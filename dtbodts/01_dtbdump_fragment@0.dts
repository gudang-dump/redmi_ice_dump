/dts-v1/;

/ {

	__fixups__ {
		accdet = "/fragment@7:target:0", "/fragment@36:target:0";
		audgpio = "/fragment@15:target:0";
		auxadc = "/fragment@17:target:0", "/fragment@18/__overlay__:io-channels:0";
		chosen = "/fragment@0:target:0", "/fragment@56:target:0";
		consys = "/fragment@14:target:0";
		flashlights_ocp8132 = "/fragment@55:target:0";
		fpsensor_finger = "/fragment@70:target:0";
		fpsensor_fp_eint = "/fragment@34:target:0";
		gpio = "/fragment@31:target:0";
		gpio_usage_mapping = "/fragment@30:target:0";
		i2c0 = "/fragment@20:target:0", "/fragment@73:target:0", "/fragment@74:target:0";
		i2c1 = "/fragment@21:target:0";
		i2c2 = "/fragment@2:target:0", "/fragment@22:target:0";
		i2c3 = "/fragment@3:target:0", "/fragment@11:target:0", "/fragment@23:target:0", "/fragment@72:target:0";
		i2c4 = "/fragment@24:target:0", "/fragment@61:target:0";
		i2c5 = "/fragment@25:target:0", "/fragment@63:target:0";
		i2c6 = "/fragment@4:target:0", "/fragment@26:target:0", "/fragment@62:target:0";
		i2c7 = "/fragment@27:target:0";
		i2c8 = "/fragment@28:target:0";
		i2c9 = "/fragment@29:target:0";
		irq_nfc = "/fragment@37:target:0";
		kd_camera_hw1 = "/fragment@50:target:0", "/fragment@54:target:0";
		keypad = "/fragment@5:target:0", "/fragment@52:target:0";
		md1_sim1_hot_plug_eint = "/fragment@42:target:0";
		md1_sim2_hot_plug_eint = "/fragment@43:target:0";
		md_auxadc = "/fragment@18:target:0";
		mrdump_ext_rst = "/fragment@33:target:0";
		msdc1_ins = "/fragment@32:target:0";
		mt6370_chg = "/fragment@10:target:0";
		mt6370_pmu = "/fragment@9:target:0";
		mt6370_typec = "/fragment@12:target:0";
		mt_pmic_vcama_ldo_reg = "/fragment@44:target:0", "/fragment@50/__overlay__:vcama-supply:0", "/fragment@50/__overlay__:vcama_sub-supply:0", "/fragment@50/__overlay__:vcama_main2-supply:0", "/fragment@54/__overlay__:cam0_vcama-supply:0", "/fragment@54/__overlay__:cam1_vcama-supply:0", "/fragment@54/__overlay__:cam2_vcama-supply:0", "/fragment@61/__overlay__/gc6133c@40:vcama-supply:0", "/fragment@61/__overlay__/bf30a2@6e:vcama-supply:0";
		mt_pmic_vcamd_ldo_reg = "/fragment@47:target:0", "/fragment@50/__overlay__:vcamd-supply:0", "/fragment@50/__overlay__:vcamd_sub-supply:0", "/fragment@54/__overlay__:cam0_vcamd-supply:0", "/fragment@54/__overlay__:cam1_vcamd-supply:0", "/fragment@61/__overlay__/gc6133c@40:vcamd-supply:0", "/fragment@61/__overlay__/bf30a2@6e:vcamd-supply:0";
		mt_pmic_vcamio_ldo_reg = "/fragment@48:target:0", "/fragment@50/__overlay__:vcamio-supply:0", "/fragment@50/__overlay__:vcamio_sub-supply:0", "/fragment@50/__overlay__:vcamio_main2-supply:0", "/fragment@54/__overlay__:cam0_vcamio-supply:0", "/fragment@54/__overlay__:cam1_vcamio-supply:0", "/fragment@54/__overlay__:cam2_vcamio-supply:0", "/fragment@61/__overlay__/gc6133c@40:vcamio-supply:0", "/fragment@61/__overlay__/bf30a2@6e:vcamio-supply:0";
		mt_pmic_vldo28_ldo_reg = "/fragment@49:target:0", "/fragment@50/__overlay__:vcamaf-supply:0", "/fragment@51/__overlay__:vtouch-supply:0", "/fragment@54/__overlay__:cam0_vcamaf-supply:0";
		mt_pmic_vsim1_ldo_reg = "/fragment@45:target:0";
		mt_pmic_vsim2_ldo_reg = "/fragment@46:target:0";
		mtkfb = "/fragment@58:target:0";
		odm = "/fragment@1:target:0";
		otg_iddig = "/fragment@41:target:0";
		pio = "/fragment@6:target:0", "/fragment@8:target:0", "/fragment@9/__overlay__:mt6370,intr_gpio:0", "/fragment@11/__overlay__/rt9465@4b:rt,en_gpio:0", "/fragment@11/__overlay__/rt9465@4b:rt,intr_gpio:0", "/fragment@12/__overlay__:mt6370pd,intr_gpio:0", "/fragment@13:target:0", "/fragment@16:target:0", "/fragment@30/__overlay__:GPIO_SIM2_SIO:0", "/fragment@30/__overlay__:GPIO_SIM2_SRST:0", "/fragment@30/__overlay__:GPIO_SIM2_SCLK:0", "/fragment@30/__overlay__:GPIO_SIM1_SCLK:0", "/fragment@30/__overlay__:GPIO_SIM1_SRST:0", "/fragment@30/__overlay__:GPIO_SIM1_SIO:0", "/fragment@30/__overlay__:GPIO_SIM2_HOT_PLUG:0", "/fragment@30/__overlay__:GPIO_SIM1_HOT_PLUG:0", "/fragment@30/__overlay__:GPIO_FDD_BAND_SUPPORT_DETECT_1ST_PIN:0", "/fragment@32/__overlay__:interrupt-parent:0", "/fragment@33/__overlay__:interrupt-parent:0", "/fragment@33/__overlay__:deb-gpios:0", "/fragment@34/__overlay__:interrupt-parent:0", "/fragment@35/__overlay__:interrupt-parent:0", "/fragment@36/__overlay__:interrupt-parent:0", "/fragment@36/__overlay__:deb-gpios:0", "/fragment@37/__overlay__:interrupt-parent:0", "/fragment@38/__overlay__:interrupt-parent:0", "/fragment@39/__overlay__:interrupt-parent:0", "/fragment@39/__overlay__:deb-gpios:0", "/fragment@40/__overlay__:interrupt-parent:0", "/fragment@40/__overlay__:deb-gpios:0", "/fragment@41/__overlay__:interrupt-parent:0", "/fragment@53:target:0", "/fragment@57:target:0", "/fragment@59:target:0", "/fragment@60:target:0", "/fragment@61/__overlay__/gc6133c@40:reset-gpio:0", "/fragment@61/__overlay__/gc6133c@40:reset-gpio1:0", "/fragment@61/__overlay__/bf30a2@6e:reset-gpio:0", "/fragment@61/__overlay__/bf30a2@6e:reset-gpio1:0", "/fragment@64/__overlay__:interrupt-parent:0", "/fragment@65:target:0", "/fragment@68:target:0", "/fragment@69:target:0", "/fragment@71:target:0", "/fragment@75/__overlay__/touch@0:interrupt-parent:0", "/fragment@75/__overlay__/touch@0:focaltech,reset-gpio:0", "/fragment@75/__overlay__/touch@0:focaltech,irq-gpio:0", "/fragment@75/__overlay__/touch@0:chipone,rst-gpio:0", "/fragment@75/__overlay__/touch@0:chipone,irq-gpio:0", "/fragment@75/__overlay__/touch@0:novatek,reset-gpio:0", "/fragment@75/__overlay__/touch@0:novatek,irq-gpio:0";
		pmic_clock_buffer_ctrl = "/fragment@19:target:0";
		silead_fp = "/fragment@67:target:0";
		smart_pa = "/fragment@35:target:0";
		spi1 = "/fragment@66:target:0";
		spi3 = "/fragment@75:target:0";
		subpmic_pmu_eint = "/fragment@38:target:0";
		swtp = "/fragment@40:target:0";
		swtp1 = "/fragment@39:target:0";
		touch = "/fragment@51:target:0", "/fragment@64:target:0";
	};

	__local_fixups__ {

		fragment@14 {

			__overlay__ {
				pinctrl-0 = <0x0>;
				pinctrl-1 = <0x0>;
				pinctrl-2 = <0x0>;
				pinctrl-3 = <0x0>;
			};
		};

		fragment@15 {

			__overlay__ {
				pinctrl-0 = <0x0>;
				pinctrl-1 = <0x0>;
				pinctrl-2 = <0x0>;
				pinctrl-3 = <0x0>;
				pinctrl-4 = <0x0>;
				pinctrl-5 = <0x0>;
				pinctrl-6 = <0x0>;
				pinctrl-7 = <0x0>;
				pinctrl-8 = <0x0>;
				pinctrl-9 = <0x0>;
			};
		};

		fragment@5 {

			__overlay__ {
				pinctrl-0 = <0x0>;
			};
		};

		fragment@54 {

			__overlay__ {
				pinctrl-0 = <0x0>;
				pinctrl-1 = <0x0>;
				pinctrl-10 = <0x0>;
				pinctrl-11 = <0x0>;
				pinctrl-12 = <0x0>;
				pinctrl-13 = <0x0>;
				pinctrl-14 = <0x0>;
				pinctrl-15 = <0x0>;
				pinctrl-16 = <0x0>;
				pinctrl-2 = <0x0>;
				pinctrl-3 = <0x0>;
				pinctrl-4 = <0x0>;
				pinctrl-5 = <0x0>;
				pinctrl-6 = <0x0>;
				pinctrl-7 = <0x0>;
				pinctrl-8 = <0x0>;
				pinctrl-9 = <0x0>;
			};
		};

		fragment@55 {

			__overlay__ {
				pinctrl-0 = <0x0>;
				pinctrl-1 = <0x0>;
				pinctrl-2 = <0x0>;
				pinctrl-3 = <0x0>;
				pinctrl-4 = <0x0>;
			};
		};

		fragment@58 {

			__overlay__ {
				pinctrl-0 = <0x0>;
				pinctrl-1 = <0x0>;
				pinctrl-10 = <0x0>;
				pinctrl-11 = <0x0>;
				pinctrl-12 = <0x0>;
				pinctrl-2 = <0x0>;
				pinctrl-3 = <0x0>;
				pinctrl-4 = <0x0>;
				pinctrl-5 = <0x0>;
				pinctrl-6 = <0x0>;
				pinctrl-7 = <0x0>;
				pinctrl-8 = <0x0>;
				pinctrl-9 = <0x0>;
			};
		};

		fragment@61 {

			__overlay__ {

				bf30a2@6e {
					pinctrl-0 = <0x0>;
					pinctrl-1 = <0x0>;
				};

				gc6133c@40 {
					pinctrl-0 = <0x0>;
					pinctrl-1 = <0x0>;
				};
			};
		};

		fragment@64 {

			__overlay__ {
				pinctrl-0 = <0x0>;
				pinctrl-1 = <0x0>;
				pinctrl-2 = <0x0>;
				pinctrl-3 = <0x0>;
				pinctrl-4 = <0x0>;
				pinctrl-5 = <0x0>;
				pinctrl-6 = <0x0>;
				pinctrl-7 = <0x0>;
			};
		};

		fragment@67 {

			__overlay__ {
				pinctrl-0 = <0x0>;
				pinctrl-1 = <0x0>;
				pinctrl-2 = <0x0>;
				pinctrl-3 = <0x0>;
				pinctrl-4 = <0x0>;
				pinctrl-5 = <0x0>;
				pinctrl-6 = <0x0>;
				pinctrl-7 = <0x0>;
			};
		};

		fragment@7 {

			__overlay__ {
				pinctrl-0 = <0x0>;
				pinctrl-1 = <0x0>;
			};
		};

		fragment@70 {

			__overlay__ {
				pinctrl-0 = <0x0>;
				pinctrl-1 = <0x0>;
				pinctrl-2 = <0x0>;
			};
		};
	};

	__symbols__ {
		accdet_pins_default = "/fragment@8/__overlay__/accdetdefault";
		accdet_pins_eint_as_int = "/fragment@8/__overlay__/accdeteint@0";
		aud_clk_miso_off = "/fragment@16/__overlay__/aud_clk_miso_off";
		aud_clk_miso_on = "/fragment@16/__overlay__/aud_clk_miso_on";
		aud_clk_mosi_off = "/fragment@16/__overlay__/aud_clk_mosi_off";
		aud_clk_mosi_on = "/fragment@16/__overlay__/aud_clk_mosi_on";
		aud_dat_miso_off = "/fragment@16/__overlay__/aud_dat_miso_off";
		aud_dat_miso_on = "/fragment@16/__overlay__/aud_dat_miso_on";
		aud_dat_mosi_off = "/fragment@16/__overlay__/aud_dat_mosi_off";
		aud_dat_mosi_on = "/fragment@16/__overlay__/aud_dat_mosi_on";
		aud_pins_smartpa_off = "/fragment@16/__overlay__/aud_pins_smartpa_off";
		aud_pins_smartpa_on = "/fragment@16/__overlay__/aud_pins_smartpa_on";
		camera_main_af_mtk = "/fragment@22/__overlay__/camera_main_af@0c";
		camera_main_eeprom_mtk = "/fragment@22/__overlay__/camera_main_eeprom@51";
		camera_main_mtk = "/fragment@22/__overlay__/camera_main@10";
		camera_main_two_mtk = "/fragment@24/__overlay__/camera_main_two@3c";
		camera_pins_bf30a2_mclk_off = "/fragment@60/__overlay__/camera_pins_bf30a2_mclk_off";
		camera_pins_bf30a2_mclk_on = "/fragment@60/__overlay__/camera_pins_bf30a2_mclk_on";
		camera_pins_cam0_mclk_off = "/fragment@53/__overlay__/camera_pins_cam0_mclk_off";
		camera_pins_cam0_mclk_on = "/fragment@53/__overlay__/camera_pins_cam0_mclk_on";
		camera_pins_cam0_pnd0 = "/fragment@53/__overlay__/cam0@2";
		camera_pins_cam0_pnd1 = "/fragment@53/__overlay__/cam0@3";
		camera_pins_cam0_rst0 = "/fragment@53/__overlay__/cam0@0";
		camera_pins_cam0_rst1 = "/fragment@53/__overlay__/cam0@1";
		camera_pins_cam1_mclk_off = "/fragment@53/__overlay__/camera_pins_cam1_mclk_off";
		camera_pins_cam1_mclk_on = "/fragment@53/__overlay__/camera_pins_cam1_mclk_on";
		camera_pins_cam1_pnd0 = "/fragment@53/__overlay__/cam1@2";
		camera_pins_cam1_pnd1 = "/fragment@53/__overlay__/cam1@3";
		camera_pins_cam1_rst0 = "/fragment@53/__overlay__/cam1@0";
		camera_pins_cam1_rst1 = "/fragment@53/__overlay__/cam1@1";
		camera_pins_cam2_mclk_off = "/fragment@53/__overlay__/camera_pins_cam2_mclk_off";
		camera_pins_cam2_mclk_on = "/fragment@53/__overlay__/camera_pins_cam2_mclk_on";
		camera_pins_cam2_rst0 = "/fragment@53/__overlay__/cam2@0";
		camera_pins_cam2_rst1 = "/fragment@53/__overlay__/cam2@1";
		camera_pins_default = "/fragment@53/__overlay__/camdefault";
		camera_pins_gc6133c_mclk_off = "/fragment@59/__overlay__/camera_pins_gc6133c_mclk_off";
		camera_pins_gc6133c_mclk_on = "/fragment@59/__overlay__/camera_pins_gc6133c_mclk_on";
		camera_sub_eeprom_mtk = "/fragment@24/__overlay__/camera_sub_eeprom@51";
		camera_sub_mtk = "/fragment@24/__overlay__/camera_sub@10";
		consys_pins_default = "/fragment@13/__overlay__/consys_default";
		ctp_pins_default = "/fragment@65/__overlay__/eint0default";
		ctp_pins_eint_as_int = "/fragment@65/__overlay__/eint@0";
		ctp_pins_eint_output0 = "/fragment@65/__overlay__/eintoutput0";
		ctp_pins_eint_output1 = "/fragment@65/__overlay__/eintoutput1";
		ctp_pins_rst_output0 = "/fragment@65/__overlay__/rstoutput0";
		ctp_pins_rst_output1 = "/fragment@65/__overlay__/rstoutput1";
		ctp_pins_spi_cs_output0 = "/fragment@65/__overlay__/spi_cs_out0_gpio";
		ctp_pins_spi_cs_output1 = "/fragment@65/__overlay__/spi_cs_out1_gpio";
		ext_buck_lp4_mtk = "/fragment@23/__overlay__/ext_buck_lp4@57";
		ext_buck_lp4x_mtk = "/fragment@23/__overlay__/ext_buck_lp4x@50";
		ext_buck_vgpu_mtk = "/fragment@26/__overlay__/ext_buck_vgpu@55";
		fingerprint_pins_default = "/fragment@68/__overlay__/fp_default";
		flashlight_pins_default = "/fragment@53/__overlay__/flashlightdefault";
		flashlight_pins_en_output0 = "/fragment@53/__overlay__/flashlightenoutput0";
		flashlight_pins_en_output1 = "/fragment@53/__overlay__/flashlightenoutput1";
		flashlight_pins_sel_output0 = "/fragment@53/__overlay__/flashlightseloutput0";
		flashlight_pins_sel_output1 = "/fragment@53/__overlay__/flashlightseloutput1";
		fpsensor_fp_power_high = "/fragment@71/__overlay__/fpsensor_fp_power_high";
		fpsensor_fpc_rst_high = "/fragment@71/__overlay__/fpsensor_fpc_rst_high";
		fpsensor_fpc_rst_low = "/fragment@71/__overlay__/fpsensor_fpc_rst_low";
		gpslna_pins_init = "/fragment@13/__overlay__/gpslna@0";
		gpslna_pins_oh = "/fragment@13/__overlay__/gpslna@1";
		gpslna_pins_ol = "/fragment@13/__overlay__/gpslna@2";
		i2c_lcd_bias_mtk = "/fragment@26/__overlay__/i2c_lcd_bias@7c";
		kpd_pins_default = "/fragment@6/__overlay__/kpdgpiodefault";
		led0 = "/fragment@1/__overlay__/led@0";
		led1 = "/fragment@1/__overlay__/led@1";
		led2 = "/fragment@1/__overlay__/led@2";
		led3 = "/fragment@1/__overlay__/led@3";
		led4 = "/fragment@1/__overlay__/led@4";
		led5 = "/fragment@1/__overlay__/led@5";
		led6 = "/fragment@1/__overlay__/led@6";
		mtkfb_pins_default = "/fragment@57/__overlay__/dispdefault";
		mtkfb_pins_lcd_bias_enn0 = "/fragment@57/__overlay__/lcd_bias_enn0_gpio";
		mtkfb_pins_lcd_bias_enn1 = "/fragment@57/__overlay__/lcd_bias_enn1_gpio";
		mtkfb_pins_lcd_bias_enp0 = "/fragment@57/__overlay__/lcd_bias_enp0_gpio";
		mtkfb_pins_lcd_bias_enp1 = "/fragment@57/__overlay__/lcd_bias_enp1_gpio";
		mtkfb_pins_lcd_bl_out0 = "/fragment@57/__overlay__/lcd_bl_out0_gpio";
		mtkfb_pins_lcd_bl_out1 = "/fragment@57/__overlay__/lcd_bl_out1_gpio";
		mtkfb_pins_lcd_ldo18_out0 = "/fragment@57/__overlay__/lcd_ldo18_out0_gpio";
		mtkfb_pins_lcd_ldo18_out1 = "/fragment@57/__overlay__/lcd_ldo18_out1_gpio";
		mtkfb_pins_lcm_rst_out0 = "/fragment@57/__overlay__/lcm_rst_out0_gpio";
		mtkfb_pins_lcm_rst_out1 = "/fragment@57/__overlay__/lcm_rst_out1_gpio";
		mtkfb_pins_tp_rst_out0 = "/fragment@57/__overlay__/tp_rst_out0_gpio";
		mtkfb_pins_tp_rst_out1 = "/fragment@57/__overlay__/tp_rst_out1_gpio";
		nfc_mtk = "/fragment@23/__overlay__/nfc@08";
		silfp_avdd_high = "/fragment@69/__overlay__/state_avdd_high";
		silfp_default = "/fragment@69/__overlay__/silfpdefault";
		silfp_irq = "/fragment@69/__overlay__/fp_eint@3";
		silfp_irq_rst_high = "/fragment@69/__overlay__/state_irq_to_reset_high";
		silfp_irq_rst_low = "/fragment@69/__overlay__/state_irq_to_reset_low";
		silfp_rst_high = "/fragment@69/__overlay__/state_reset_high";
		silfp_rst_low = "/fragment@69/__overlay__/state_reset_low";
		slave_charger_mtk = "/fragment@23/__overlay__/slave_charger@4b";
		speaker_amp = "/fragment@72/__overlay__/speaker_amp@34";
		speaker_amp_mtk = "/fragment@23/__overlay__/speaker_amp@34";
		subpmic_pmu_mtk = "/fragment@25/__overlay__/subpmic_pmu@34";
		usb_type_c_mtk = "/fragment@25/__overlay__/usb_type_c@4e";
		vibrator0 = "/fragment@1/__overlay__/vibrator@0";
	};

	fragment@0 {
		target = <0xffffffff>;

		__overlay__ {
			atag,videolfb-fb_base_h = <0x0>;
			atag,videolfb-fb_base_l = "^`P";
			atag,videolfb-fps = <0x1770>;
			atag,videolfb-islcm_inited = <0x0>;
			atag,videolfb-islcmfound = <0x1>;
			atag,videolfb-vramSize = <0x17bb000>;
		};
	};

	fragment@1 {
		target = <0xffffffff>;

		__overlay__ {

			led@0 {
				compatible = "mediatek,red";
				data = <0x1>;
				led_mode = <0x0>;
				phandle = <0x4c>;
				pwm_config = <0x0 0x0 0x0 0x0 0x0>;
			};

			led@1 {
				compatible = "mediatek,green";
				data = <0x1>;
				led_mode = <0x0>;
				phandle = <0x4d>;
				pwm_config = <0x0 0x0 0x0 0x0 0x0>;
			};

			led@2 {
				compatible = "mediatek,blue";
				data = <0x1>;
				led_mode = <0x0>;
				phandle = <0x4e>;
				pwm_config = <0x0 0x0 0x0 0x0 0x0>;
			};

			led@3 {
				compatible = "mediatek,jogball-backlight";
				data = <0x1>;
				led_mode = <0x0>;
				phandle = <0x4f>;
				pwm_config = <0x0 0x0 0x0 0x0 0x0>;
			};

			led@4 {
				compatible = "mediatek,keyboard-backlight";
				data = <0x1>;
				led_mode = <0x0>;
				phandle = <0x50>;
				pwm_config = <0x0 0x0 0x0 0x0 0x0>;
			};

			led@5 {
				compatible = "mediatek,button-backlight";
				data = <0x1>;
				led_mode = <0x0>;
				phandle = <0x51>;
				pwm_config = <0x0 0x0 0x0 0x0 0x0>;
			};

			led@6 {
				compatible = "mediatek,lcd-backlight";
				data = <0x1>;
				led_mode = <0x4>;
				phandle = <0x52>;
				pwm_config = <0x0 0x3 0x0 0x0 0x0>;
			};

			vibrator@0 {
				compatible = "mediatek,vibrator";
				phandle = <0x53>;
				vib_limit = <0x9>;
				vib_timer = <0x19>;
				vib_vol = <0x9>;
			};
		};
	};

	fragment@10 {
		target = <0xffffffff>;

		__overlay__ {
			bc12_sel = <0x1>;
		};
	};

	fragment@11 {
		target = <0xffffffff>;

		__overlay__ {

			rt9465@4b {
				charger_name = "secondary_chg";
				compatible = "richtek,rt9465";
				cv = <0x456d70>;
				en_st;
				en_wdt;
				ichg = <0x16e360>;
				ieoc = <0xaae60>;
				interrupt-names = "wdtmri";
				mivr = <0x44aa20>;
				reg = <0x4b>;
				rt,en_gpio = <0xffffffff 0xb0 0x0>;
				rt,en_gpio_num = <0xb0>;
				rt,intr_gpio = <0xffffffff 0x17 0x0>;
				rt,intr_gpio_num = <0x17>;
				safety_timer = <0xc>;
				status = "okay";
			};
		};
	};

	fragment@12 {
		target = <0xffffffff>;

		__overlay__ {
			mt6370pd,intr_gpio = <0xffffffff 0x29 0x0>;
			mt6370pd,intr_gpio_num = <0x29>;
		};
	};

	fragment@13 {
		target = <0xffffffff>;

		__overlay__ {

			consys_default {
				phandle = <0x4>;
			};

			gpslna@0 {
				phandle = <0x5>;

				pins_cmd_dat {
					bias-disable;
					output-low;
					pinmux = <0x5b00>;
					slew-rate = <0x0>;
				};
			};

			gpslna@1 {
				phandle = <0x6>;

				pins_cmd_dat {
					output-high;
					pinmux = <0x5b00>;
					slew-rate = <0x1>;
				};
			};

			gpslna@2 {
				phandle = <0x7>;

				pins_cmd_dat {
					output-low;
					pinmux = <0x5b00>;
					slew-rate = <0x1>;
				};
			};
		};
	};

	fragment@14 {
		target = <0xffffffff>;

		__overlay__ {
			pinctrl-0 = <0x4>;
			pinctrl-1 = <0x5>;
			pinctrl-2 = <0x6>;
			pinctrl-3 = <0x7>;
			pinctrl-names = "default", "gps_lna_state_init", "gps_lna_state_oh", "gps_lna_state_ol";
			status = "okay";
		};
	};

	fragment@15 {
		target = <0xffffffff>;

		__overlay__ {
			pinctrl-0 = <0x8>;
			pinctrl-1 = <0x9>;
			pinctrl-2 = <0xa>;
			pinctrl-3 = <0xb>;
			pinctrl-4 = <0xc>;
			pinctrl-5 = <0xd>;
			pinctrl-6 = <0xe>;
			pinctrl-7 = <0xf>;
			pinctrl-8 = <0x10>;
			pinctrl-9 = <0x11>;
			pinctrl-names = "aud_clk_mosi_off", "aud_clk_mosi_on", "aud_clk_miso_off", "aud_clk_miso_on", "aud_dat_mosi_off", "aud_dat_mosi_on", "aud_dat_miso_off", "aud_dat_miso_on", "aud_smartpa_off", "aud_smartpa_on";
			status = "okay";
		};
	};

	fragment@16 {
		target = <0xffffffff>;

		__overlay__ {

			aud_clk_miso_off {
				phandle = <0xa>;

				pins_cmd0_dat {
					pinmux = <0x8c00>;
				};
			};

			aud_clk_miso_on {
				phandle = <0xb>;

				pins_cmd0_dat {
					pinmux = <0x8c01>;
				};
			};

			aud_clk_mosi_off {
				phandle = <0x8>;

				pins_cmd0_dat {
					pinmux = <0x8800>;
				};
			};

			aud_clk_mosi_on {
				phandle = <0x9>;

				pins_cmd0_dat {
					pinmux = <0x8801>;
				};
			};

			aud_dat_miso_off {
				phandle = <0xe>;

				pins_cmd1_dat {
					bias-disable;
					input-enable;
					pinmux = <0x8e00>;
					slew-rate = <0x0>;
				};

				pins_cmd2_dat {
					bias-disable;
					input-enable;
					pinmux = <0x8f00>;
					slew-rate = <0x0>;
				};
			};

			aud_dat_miso_on {
				phandle = <0xf>;

				pins_cmd1_dat {
					pinmux = <0x8e01>;
				};

				pins_cmd2_dat {
					pinmux = <0x8f01>;
				};
			};

			aud_dat_mosi_off {
				phandle = <0xc>;

				pins_cmd1_dat {
					bias-disable;
					input-enable;
					pinmux = <0x8a00>;
					slew-rate = <0x0>;
				};

				pins_cmd2_dat {
					bias-disable;
					input-enable;
					pinmux = <0x8b00>;
					slew-rate = <0x0>;
				};
			};

			aud_dat_mosi_on {
				phandle = <0xd>;

				pins_cmd1_dat {
					pinmux = <0x8a01>;
				};

				pins_cmd2_dat {
					pinmux = <0x8b01>;
				};
			};

			aud_pins_smartpa_off {
				phandle = <0x10>;

				pins_cmd0_dat {
					pinmux = <0x1100>;
				};

				pins_cmd1_dat {
					pinmux = <0x1200>;
				};

				pins_cmd2_dat {
					pinmux = <0x1300>;
				};

				pins_cmd3_dat {
					pinmux = <0x1400>;
				};
			};

			aud_pins_smartpa_on {
				phandle = <0x11>;

				pins_cmd0_dat {
					pinmux = <0x1106>;
				};

				pins_cmd1_dat {
					pinmux = <0x1206>;
				};

				pins_cmd2_dat {
					pinmux = <0x1306>;
				};

				pins_cmd3_dat {
					pinmux = <0x1406>;
				};
			};
		};
	};

	fragment@17 {
		target = <0xffffffff>;

		__overlay__ {

			adc_channel@ {
				compatible = "mediatek,adc_channel";
				mediatek,adc_fdd_rf_params_dynamic_custom_ch = <0x3>;
				mediatek,battery_voltage = <0x2>;
				mediatek,temperature0 = <0x0>;
				mediatek,temperature1 = <0x1>;
				status = "okay";
			};
		};
	};

	fragment@18 {
		target = <0xffffffff>;

		__overlay__ {
			io-channels = <0xffffffff 0x3>;
		};
	};

	fragment@19 {
		target = <0xffffffff>;

		__overlay__ {
			mediatek,clkbuf-config = <0x2 0x1 0x1 0x2 0x0 0x0 0x0>;
			mediatek,clkbuf-driving-current = <0x1 0x1 0x1 0x1 0x1 0x1 0x1>;
			mediatek,clkbuf-quantity = <0x7>;
			status = "okay";
		};
	};

	fragment@2 {
		target = <0xffffffff>;

		__overlay__ {
			#address-cells = <0x1>;
			#size-cells = <0x0>;
			clock-frequency = <0x61a80>;

			mtk-usb@60 {
				compatible = "mediatek,mtk-usb";
				reg = <0x60>;
				status = "okay";
			};
		};
	};

	fragment@20 {
		target = <0xffffffff>;

		__overlay__ {
			#address-cells = <0x1>;
			#size-cells = <0x0>;
			clock-frequency = <0x61a80>;
			mediatek,use-open-drain;
		};
	};

	fragment@21 {
		target = <0xffffffff>;

		__overlay__ {
			#address-cells = <0x1>;
			#size-cells = <0x0>;
			clock-frequency = <0x61a80>;
			mediatek,use-open-drain;
		};
	};

	fragment@22 {
		target = <0xffffffff>;

		__overlay__ {
			#address-cells = <0x1>;
			#size-cells = <0x0>;
			clock-frequency = <0x61a80>;
			mediatek,use-open-drain;

			camera_main@10 {
				compatible = "mediatek,camera_main";
				phandle = <0x54>;
				reg = <0x10>;
				status = "okay";
			};

			camera_main_af@0c {
				compatible = "mediatek,camera_main_af";
				phandle = <0x56>;
				reg = <0xc>;
				status = "okay";
			};

			camera_main_eeprom@51 {
				compatible = "mediatek,camera_main_eeprom";
				phandle = <0x55>;
				reg = <0x51>;
				status = "okay";
			};
		};
	};

	fragment@23 {
		target = <0xffffffff>;

		__overlay__ {
			#address-cells = <0x1>;
			#size-cells = <0x0>;
			clock-frequency = <0x61a80>;
			mediatek,use-open-drain;

			ext_buck_lp4@57 {
				compatible = "mediatek,ext_buck_lp4";
				phandle = <0x5a>;
				reg = <0x57>;
				status = "okay";
			};

			ext_buck_lp4x@50 {
				compatible = "mediatek,ext_buck_lp4x";
				phandle = <0x5b>;
				reg = <0x50>;
				status = "okay";
			};

			nfc@08 {
				compatible = "mediatek,nfc";
				phandle = <0x59>;
				reg = <0x8>;
				status = "okay";
			};

			slave_charger@4b {
				compatible = "mediatek,slave_charger";
				phandle = <0x58>;
				reg = <0x4b>;
				status = "okay";
			};

			speaker_amp@34 {
				compatible = "mediatek,speaker_amp";
				phandle = <0x57>;
				reg = <0x34>;
				status = "okay";
			};
		};
	};

	fragment@24 {
		target = <0xffffffff>;

		__overlay__ {
			#address-cells = <0x1>;
			#size-cells = <0x0>;
			clock-frequency = <0x61a80>;
			mediatek,use-open-drain;

			camera_main_two@3c {
				compatible = "mediatek,camera_main_two";
				phandle = <0x5e>;
				reg = <0x3c>;
				status = "okay";
			};

			camera_sub@10 {
				compatible = "mediatek,camera_sub";
				phandle = <0x5c>;
				reg = <0x10>;
				status = "okay";
			};

			camera_sub_eeprom@51 {
				compatible = "mediatek,camera_sub_eeprom";
				phandle = <0x5d>;
				reg = <0x51>;
				status = "okay";
			};
		};
	};

	fragment@25 {
		target = <0xffffffff>;

		__overlay__ {
			#address-cells = <0x1>;
			#size-cells = <0x0>;
			clock-frequency = <0x61a80>;
			mediatek,use-push-pull;

			subpmic_pmu@34 {
				compatible = "mediatek,subpmic_pmu";
				phandle = <0x5f>;
				reg = <0x34>;
				status = "okay";
			};

			usb_type_c@4e {
				compatible = "mediatek,usb_type_c";
				phandle = <0x60>;
				reg = <0x4e>;
				status = "okay";
			};
		};
	};

	fragment@26 {
		target = <0xffffffff>;

		__overlay__ {
			#address-cells = <0x1>;
			#size-cells = <0x0>;
			clock-frequency = <0x61a80>;
			mediatek,use-open-drain;

			ext_buck_vgpu@55 {
				compatible = "mediatek,ext_buck_vgpu";
				phandle = <0x61>;
				reg = <0x55>;
				status = "okay";
			};

			i2c_lcd_bias@7c {
				compatible = "mediatek,i2c_lcd_bias";
				phandle = <0x62>;
				reg = <0x7c>;
				status = "okay";
			};
		};
	};

	fragment@27 {
		target = <0xffffffff>;

		__overlay__ {
			#address-cells = <0x1>;
			#size-cells = <0x0>;
			clock-frequency = <0x61a80>;
			mediatek,use-open-drain;
		};
	};

	fragment@28 {
		target = <0xffffffff>;

		__overlay__ {
			#address-cells = <0x1>;
			#size-cells = <0x0>;
			clock-frequency = <0x61a80>;
			mediatek,use-open-drain;
		};
	};

	fragment@29 {
		target = <0xffffffff>;

		__overlay__ {
			#address-cells = <0x1>;
			#size-cells = <0x0>;
			clock-frequency = <0x61a80>;
			mediatek,use-open-drain;
		};
	};

	fragment@3 {
		target = <0xffffffff>;

		__overlay__ {

			ext_buck_lp4@57 {
				regulator-max-microvolt = <0x13d620>;
				regulator-min-microvolt = <0x493e0>;
				regulator-name = "ext_buck_vdd2";
				vsel_pin = <0x0>;
			};

			ext_buck_lp4x@50 {
				regulator-max-microvolt = <0x13d620>;
				regulator-min-microvolt = <0x493e0>;
				regulator-name = "ext_buck_vddq";
				vsel_pin = <0x1>;
			};
		};
	};

	fragment@30 {
		target = <0xffffffff>;

		__overlay__ {
			GPIO_FDD_BAND_SUPPORT_DETECT_1ST_PIN = <0xffffffff 0xa4 0x0>;
			GPIO_SIM1_HOT_PLUG = <0xffffffff 0x2f 0x0>;
			GPIO_SIM1_SCLK = <0xffffffff 0x26 0x0>;
			GPIO_SIM1_SIO = <0xffffffff 0x28 0x0>;
			GPIO_SIM1_SRST = <0xffffffff 0x27 0x0>;
			GPIO_SIM2_HOT_PLUG = <0xffffffff 0x2e 0x0>;
			GPIO_SIM2_SCLK = <0xffffffff 0x25 0x0>;
			GPIO_SIM2_SIO = <0xffffffff 0x23 0x0>;
			GPIO_SIM2_SRST = <0xffffffff 0x24 0x0>;
		};
	};

	fragment@31 {
		target = <0xffffffff>;

		__overlay__ {
			gpio_init_default = <0x0 0x0 0x0 0x0 0x1 0x1 0x1 0x1 0x0 0x0 0x0 0x1 0x1 0x1 0x2 0x0 0x0 0x0 0x1 0x1 0x1 0x3 0x0 0x0 0x0 0x1 0x0 0x1 0x4 0x5 0x0 0x0 0x1 0x1 0x0 0x5 0x5 0x0 0x0 0x0 0x0 0x0 0x6 0x0 0x0 0x0 0x1 0x0 0x0 0x7 0x0 0x0 0x0 0x1 0x0 0x0 0x8 0x7 0x0 0x0 0x1 0x1 0x0 0x9 0x0 0x0 0x0 0x1 0x1 0x0 0xa 0x0 0x0 0x0 0x1 0x0 0x0 0xb 0x0 0x0 0x0 0x1 0x1 0x0 0xc 0x0 0x0 0x0 0x1 0x0 0x0 0xd 0x3 0x0 0x0 0x1 0x0 0x0 0xe 0x3 0x0 0x0 0x0 0x0 0x0 0xf 0x3 0x0 0x0 0x0 0x0 0x0 0x10 0x3 0x0 0x0 0x0 0x0 0x0 0x11 0x6 0x0 0x0 0x1 0x0 0x0 0x12 0x0 0x0 0x0 0x1 0x0 0x0 0x13 0x0 0x0 0x0 0x0 0x0 0x0 0x14 0x0 0x0 0x0 0x1 0x0 0x0 0x15 0x1 0x0 0x0 0x1 0x0 0x0 0x16 0x1 0x0 0x0 0x0 0x0 0x0 0x17 0x1 0x0 0x0 0x0 0x0 0x0 0x18 0x1 0x0 0x0 0x0 0x0 0x0 0x19 0x1 0x0 0x0 0x1 0x0 0x0 0x1a 0x1 0x0 0x0 0x1 0x0 0x0 0x1b 0x1 0x0 0x0 0x0 0x0 0x0 0x1c 0x1 0x0 0x0 0x1 0x0 0x0 0x1d 0x1 0x0 0x0 0x1 0x0 0x1 0x1e 0x1 0x0 0x0 0x1 0x0 0x1 0x1f 0x1 0x0 0x0 0x1 0x0 0x1 0x20 0x1 0x0 0x0 0x1 0x0 0x1 0x21 0x1 0x0 0x0 0x1 0x0 0x1 0x22 0x1 0x0 0x0 0x1 0x0 0x1 0x23 0x1 0x0 0x0 0x1 0x1 0x0 0x24 0x1 0x1 0x0 0x0 0x0 0x0 0x25 0x1 0x1 0x0 0x0 0x0 0x0 0x26 0x1 0x1 0x0 0x0 0x0 0x0 0x27 0x1 0x1 0x0 0x0 0x0 0x0 0x28 0x1 0x0 0x0 0x1 0x1 0x0 0x29 0x1 0x0 0x0 0x1 0x1 0x0 0x2a 0x0 0x0 0x0 0x1 0x0 0x0 0x2b 0x0 0x1 0x0 0x0 0x0 0x0 0x2c 0x0 0x0 0x0 0x1 0x0 0x0 0x2d 0x0 0x1 0x0 0x1 0x0 0x0 0x2e 0x1 0x0 0x0 0x1 0x1 0x0 0x2f 0x1 0x0 0x0 0x1 0x1 0x0 0x30 0x1 0x0 0x0 0x1 0x1 0x1 0x31 0x1 0x0 0x0 0x1 0x1 0x1 0x32 0x1 0x0 0x0 0x1 0x1 0x1 0x33 0x1 0x0 0x0 0x1 0x1 0x1 0x34 0x1 0x0 0x0 0x1 0x0 0x0 0x35 0x1 0x0 0x0 0x1 0x0 0x0 0x36 0x0 0x0 0x0 0x0 0x0 0x0 0x37 0x1 0x0 0x0 0x1 0x0 0x0 0x38 0x1 0x0 0x0 0x1 0x0 0x0 0x39 0x1 0x0 0x0 0x1 0x0 0x0 0x3a 0x0 0x0 0x0 0x1 0x0 0x0 0x3b 0x1 0x0 0x0 0x1 0x0 0x0 0x3c 0x1 0x0 0x0 0x1 0x0 0x0 0x3d 0x1 0x0 0x0 0x1 0x0 0x0 0x3e 0x1 0x0 0x0 0x1 0x0 0x0 0x3f 0x1 0x0 0x0 0x1 0x0 0x0 0x40 0x1 0x0 0x0 0x1 0x0 0x0 0x41 0x2 0x0 0x0 0x1 0x0 0x0 0x42 0x2 0x0 0x0 0x1 0x0 0x0 0x43 0x0 0x0 0x0 0x0 0x0 0x0 0x44 0x0 0x0 0x0 0x0 0x0 0x0 0x45 0x1 0x0 0x0 0x1 0x0 0x0 0x46 0x1 0x0 0x0 0x1 0x0 0x0 0x47 0x1 0x0 0x0 0x1 0x0 0x0 0x48 0x1 0x0 0x0 0x1 0x0 0x0 0x49 0x1 0x0 0x0 0x1 0x0 0x0 0x4a 0x1 0x0 0x0 0x1 0x0 0x0 0x4b 0x1 0x0 0x0 0x1 0x0 0x0 0x4c 0x1 0x0 0x0 0x1 0x0 0x0 0x4d 0x1 0x0 0x0 0x1 0x0 0x0 0x4e 0x0 0x0 0x0 0x0 0x0 0x0 0x4f 0x0 0x0 0x0 0x1 0x0 0x0 0x50 0x0 0x0 0x0 0x1 0x0 0x0 0x51 0x1 0x0 0x0 0x1 0x1 0x1 0x52 0x1 0x0 0x0 0x1 0x1 0x1 0x53 0x1 0x0 0x0 0x1 0x1 0x1 0x54 0x1 0x0 0x0 0x1 0x1 0x1 0x55 0x1 0x0 0x0 0x1 0x0 0x0 0x56 0x1 0x0 0x0 0x1 0x0 0x0 0x57 0x0 0x0 0x0 0x1 0x0 0x0 0x58 0x0 0x0 0x0 0x1 0x0 0x0 0x59 0x1 0x0 0x0 0x1 0x0 0x0 0x5a 0x0 0x0 0x0 0x1 0x0 0x0 0x5b 0x0 0x1 0x0 0x1 0x0 0x0 0x5c 0x1 0x0 0x0 0x0 0x0 0x0 0x5d 0x1 0x0 0x0 0x1 0x1 0x0 0x5e 0x0 0x0 0x0 0x1 0x0 0x0 0x5f 0x1 0x0 0x0 0x1 0x1 0x0 0x60 0x1 0x0 0x0 0x0 0x0 0x0 0x61 0x0 0x0 0x0 0x1 0x0 0x0 0x62 0x0 0x0 0x0 0x1 0x0 0x0 0x63 0x1 0x0 0x0 0x0 0x0 0x0 0x64 0x1 0x0 0x0 0x0 0x0 0x0 0x65 0x0 0x1 0x1 0x1 0x0 0x0 0x66 0x0 0x1 0x1 0x1 0x0 0x0 0x67 0x1 0x0 0x0 0x1 0x1 0x1 0x68 0x1 0x0 0x0 0x1 0x1 0x1 0x69 0x1 0x0 0x0 0x1 0x1 0x1 0x6a 0x1 0x0 0x0 0x1 0x1 0x1 0x6b 0x0 0x0 0x0 0x1 0x0 0x0 0x6c 0x1 0x0 0x0 0x0 0x0 0x0 0x6d 0x0 0x1 0x1 0x1 0x0 0x0 0x6e 0x0 0x0 0x0 0x1 0x0 0x0 0x6f 0x0 0x0 0x0 0x1 0x0 0x0 0x70 0x0 0x0 0x0 0x1 0x0 0x0 0x71 0x0 0x0 0x0 0x1 0x0 0x0 0x72 0x0 0x0 0x0 0x1 0x0 0x0 0x73 0x0 0x0 0x0 0x1 0x0 0x0 0x74 0x0 0x0 0x0 0x1 0x0 0x0 0x75 0x0 0x0 0x0 0x1 0x0 0x0 0x76 0x0 0x0 0x0 0x1 0x0 0x0 0x77 0x0 0x0 0x0 0x1 0x0 0x0 0x78 0x0 0x0 0x0 0x1 0x0 0x0 0x79 0x0 0x0 0x0 0x1 0x0 0x0 0x86 0x1 0x0 0x0 0x1 0x0 0x1 0x87 0x1 0x0 0x0 0x0 0x0 0x0 0x88 0x1 0x0 0x0 0x0 0x0 0x0 0x89 0x1 0x0 0x0 0x0 0x0 0x0 0x8a 0x1 0x0 0x0 0x0 0x0 0x0 0x8b 0x1 0x0 0x0 0x0 0x0 0x0 0x8c 0x1 0x0 0x0 0x1 0x0 0x0 0x8d 0x1 0x0 0x0 0x1 0x0 0x0 0x8e 0x1 0x0 0x0 0x1 0x0 0x0 0x8f 0x1 0x0 0x0 0x1 0x0 0x0 0x90 0x1 0x0 0x0 0x1 0x0 0x0 0x91 0x1 0x0 0x0 0x0 0x0 0x0 0x92 0x1 0x0 0x0 0x1 0x0 0x0 0x93 0x1 0x0 0x0 0x0 0x0 0x0 0x94 0x1 0x0 0x0 0x0 0x0 0x0 0x95 0x1 0x0 0x0 0x0 0x0 0x0 0x96 0x6 0x0 0x0 0x1 0x1 0x1 0x97 0x0 0x1 0x0 0x1 0x0 0x1 0x98 0x0 0x1 0x0 0x1 0x0 0x0 0x99 0x5 0x0 0x0 0x1 0x0 0x0 0x9a 0x0 0x0 0x0 0x1 0x0 0x0 0x9b 0x7 0x0 0x0 0x0 0x0 0x0 0x9c 0x7 0x0 0x0 0x1 0x0 0x0 0x9d 0x7 0x0 0x0 0x1 0x0 0x0 0x9e 0x7 0x0 0x0 0x1 0x0 0x0 0x9f 0x0 0x0 0x0 0x1 0x0 0x0 0xa0 0x0 0x0 0x0 0x1 0x0 0x0 0xa1 0x1 0x0 0x0 0x1 0x1 0x1 0xa2 0x1 0x0 0x0 0x1 0x1 0x1 0xa3 0x0 0x0 0x0 0x0 0x0 0x0 0xa4 0x0 0x0 0x0 0x0 0x0 0x0 0xa5 0x0 0x0 0x0 0x0 0x0 0x0 0xa6 0x0 0x0 0x0 0x0 0x0 0x0 0xa7 0x0 0x1 0x0 0x1 0x0 0x0 0xa8 0x0 0x1 0x0 0x0 0x0 0x0 0xa9 0x0 0x1 0x0 0x1 0x0 0x0 0xaa 0x0 0x0 0x0 0x1 0x0 0x0 0xab 0x0 0x0 0x0 0x1 0x0 0x0 0xac 0x0 0x1 0x1 0x1 0x0 0x0 0xad 0x0 0x1 0x0 0x0 0x0 0x0 0xae 0x0 0x1 0x0 0x1 0x0 0x0 0xaf 0x0 0x1 0x0 0x1 0x0 0x0 0xb0 0x0 0x1 0x0 0x1 0x0 0x0 0xb1 0x0 0x1 0x0 0x1 0x0 0x0 0xb2 0x0 0x1 0x1 0x0 0x0 0x0 0xb3 0x0 0x0 0x0 0x1 0x0 0x0>;
		};
	};

	fragment@32 {
		target = <0xffffffff>;

		__overlay__ {
			interrupt-parent = <0xffffffff>;
			interrupts = <0x1 0x2 0x1 0x0>;
			status = "okay";
		};
	};

	fragment@33 {
		target = <0xffffffff>;

		__overlay__ {
			deb-gpios = <0xffffffff 0x2 0x0>;
			debounce = <0x7d000>;
			interrupt-parent = <0xffffffff>;
			interrupts = <0x2 0x8 0x2 0x0>;
			status = "okay";
		};
	};

	fragment@34 {
		target = <0xffffffff>;

		__overlay__ {
			interrupt-parent = <0xffffffff>;
			interrupts = <0x3 0x2 0x3 0x0>;
			status = "okay";
		};
	};

	fragment@35 {
		target = <0xffffffff>;

		__overlay__ {
			interrupt-parent = <0xffffffff>;
			interrupts = <0x7 0x8 0x7 0x0>;
			status = "okay";
		};
	};

	fragment@36 {
		target = <0xffffffff>;

		__overlay__ {
			deb-gpios = <0xffffffff 0x9 0x0>;
			debounce = <0x3e800>;
			interrupt-parent = <0xffffffff>;
			interrupts = <0x9 0x8 0x9 0x0>;
			status = "okay";
		};
	};

	fragment@37 {
		target = <0xffffffff>;

		__overlay__ {
			interrupt-parent = <0xffffffff>;
			interrupts = <0xa 0x4 0xa 0x0>;
			status = "okay";
		};
	};

	fragment@38 {
		target = <0xffffffff>;

		__overlay__ {
			interrupt-parent = <0xffffffff>;
			interrupts = <0xb 0x2 0xb 0x0>;
			status = "okay";
		};
	};

	fragment@39 {
		target = <0xffffffff>;

		__overlay__ {
			deb-gpios = <0xffffffff 0x36 0x0>;
			debounce = <0x7d000>;
			interrupt-parent = <0xffffffff>;
			interrupts = <0x36 0x8 0x36 0x0>;
			status = "okay";
		};
	};

	fragment@4 {
		target = <0xffffffff>;

		__overlay__ {

			ext_buck_vgpu@55 {
				regulator-max-microvolt = <0x13d620>;
				regulator-min-microvolt = <0x493e0>;
				regulator-name = "ext_buck_vgpu";
				vsel_pin = <0x2>;
			};
		};
	};

	fragment@40 {
		target = <0xffffffff>;

		__overlay__ {
			deb-gpios = <0xffffffff 0x4e 0x0>;
			debounce = <0x7d000>;
			interrupt-parent = <0xffffffff>;
			interrupts = <0x4e 0x8 0x4e 0x0>;
			status = "okay";
		};
	};

	fragment@41 {
		target = <0xffffffff>;

		__overlay__ {
			interrupt-parent = <0xffffffff>;
			interrupts = <0x93 0x8 0x29 0x1>;
			status = "okay";
		};
	};

	fragment@42 {
		target = <0xffffffff>;

		__overlay__ {
			compatible = "mediatek,md1_sim1_hot_plug_eint-eint";
			debounce = <0x0 0x2710>;
			dedicated = <0x0 0x0>;
			interrupts = <0x0 0x8>;
			sockettype = <0x0 0x0>;
			src_pin = <0x0 0x1>;
			status = "okay";
		};
	};

	fragment@43 {
		target = <0xffffffff>;

		__overlay__ {
			compatible = "mediatek,md1_sim2_hot_plug_eint-eint";
			debounce = <0x1 0x2710>;
			dedicated = <0x1 0x0>;
			interrupts = <0x1 0x8>;
			sockettype = <0x1 0x0>;
			src_pin = <0x1 0x2>;
			status = "okay";
		};
	};

	fragment@44 {
		target = <0xffffffff>;

		__overlay__ {
			regulator-default-on = <0x1>;
			regulator-name = "vcama";
			status = "okay";
		};
	};

	fragment@45 {
		target = <0xffffffff>;

		__overlay__ {
			regulator-default-on = <0x1>;
			regulator-name = "vsim1";
			status = "okay";
		};
	};

	fragment@46 {
		target = <0xffffffff>;

		__overlay__ {
			regulator-default-on = <0x1>;
			regulator-name = "vsim2";
			status = "okay";
		};
	};

	fragment@47 {
		target = <0xffffffff>;

		__overlay__ {
			regulator-default-on = <0x1>;
			regulator-name = "vcamd";
			status = "okay";
		};
	};

	fragment@48 {
		target = <0xffffffff>;

		__overlay__ {
			regulator-default-on = <0x1>;
			regulator-name = "vcamio";
			status = "okay";
		};
	};

	fragment@49 {
		target = <0xffffffff>;

		__overlay__ {
			regulator-default-on = <0x1>;
			regulator-name = "vldo28";
			status = "okay";
		};
	};

	fragment@5 {
		target = <0xffffffff>;

		__overlay__ {
			pinctrl-0 = <0x1>;
			pinctrl-names = "default";
		};
	};

	fragment@50 {
		target = <0xffffffff>;

		__overlay__ {
			status = "okay";
			vcama-supply = <0xffffffff>;
			vcama_main2-supply = <0xffffffff>;
			vcama_sub-supply = <0xffffffff>;
			vcamaf-supply = <0xffffffff>;
			vcamd-supply = <0xffffffff>;
			vcamd_sub-supply = <0xffffffff>;
			vcamio-supply = <0xffffffff>;
			vcamio_main2-supply = <0xffffffff>;
			vcamio_sub-supply = <0xffffffff>;
		};
	};

	fragment@51 {
		target = <0xffffffff>;

		__overlay__ {
			status = "okay";
			vtouch-supply = <0xffffffff>;
		};
	};

	fragment@52 {
		target = <0xffffffff>;

		__overlay__ {
			mediatek,kpd-hw-dl-key0 = <0x11>;
			mediatek,kpd-hw-dl-key1 = <0x0>;
			mediatek,kpd-hw-dl-key2 = <0x8>;
			mediatek,kpd-hw-factory-key = <0x0>;
			mediatek,kpd-hw-init-map = <0x72 0x0 0x0 0x0 0x0 0x0 0x0 0x0 0x0 0x0 0x0 0x0 0x0 0x0 0x0 0x0 0x0 0x0 0x0 0x0 0x0 0x0 0x0 0x0 0x0 0x0 0x0 0x0 0x0 0x0 0x0 0x0 0x0 0x0 0x0 0x0 0x0 0x0 0x0 0x0 0x0 0x0 0x0 0x0 0x0 0x0 0x0 0x0 0x0 0x0 0x0 0x0 0x0 0x0 0x0 0x0 0x0 0x0 0x0 0x0 0x0 0x0 0x0 0x0 0x0 0x0 0x0 0x0 0x0 0x0 0x0 0x0>;
			mediatek,kpd-hw-map-num = <0x48>;
			mediatek,kpd-hw-pwrkey = <0x8>;
			mediatek,kpd-hw-recovery-key = <0x11>;
			mediatek,kpd-hw-rstkey = <0x11>;
			mediatek,kpd-key-debounce = <0x400>;
			mediatek,kpd-pwkey-gpio-din = <0x0>;
			mediatek,kpd-pwrkey-eint-gpio = <0x0>;
			mediatek,kpd-sw-pwrkey = <0x74>;
			mediatek,kpd-sw-rstkey = <0x73>;
			mediatek,kpd-use-extend-type = <0x0>;
			status = "okay";
		};
	};

	fragment@53 {
		target = <0xffffffff>;

		__overlay__ {

			cam0@0 {
				phandle = <0x13>;

				pins_cmd_dat {
					output-low;
					pinmux = <0x6500>;
					slew-rate = <0x1>;
				};
			};

			cam0@1 {
				phandle = <0x14>;

				pins_cmd_dat {
					output-high;
					pinmux = <0x6500>;
					slew-rate = <0x1>;
				};
			};

			cam0@2 {
				phandle = <0x15>;

				pins_cmd_dat {
					output-low;
					pinmux = <0x6600>;
					slew-rate = <0x1>;
				};
			};

			cam0@3 {
				phandle = <0x16>;

				pins_cmd_dat {
					output-high;
					pinmux = <0x6600>;
					slew-rate = <0x1>;
				};
			};

			cam1@0 {
				phandle = <0x17>;

				pins_cmd_dat {
					output-low;
					pinmux = <0x6600>;
					slew-rate = <0x1>;
				};
			};

			cam1@1 {
				phandle = <0x18>;

				pins_cmd_dat {
					output-high;
					pinmux = <0x6600>;
					slew-rate = <0x1>;
				};
			};

			cam1@2 {
				phandle = <0x19>;

				pins_cmd_dat {
					output-low;
					pinmux = <0x6500>;
					slew-rate = <0x1>;
				};
			};

			cam1@3 {
				phandle = <0x1a>;

				pins_cmd_dat {
					output-high;
					pinmux = <0x6500>;
					slew-rate = <0x1>;
				};
			};

			cam2@0 {
				phandle = <0x1b>;

				pins_cmd_dat {
					output-low;
					pinmux = <0x6d00>;
					slew-rate = <0x1>;
				};
			};

			cam2@1 {
				phandle = <0x1c>;

				pins_cmd_dat {
					output-high;
					pinmux = <0x6d00>;
					slew-rate = <0x1>;
				};
			};

			camdefault {
				phandle = <0x12>;
			};

			camera_pins_cam0_mclk_off {
				phandle = <0x1e>;

				pins_cmd_dat {
					pinmux = <0x6300>;
				};
			};

			camera_pins_cam0_mclk_on {
				phandle = <0x1d>;

				pins_cmd_dat {
					pinmux = <0x6301>;
				};
			};

			camera_pins_cam1_mclk_off {
				phandle = <0x20>;

				pins_cmd_dat {
					pinmux = <0x6400>;
				};
			};

			camera_pins_cam1_mclk_on {
				phandle = <0x1f>;

				pins_cmd_dat {
					pinmux = <0x6401>;
				};
			};

			camera_pins_cam2_mclk_off {
				phandle = <0x22>;

				pins_cmd_dat {
					pinmux = <0x6c00>;
				};
			};

			camera_pins_cam2_mclk_on {
				phandle = <0x21>;

				pins_cmd_dat {
					pinmux = <0x6c01>;
				};
			};

			flashlightdefault {
				phandle = <0x23>;
			};

			flashlightenoutput0 {
				phandle = <0x25>;

				pins_cmd_dat {
					output-low;
					pinmux = <0x9700>;
					slew-rate = <0x1>;
				};
			};

			flashlightenoutput1 {
				phandle = <0x24>;

				pins_cmd_dat {
					output-high;
					pinmux = <0x9700>;
					slew-rate = <0x1>;
				};
			};

			flashlightseloutput0 {
				phandle = <0x27>;

				pins_cmd_dat {
					output-low;
					pinmux = <0x9800>;
					slew-rate = <0x1>;
				};
			};

			flashlightseloutput1 {
				phandle = <0x26>;

				pins_cmd_dat {
					output-high;
					pinmux = <0x9800>;
					slew-rate = <0x1>;
				};
			};
		};
	};

	fragment@54 {
		target = <0xffffffff>;

		__overlay__ {
			cam0_vcama-supply = <0xffffffff>;
			cam0_vcamaf-supply = <0xffffffff>;
			cam0_vcamd-supply = <0xffffffff>;
			cam0_vcamio-supply = <0xffffffff>;
			cam1_vcama-supply = <0xffffffff>;
			cam1_vcamd-supply = <0xffffffff>;
			cam1_vcamio-supply = <0xffffffff>;
			cam2_vcama-supply = <0xffffffff>;
			cam2_vcamio-supply = <0xffffffff>;
			pinctrl-0 = <0x12>;
			pinctrl-1 = <0x13>;
			pinctrl-10 = <0x1c>;
			pinctrl-11 = <0x1d>;
			pinctrl-12 = <0x1e>;
			pinctrl-13 = <0x1f>;
			pinctrl-14 = <0x20>;
			pinctrl-15 = <0x21>;
			pinctrl-16 = <0x22>;
			pinctrl-2 = <0x14>;
			pinctrl-3 = <0x15>;
			pinctrl-4 = <0x16>;
			pinctrl-5 = <0x17>;
			pinctrl-6 = <0x18>;
			pinctrl-7 = <0x19>;
			pinctrl-8 = <0x1a>;
			pinctrl-9 = <0x1b>;
			pinctrl-names = "default", "cam0_rst0", "cam0_rst1", "cam0_pnd0", "cam0_pnd1", "cam1_rst0", "cam1_rst1", "cam1_pnd0", "cam1_pnd1", "cam2_rst0", "cam2_rst1", "cam0_mclk_on", "cam0_mclk_off", "cam1_mclk_on", "cam1_mclk_off", "cam2_mclk_on", "cam2_mclk_off";
			status = "okay";
		};
	};

	fragment@55 {
		target = <0xffffffff>;

		__overlay__ {
			pinctrl-0 = <0x23>;
			pinctrl-1 = <0x24>;
			pinctrl-2 = <0x25>;
			pinctrl-3 = <0x26>;
			pinctrl-4 = <0x27>;
			pinctrl-names = "default", "hw_ch0_high", "hw_ch0_low", "hw_ch1_high", "hw_ch1_low";
			status = "okay";
		};
	};

	fragment@56 {
		target = <0xffffffff>;

		__overlay__ {
			atag,videolfb-lcmname = "nt36525b_vdo_hdp_boe_xinli";
		};
	};

	fragment@57 {
		target = <0xffffffff>;

		__overlay__ {

			dispdefault {
				phandle = <0x28>;
			};

			lcd_bias_enn0_gpio {
				phandle = <0x2b>;

				pins_cmd_dat {
					output-low;
					pinmux = <0xad00>;
					slew-rate = <0x1>;
				};
			};

			lcd_bias_enn1_gpio {
				phandle = <0x2c>;

				pins_cmd_dat {
					output-high;
					pinmux = <0xad00>;
					slew-rate = <0x1>;
				};
			};

			lcd_bias_enp0_gpio {
				phandle = <0x29>;

				pins_cmd_dat {
					output-low;
					pinmux = <0xa800>;
					slew-rate = <0x1>;
				};
			};

			lcd_bias_enp1_gpio {
				phandle = <0x2a>;

				pins_cmd_dat {
					output-high;
					pinmux = <0xa800>;
					slew-rate = <0x1>;
				};
			};

			lcd_bl_out0_gpio {
				phandle = <0x2d>;

				pins_cmd_dat {
					output-low;
					pinmux = <0x9a00>;
					slew-rate = <0x1>;
				};
			};

			lcd_bl_out1_gpio {
				phandle = <0x2e>;

				pins_cmd_dat {
					output-high;
					pinmux = <0x9a00>;
					slew-rate = <0x1>;
				};
			};

			lcd_ldo18_out0_gpio {
				phandle = <0x2f>;

				pins_cmd_dat {
					output-low;
					pinmux = <0xb200>;
					slew-rate = <0x1>;
				};
			};

			lcd_ldo18_out1_gpio {
				phandle = <0x30>;

				pins_cmd_dat {
					output-high;
					pinmux = <0xb200>;
					slew-rate = <0x1>;
				};
			};

			lcm_rst_out0_gpio {
				phandle = <0x31>;

				pins_cmd_dat {
					output-low;
					pinmux = <0x2d00>;
					slew-rate = <0x1>;
				};
			};

			lcm_rst_out1_gpio {
				phandle = <0x32>;

				pins_cmd_dat {
					output-high;
					pinmux = <0x2d00>;
					slew-rate = <0x1>;
				};
			};

			tp_rst_out0_gpio {
				phandle = <0x33>;

				pins_cmd_dat {
					output-low;
					pinmux = <0xae00>;
					slew-rate = <0x1>;
				};
			};

			tp_rst_out1_gpio {
				phandle = <0x34>;

				pins_cmd_dat {
					output-high;
					pinmux = <0xae00>;
					slew-rate = <0x1>;
				};
			};
		};
	};

	fragment@58 {
		target = <0xffffffff>;

		__overlay__ {
			pinctrl-0 = <0x28>;
			pinctrl-1 = <0x29>;
			pinctrl-10 = <0x32>;
			pinctrl-11 = <0x33>;
			pinctrl-12 = <0x34>;
			pinctrl-2 = <0x2a>;
			pinctrl-3 = <0x2b>;
			pinctrl-4 = <0x2c>;
			pinctrl-5 = <0x2d>;
			pinctrl-6 = <0x2e>;
			pinctrl-7 = <0x2f>;
			pinctrl-8 = <0x30>;
			pinctrl-9 = <0x31>;
			pinctrl-names = "dispdefault", "lcd_bias_enp0_gpio", "lcd_bias_enp1_gpio", "lcd_bias_enn0_gpio", "lcd_bias_enn1_gpio", "lcd_bl_out0_gpio", "lcd_bl_out1_gpio", "lcd_ldo18_out0_gpio", "lcd_ldo18_out1_gpio", "lcm_rst_out0_gpio", "lcm_rst_out1_gpio", "tp_rst_out0_gpio", "tp_rst_out1_gpio";
			status = "okay";
		};
	};

	fragment@59 {
		target = <0xffffffff>;

		__overlay__ {

			camera_pins_gc6133c_mclk_off {
				phandle = <0x36>;

				pins_cmd_dat {
					pinmux = <0x6c00>;
				};
			};

			camera_pins_gc6133c_mclk_on {
				phandle = <0x35>;

				pins_cmd_dat {
					pinmux = <0x6c01>;
				};
			};
		};
	};

	fragment@6 {
		target = <0xffffffff>;

		__overlay__ {

			kpdgpiodefault {
				phandle = <0x1>;

				pins_cmd_dat {
					bias-pull-up = <0x66>;
					input-schmitt-enable;
					output-low;
					pinmux = <0x5d01>;
				};
			};
		};
	};

	fragment@60 {
		target = <0xffffffff>;

		__overlay__ {

			camera_pins_bf30a2_mclk_off {
				phandle = <0x38>;

				pins_cmd_dat {
					pinmux = <0x6c00>;
				};
			};

			camera_pins_bf30a2_mclk_on {
				phandle = <0x37>;

				pins_cmd_dat {
					pinmux = <0x6c01>;
				};
			};
		};
	};

	fragment@61 {
		target = <0xffffffff>;

		__overlay__ {

			bf30a2@6e {
				compatible = "byd,bf30a2_yuv";
				pinctrl-0 = <0x37>;
				pinctrl-1 = <0x38>;
				pinctrl-names = "bf30a2_mclk_on", "bf30a2_mclk_off";
				reg = <0x6e>;
				reset-gpio = <0xffffffff 0x6d 0x0>;
				reset-gpio1 = <0xffffffff 0x66 0x0>;
				status = "okay";
				vcama-supply = <0xffffffff>;
				vcamd-supply = <0xffffffff>;
				vcamio-supply = <0xffffffff>;
			};

			gc6133c@40 {
				compatible = "gc,gc6133c_yuv";
				pinctrl-0 = <0x35>;
				pinctrl-1 = <0x36>;
				pinctrl-names = "gc6133c_mclk_on", "gc6133c_mclk_off";
				reg = <0x40>;
				reset-gpio = <0xffffffff 0x6d 0x0>;
				reset-gpio1 = <0xffffffff 0x66 0x0>;
				status = "okay";
				vcama-supply = <0xffffffff>;
				vcamd-supply = <0xffffffff>;
				vcamio-supply = <0xffffffff>;
			};
		};
	};

	fragment@62 {
		target = <0xffffffff>;

		__overlay__ {

			tps65132_driver@7C {
				compatibel = "mediatek,I2C_LCD_BIAS";
				reg = <0x7c>;
			};
		};
	};

	fragment@63 {
		target = <0xffffffff>;

		__overlay__ {
			status = "okay";

			charger1@1A {
				compatible = "sgm,sgm41513_charger";
				reg = <0x1a>;
				sgm,sgm41513,boost-current = <0x4b0>;
				sgm,sgm41513,boost-voltage = <0x141e>;
				sgm,sgm41513,enable_term;
				sgm,sgm41513,precharge-current = <0xb4>;
				sgm,sgm41513,stat-pin-ctrl = <0x3>;
				sgm,sgm41513,termination-current = <0xf0>;
				sgm,sgm41513,usb-ichg = <0x1f4>;
				sgm,sgm41513,usb-ilim = <0x1f4>;
				sgm,sgm41513,usb-vlim = <0x11f8>;
				sgm,sgm41513,usb-vreg = <0x1130>;
				sgm,sgm41513,vac-ovp-threshold = <0x1964>;
			};

			charger@6B {
				compatible = "sc,sc89601a_charger";
				reg = <0x6b>;
				sc,sc89601a,boost-current = <0x4b0>;
				sc,sc89601a,boost-voltage = <0x141e>;
				sc,sc89601a,enable_term;
				sc,sc89601a,precharge-current = <0xb4>;
				sc,sc89601a,stat-pin-ctrl = <0x3>;
				sc,sc89601a,termination-current = <0xf0>;
				sc,sc89601a,usb-ichg = <0x1f4>;
				sc,sc89601a,usb-ilim = <0x1f4>;
				sc,sc89601a,usb-vlim = <0x11f8>;
				sc,sc89601a,usb-vreg = <0x1130>;
				sc,sc89601a,vac-ovp-threshold = <0x1964>;
			};
		};
	};

	fragment@64 {
		target = <0xffffffff>;

		__overlay__ {
			interrupt-parent = <0xffffffff>;
			interrupts = <0x0 0x2 0x0 0x0>;
			pinctrl-0 = <0x39>;
			pinctrl-1 = <0x3a>;
			pinctrl-2 = <0x3b>;
			pinctrl-3 = <0x3c>;
			pinctrl-4 = <0x3d>;
			pinctrl-5 = <0x3e>;
			pinctrl-6 = <0x3f>;
			pinctrl-7 = <0x40>;
			pinctrl-names = "default", "state_eint_as_int", "state_eint_output0", "state_eint_output1", "state_rst_output0", "state_rst_output1", "state_spi_cs_out0", "state_spi_cs_out1";
			status = "okay";
			tpd-filter-custom-prameters = <0x0 0x0 0x0 0x0 0x0 0x0 0x0 0x0 0x0 0x0 0x0 0x0>;
			tpd-filter-custom-speed = <0x0 0x0 0x0>;
			tpd-filter-enable = <0x0>;
			tpd-filter-pixel-density = <0x92>;
			tpd-key-dim-local = <0x5a 0x373 0x64 0x28 0xe6 0x373 0x64 0x28 0x172 0x373 0x64 0x28 0x0 0x0 0x0 0x0>;
			tpd-key-local = <0x8b 0xac 0x9e 0x0>;
			tpd-key-num = <0x3>;
			tpd-max-touch-num = <0xa>;
			tpd-resolution = <0x2cf 0x63f>;
			use-tpd-button = <0x0>;
		};
	};

	fragment@65 {
		target = <0xffffffff>;

		__overlay__ {

			eint0default {
				phandle = <0x39>;
			};

			eint@0 {
				phandle = <0x3a>;

				pins_cmd_dat {
					bias-disable;
					pinmux = <0x0>;
					slew-rate = <0x0>;
				};
			};

			eintoutput0 {
				phandle = <0x3b>;

				pins_cmd_dat {
					output-low;
					pinmux = <0x0>;
					slew-rate = <0x1>;
				};
			};

			eintoutput1 {
				phandle = <0x3c>;

				pins_cmd_dat {
					output-high;
					pinmux = <0x0>;
					slew-rate = <0x1>;
				};
			};

			rstoutput0 {
				phandle = <0x3d>;

				pins_cmd_dat {
					output-low;
					pinmux = <0xae00>;
					slew-rate = <0x1>;
				};
			};

			rstoutput1 {
				phandle = <0x3e>;

				pins_cmd_dat {
					output-high;
					pinmux = <0xae00>;
					slew-rate = <0x1>;
				};
			};

			spi_cs_out0_gpio {
				phandle = <0x3f>;

				pins_cmd_dat {
					output-low;
					pinmux = <0x1600>;
					slew-rate = <0x1>;
				};
			};

			spi_cs_out1_gpio {
				phandle = <0x40>;

				pins_cmd_dat {
					pinmux = <0x1601>;
					slew-rate = <0x1>;
				};
			};
		};
	};

	fragment@66 {
		target = <0xffffffff>;

		__overlay__ {
			#address-cells = <0x1>;
			#size-cells = <0x0>;
			status = "okay";

			fpc_tee@0 {
				compatible = "fpc,fpc_spi";
				fpc,enable-wakeup;
				netlink-event = <0x1f>;
				reg = <0x0>;
				spi-max-frequency = <0x989680>;
				status = "okay";
			};
		};
	};

	fragment@67 {
		target = <0xffffffff>;

		__overlay__ {
			pinctrl-0 = <0x41>;
			pinctrl-1 = <0x42>;
			pinctrl-2 = <0x43>;
			pinctrl-3 = <0x44>;
			pinctrl-4 = <0x45>;
			pinctrl-5 = <0x46>;
			pinctrl-6 = <0x47>;
			pinctrl-7 = <0x48>;
			pinctrl-names = "default", "rst-low", "rst-high", "irq-init", "spi-default", "irq_rst-low", "irq_rst-high", "avdd-enable";
			status = "okay";
		};
	};

	fragment@68 {
		target = <0xffffffff>;

		__overlay__ {

			fp_default {
				phandle = <0x45>;

				pins_cmd2_dat {
					bias-pull-down;
					pinmux = <0x1c01>;
					slew-rate = <0x1>;
				};

				pins_cmd3_dat {
					bias-pull-down;
					pinmux = <0x1901>;
					slew-rate = <0x0>;
				};

				pins_cmd4_dat {
					bias-pull-down;
					pinmux = <0x1b01>;
					slew-rate = <0x1>;
				};

				pins_cmd_dat {
					bias-pull-up;
					pinmux = <0x1a01>;
					slew-rate = <0x1>;
				};
			};
		};
	};

	fragment@69 {
		target = <0xffffffff>;

		__overlay__ {

			fp_eint@3 {
				phandle = <0x44>;

				pins_cmd_dat {
					bias-pull-down = <0x0>;
					pinmux = <0x300>;
					slew-rate = <0x0>;
				};
			};

			silfpdefault {
				phandle = <0x41>;
			};

			state_avdd_high {
				phandle = <0x48>;

				pins_cmd_dat {
					output-high;
					pinmux = <0xa900>;
					slew-rate = <0x1>;
				};
			};

			state_irq_to_reset_high {
				phandle = <0x47>;

				pins_cmd_dat {
					output-high;
					pinmux = <0x300>;
					slew-rate = <0x1>;
				};
			};

			state_irq_to_reset_low {
				phandle = <0x46>;

				pins_cmd_dat {
					output-low;
					pinmux = <0x300>;
					slew-rate = <0x1>;
				};
			};

			state_reset_high {
				phandle = <0x43>;

				pins_cmd_dat {
					output-high;
					pinmux = <0xa700>;
					slew-rate = <0x1>;
				};
			};

			state_reset_low {
				phandle = <0x42>;

				pins_cmd_dat {
					output-low;
					pinmux = <0xa700>;
					slew-rate = <0x1>;
				};
			};
		};
	};

	fragment@7 {
		target = <0xffffffff>;

		__overlay__ {
			accdet-mic-mode = <0x1>;
			accdet-mic-vol = <0x6>;
			accdet-plugout-debounce = <0x1>;
			headset-eint-level-pol = <0x8>;
			headset-four-key-threshold = <0x0 0x3a 0x79 0xc0 0x190>;
			headset-mode-setting = <0x500 0x500 0x1 0x1f0 0x800 0x800 0x20 0x44>;
			headset-three-key-threshold = <0x0 0x50 0xdc 0x190>;
			headset-three-key-threshold-CDD = <0x0 0x79 0xc0 0x258>;
			pinctrl-0 = <0x2>;
			pinctrl-1 = <0x3>;
			pinctrl-names = "default", "state_eint_as_int";
			status = "okay";
		};
	};

	fragment@70 {
		target = <0xffffffff>;

		__overlay__ {
			pinctrl-0 = <0x49>;
			pinctrl-1 = <0x4a>;
			pinctrl-2 = <0x4b>;
			pinctrl-names = "fpsensor_fpc_rst_low", "fpsensor_fpc_rst_high", "fpsensor_fp_power_high";
			status = "okay";
		};
	};

	fragment@71 {
		target = <0xffffffff>;

		__overlay__ {

			fpsensor_fp_power_high {
				phandle = <0x4b>;

				pins_cmd_dat {
					output-high;
					pinmux = <0xa900>;
					slew-rate = <0x1>;
				};
			};

			fpsensor_fpc_rst_high {
				phandle = <0x4a>;

				pins_cmd_dat {
					output-high;
					pinmux = <0xa700>;
					slew-rate = <0x1>;
				};
			};

			fpsensor_fpc_rst_low {
				phandle = <0x49>;

				pins_cmd_dat {
					output-low;
					pinmux = <0xa700>;
					slew-rate = <0x1>;
				};
			};
		};
	};

	fragment@72 {
		target = <0xffffffff>;

		__overlay__ {

			speaker_amp@34 {
				phandle = <0x63>;
				status = "disabled";
			};
		};
	};

	fragment@73 {
		target = <0xffffffff>;

		__overlay__ {

			aw87xxx_pa@58 {
				compatible = "awinic,aw87xxx_pa";
				dev_index = <0x0>;
				reg = <0x58>;
				status = "okay";
			};
		};
	};

	fragment@74 {
		target = <0xffffffff>;

		__overlay__ {

			fs15xx@34 {
				compatible = "fs15xx";
				dev_index = <0x0>;
				reg = <0x34>;
				status = "okay";
			};
		};
	};

	fragment@75 {
		target = <0xffffffff>;

		__overlay__ {
			#address-cells = <0x1>;
			#size-cells = <0x0>;
			status = "ok";

			touch@0 {
				chipone,compensate-cap-max = <0x7e>;
				chipone,compensate-cap-min = <0x1>;
				chipone,irq-gpio = <0xffffffff 0x0 0x0>;
				chipone,noise-max = <0x59>;
				chipone,open-min = <0x960>;
				chipone,open-min-ctc = <0xd89>;
				chipone,open-min-holitech = <0xe5a>;
				chipone,rawdata-max = <0xb56>;
				chipone,rawdata-max-ctc = <0xb1e>;
				chipone,rawdata-max-holitech = <0xb11>;
				chipone,rawdata-min = <0x4c6>;
				chipone,rawdata-min-ctc = <0x503>;
				chipone,rawdata-min-holitech = <0x50a>;
				chipone,rst-gpio = <0xffffffff 0xae 0x0>;
				chipone,short-min = <0x73a>;
				chipone,short-min-ctc = <0x320>;
				chipone,short-min-holitech = <0x1f4>;
				chipone,test-compensate-cap;
				chipone,test-int-pin;
				chipone,test-noise;
				chipone,test-noise-frames = <0x10>;
				chipone,test-open;
				chipone,test-rawdata;
				chipone,test-rawdata-frames = <0x1>;
				chipone,test-reset-pin;
				chipone,test-short;
				chipone,touch-charger-detect-enable;
				chipone,touch-charger-detect-psp = "POWER_SUPPLY_PROP_ONLINE";
				chipone,touch-charger-detect-psp-poll-interval = <0x3e8>;
				chipone,touch-charger-detect-psy-name = "mtk_charger_type";
				chipone,touch-charger-detect-type = "notify";
				chipone,touch-earjack-detect-enable;
				chipone,touch-earjack-poll-interval = <0x3e8>;
				chipone,touch-earjack-state-filepath = "/sys/bus/platform/drivers/pmic-codec-accdet/state";
				chipone,x-res = <0x2cf>;
				chipone,y-res = <0x63f>;
				compatible = "novatek,NVT-ts-spi", "chipone-tddi", "focaltech,fts", "mediatek,cap_touch";
				focaltech,display-coords = <0x0 0x0 0x2cf 0x63f>;
				focaltech,irq-gpio = <0xffffffff 0x0 0x2>;
				focaltech,max-touch-number = <0xa>;
				focaltech,reset-gpio = <0xffffffff 0xae 0x1>;
				interrupt-parent = <0xffffffff>;
				interrupts = <0xd 0x2>;
				novatek,irq-gpio = <0xffffffff 0x0 0x2001>;
				novatek,mp-support-dt;
				novatek,reset-gpio = <0xffffffff 0xae 0x0>;
				novatek,spi-rd-fast-addr = <0x3f310>;
				novatek,swrst-n8-addr = <0x3f0fe>;
				reg = <0x0>;
				spi-max-frequency = <0x927c00>;
				status = "ok";

				novatek-mp-criteria-596B@0 {
					#address-cells = <0x1>;
					#size-cells = <0x0>;
					AIN_KEY = <0x0 0x1 0x2 0xff>;
					AIN_X = <0x0 0x1 0x2 0x3 0x4 0x5 0x6 0x7 0x8 0x9 0xa 0xb 0xc 0xd 0xe 0xf 0x10 0x11>;
					AIN_Y = <0x0 0x1 0x2 0x3 0x4 0x5 0x6 0x7 0x8 0x9 0xa 0xb 0xc 0xd 0xe 0xf 0x10 0x11 0x12 0x13 0x14 0x15 0x16 0x17 0x18 0x19 0x1a 0x1b 0x1c 0x1d 0x1e 0x1f>;
					IC_KEY_CFG_SIZE = <0x4>;
					IC_X_CFG_SIZE = <0x12>;
					IC_Y_CFG_SIZE = <0x20>;
					PS_Config_Diff_Test_Frame = <0x32>;
					PS_Config_Lmt_FW_CC_N = <0x27 0x27 0x27 0x27 0x28 0x28 0x28 0x28 0xffff0001 0xffff0001 0x2a 0x2a 0x2a 0x2a 0x29 0x29 0x28 0x28 0x29 0x29 0x29 0x29 0x29 0x29 0x29 0x29 0x2a 0x2b 0x2a 0x2a 0x2a 0x2a 0x2a 0x2a 0x2a 0x2b 0x29 0x28 0x28 0x29 0x29 0x29 0x29 0x29 0x2a 0x2b 0x2a 0x2a 0x2a 0x2a 0x2a 0x2a 0x2a 0x2b 0x29 0x29 0x29 0x29 0x29 0x29 0x29 0x2a 0x2a 0x2c 0x2b 0x2b 0x2b 0x2a 0x2a 0x2a 0x2b 0x2c 0x2a 0x29 0x29 0x29 0x29 0x29 0x29 0x2a 0x2b 0x2c 0x2b 0x2b 0x2b 0x2b 0x2b 0x2b 0x2b 0x2c 0x2a 0x2a 0x2a 0x2a 0x2a 0x2a 0x2a 0x2a 0x2c 0x2c 0x2b 0x2b 0x2b 0x2a 0x2a 0x2a 0x2b 0x2c 0x2a 0x29 0x29 0x29 0x29 0x29 0x29 0x2a 0x2a 0x2d 0x2c 0x2c 0x2c 0x2b 0x2b 0x2a 0x2a 0x2b 0x2c 0x2b 0x2a 0x2b 0x2b 0x2b 0x2b 0x2b 0x2c 0x2f 0x2d 0x2d 0x2d 0x2d 0x2d 0x2c 0x2c 0x2d 0x2a 0x2a 0x2a 0x2a 0x2a 0x2a 0x2a 0x2a 0x2b 0x2c 0x2b 0x2b 0x2b 0x2a 0x2a 0x2a 0x2a 0x2a 0x2c 0x2b 0x2b 0x2b 0x2b 0x2b 0x2b 0x2b 0x2c 0x2e 0x2d 0x2d 0x2d 0x2d 0x2c 0x2c 0x2c 0x2d 0x2a 0x2a 0x2a 0x2a 0x2a 0x2a 0x2a 0x2a 0x2b 0x2d 0x2c 0x2c 0x2c 0x2c 0x2b 0x2b 0x2b 0x2c 0x2b 0x2a 0x2a 0x2a 0x2a 0x2a 0x2a 0x2b 0x2c 0x2f 0x2d 0x2d 0x2d 0x2d 0x2d 0x2d 0x2d 0x2d 0x2a 0x2a 0x2a 0x2a 0x2a 0x2a 0x2a 0x2a 0x2c 0x2d 0x2c 0x2c 0x2c 0x2c 0x2c 0x2c 0x2c 0x2c 0x2c 0x2b 0x2b 0x2b 0x2b 0x2b 0x2c 0x2c 0x2c 0x2f 0x2f 0x2f 0x2e 0x2e 0x2e 0x2d 0x2d 0x2e 0x2a 0x2a 0x2a 0x2a 0x2a 0x2a 0x2a 0x2a 0x2b 0x2d 0x2c 0x2c 0x2c 0x2c 0x2c 0x2c 0x2c 0x2c 0x2c 0x2c 0x2c 0x2c 0x2c 0x2c 0x2c 0x2c 0x2d 0x2f 0x2e 0x2e 0x2e 0x2d 0x2d 0x2d 0x2d 0x2d 0x2b 0x2a 0x2a 0x2a 0x2a 0x2a 0x2a 0x2a 0x2c 0x2d 0x2d 0x2d 0x2d 0x2d 0x2c 0x2c 0x2c 0x2d 0x2d 0x2c 0x2c 0x2c 0x2c 0x2c 0x2c 0x2c 0x2d 0x2f 0x2e 0x2e 0x2e 0x2e 0x2e 0x2d 0x2d 0x2e 0x2b 0x2a 0x2a 0x2a 0x2a 0x2a 0x2a 0x2a 0x2c 0x2d 0x2d 0x2d 0x2d 0x2d 0x2d 0x2c 0x2c 0x2d 0x2d 0x2c 0x2c 0x2d 0x2d 0x2d 0x2d 0x2d 0x2e 0x2f 0x2f 0x2f 0x2f 0x2f 0x2f 0x2e 0x2e 0x2f 0x2b 0x2b 0x2a 0x2b 0x2b 0x2b 0x2b 0x2b 0x2c 0x2f 0x2d 0x2d 0x2d 0x2d 0x2d 0x2d 0x2d 0x2d 0x2d 0x2d 0x2d 0x2d 0x2d 0x2d 0x2d 0x2d 0x2e 0x2f 0x2e 0x2e 0x2e 0x2e 0x2e 0x2d 0x2e 0x2f 0x2b 0x2b 0x2a 0x2b 0x2b 0x2b 0x2b 0x2b 0x2c 0x2d 0x2c 0x2c 0x2c 0x2c 0x2c 0x2c 0x2c 0x2d 0x2c 0x2c 0x2c 0x2c 0x2c 0x2c 0x2c 0x2c 0x2d 0x2d 0x2d 0x2d 0x2d 0x2c 0x2c 0x2c 0x2d 0x2d 0x2b 0x2a 0x2a 0x2b 0x2a 0x2a 0x2a 0x2b 0x2c 0x2e 0x2d 0x2d 0x2d 0x2d 0x2d 0x2d 0x2d 0x2d 0x2c 0x2c 0x2c 0x2c 0x2c 0x2c 0x2c 0x2c 0x2d 0x2e 0x2d 0x2d 0x2d 0x2d 0x2d 0x2d 0x2d 0x2e 0x2c 0x2c 0x2b 0x2c 0x2b 0x2b 0x2c 0x2c 0x2d 0x2e 0x2d 0x2d 0x2d 0x2d 0x2d 0x2d 0x2d 0x2e 0x2c 0x2b 0x2b 0x2b 0x2b 0x2b 0x2b 0x2c 0x2c 0x2f 0x2d 0x2d 0x2d 0x2d 0x2d 0x2d 0x2d 0x2f 0x2c 0x2a 0x2a 0x2a 0x2a 0x2a 0x2a 0x2a 0x2c 0x2e 0x2d 0x2d 0x2d 0x2d 0x2d 0x2d 0x2d 0x2e 0x2c 0x2c 0x2c 0x2c 0x2c 0x2c 0x2c 0x2c 0x2d 0x2e 0x2d 0x2d 0x2d 0x2d 0x2d 0x2d 0x2d 0x2e 0x2a 0x2c 0x2b 0x2b 0x2b 0x2b 0x2b 0x2b 0x2c 0x2e 0x2d 0x2d 0x2d 0x2d 0x2d 0x2d 0x2d 0x2b 0x2a 0x2c 0x2c 0x2c 0x2c 0x2b 0x2b 0x2c 0x2d 0x2e 0x2d 0x2d 0x2d 0x2d 0x2d 0x2d 0x2d 0x2c 0x0 0x0 0x0>;
					PS_Config_Lmt_FW_CC_P = <0x56 0x56 0x58 0x58 0x59 0x59 0x5b 0x59 0xffff 0xffff 0x5d 0x5f 0x5d 0x5d 0x5c 0x5c 0x5b 0x5b 0x5c 0x5c 0x5c 0x5c 0x5c 0x5c 0x5c 0x5c 0x5f 0x60 0x5f 0x5f 0x5f 0x5f 0x5f 0x5f 0x5f 0x60 0x5c 0x5b 0x5b 0x5c 0x5c 0x5c 0x5c 0x5c 0x5f 0x60 0x5f 0x5f 0x5f 0x5f 0x5f 0x5f 0x5f 0x60 0x5c 0x5c 0x5c 0x5c 0x5c 0x5c 0x5c 0x5d 0x5f 0x61 0x60 0x60 0x60 0x5f 0x5f 0x5f 0x60 0x61 0x5d 0x5c 0x5c 0x5c 0x5c 0x5c 0x5c 0x5d 0x60 0x63 0x60 0x60 0x60 0x60 0x60 0x60 0x60 0x61 0x5f 0x5d 0x5d 0x5d 0x5f 0x5f 0x5f 0x5f 0x61 0x61 0x60 0x60 0x60 0x5f 0x5f 0x5f 0x60 0x61 0x5d 0x5c 0x5c 0x5c 0x5c 0x5c 0x5c 0x5d 0x5f 0x64 0x61 0x61 0x61 0x60 0x60 0x5f 0x5f 0x60 0x61 0x60 0x5f 0x60 0x60 0x60 0x60 0x60 0x63 0x68 0x66 0x66 0x66 0x66 0x64 0x63 0x63 0x64 0x5f 0x5d 0x5d 0x5d 0x5d 0x5d 0x5d 0x5d 0x60 0x61 0x60 0x60 0x60 0x5f 0x5f 0x5d 0x5f 0x5f 0x61 0x60 0x60 0x60 0x60 0x60 0x60 0x60 0x63 0x67 0x64 0x64 0x64 0x64 0x63 0x63 0x63 0x64 0x5f 0x5d 0x5d 0x5d 0x5d 0x5d 0x5d 0x5d 0x60 0x64 0x61 0x61 0x61 0x61 0x60 0x60 0x60 0x61 0x60 0x5f 0x5f 0x5f 0x5f 0x5f 0x5f 0x60 0x61 0x68 0x66 0x66 0x66 0x66 0x64 0x64 0x64 0x66 0x5f 0x5f 0x5f 0x5f 0x5f 0x5f 0x5f 0x5f 0x61 0x66 0x63 0x63 0x63 0x63 0x63 0x61 0x61 0x63 0x61 0x60 0x60 0x60 0x60 0x60 0x61 0x61 0x63 0x6a 0x68 0x68 0x67 0x67 0x67 0x66 0x66 0x67 0x5f 0x5d 0x5d 0x5d 0x5d 0x5d 0x5d 0x5d 0x60 0x64 0x63 0x63 0x63 0x63 0x61 0x61 0x61 0x63 0x63 0x61 0x61 0x61 0x61 0x61 0x61 0x63 0x64 0x68 0x67 0x67 0x67 0x66 0x66 0x64 0x66 0x66 0x60 0x5f 0x5f 0x5f 0x5f 0x5f 0x5f 0x5f 0x61 0x66 0x64 0x64 0x64 0x64 0x63 0x63 0x63 0x64 0x64 0x63 0x63 0x63 0x63 0x63 0x63 0x63 0x66 0x6a 0x67 0x67 0x67 0x67 0x67 0x66 0x66 0x67 0x60 0x5f 0x5f 0x5f 0x5f 0x5f 0x5f 0x5f 0x61 0x66 0x64 0x64 0x64 0x64 0x64 0x63 0x63 0x64 0x64 0x63 0x63 0x64 0x64 0x64 0x64 0x64 0x67 0x6a 0x68 0x68 0x68 0x68 0x68 0x67 0x67 0x68 0x60 0x60 0x5f 0x60 0x60 0x60 0x60 0x60 0x63 0x68 0x66 0x66 0x66 0x66 0x66 0x64 0x64 0x66 0x66 0x64 0x64 0x64 0x64 0x64 0x64 0x64 0x67 0x68 0x67 0x67 0x67 0x67 0x67 0x66 0x67 0x68 0x60 0x60 0x5f 0x60 0x60 0x60 0x60 0x60 0x63 0x66 0x63 0x63 0x63 0x63 0x63 0x63 0x63 0x64 0x61 0x61 0x61 0x61 0x61 0x61 0x61 0x61 0x64 0x66 0x64 0x64 0x64 0x63 0x63 0x63 0x64 0x66 0x60 0x5f 0x5f 0x60 0x5f 0x5f 0x5f 0x60 0x61 0x67 0x64 0x64 0x64 0x64 0x64 0x64 0x64 0x66 0x63 0x61 0x61 0x61 0x61 0x61 0x61 0x61 0x64 0x67 0x66 0x66 0x66 0x64 0x66 0x66 0x66 0x67 0x63 0x61 0x60 0x61 0x60 0x60 0x61 0x61 0x64 0x67 0x66 0x66 0x66 0x64 0x64 0x64 0x66 0x67 0x61 0x60 0x60 0x60 0x60 0x60 0x60 0x61 0x63 0x68 0x66 0x66 0x66 0x66 0x66 0x66 0x66 0x68 0x61 0x5f 0x5f 0x5f 0x5f 0x5f 0x5f 0x5f 0x61 0x67 0x66 0x66 0x66 0x66 0x66 0x66 0x66 0x67 0x63 0x61 0x61 0x61 0x61 0x61 0x61 0x61 0x64 0x67 0x64 0x64 0x64 0x64 0x64 0x64 0x66 0x67 0x5d 0x61 0x60 0x60 0x60 0x60 0x60 0x60 0x63 0x67 0x64 0x64 0x64 0x64 0x64 0x64 0x66 0x60 0x5d 0x61 0x61 0x61 0x61 0x60 0x60 0x61 0x64 0x67 0x64 0x64 0x64 0x64 0x64 0x64 0x66 0x61 0x13a 0x13a 0x13a>;
					PS_Config_Lmt_FW_Diff_N = <0xffffffce 0xffffffce 0xffffffce 0xffffffce 0xffffffce 0xffffffce 0xffffffce 0xffffffce 0xffff0001 0xffff0001 0xffffffce 0xffffffce 0xffffffce 0xffffffce 0xffffffce 0xffffffce 0xffffffce 0xffffffce 0xffffffce 0xffffffce 0xffffffce 0xffffffce 0xffffffce 0xffffffce 0xffffffce 0xffffffce 0xffffffce 0xffffffce 0xffffffce 0xffffffce 0xffffffce 0xffffffce 0xffffffce 0xffffffce 0xffffffce 0xffffffce 0xffffffce 0xffffffce 0xffffffce 0xffffffce 0xffffffce 0xffffffce 0xffffffce 0xffffffce 0xffffffce 0xffffffce 0xffffffce 0xffffffce 0xffffffce 0xffffffce 0xffffffce 0xffffffce 0xffffffce 0xffffffce 0xffffffce 0xffffffce 0xffffffce 0xffffffce 0xffffffce 0xffffffce 0xffffffce 0xffffffce 0xffffffce 0xffffffce 0xffffffce 0xffffffce 0xffffffce 0xffffffce 0xffffffce 0xffffffce 0xffffffce 0xffffffce 0xffffffce 0xffffffce 0xffffffce 0xffffffce 0xffffffce 0xffffffce 0xffffffce 0xffffffce 0xffffffce 0xffffffce 0xffffffce 0xffffffce 0xffffffce 0xffffffce 0xffffffce 0xffffffce 0xffffffce 0xffffffce 0xffffffce 0xffffffce 0xffffffce 0xffffffce 0xffffffce 0xffffffce 0xffffffce 0xffffffce 0xffffffce 0xffffffce 0xffffffce 0xffffffce 0xffffffce 0xffffffce 0xffffffce 0xffffffce 0xffffffce 0xffffffce 0xffffffce 0xffffffce 0xffffffce 0xffffffce 0xffffffce 0xffffffce 0xffffffce 0xffffffce 0xffffffce 0xffffffce 0xffffffce 0xffffffce 0xffffffce 0xffffffce 0xffffffce 0xffffffce 0xffffffce 0xffffffce 0xffffffce 0xffffffce 0xffffffce 0xffffffce 0xffffffce 0xffffffce 0xffffffce 0xffffffce 0xffffffce 0xffffffce 0xffffffce 0xffffffce 0xffffffce 0xffffffce 0xffffffce 0xffffffce 0xffffffce 0xffffffce 0xffffffce 0xffffffce 0xffffffce 0xffffffce 0xffffffce 0xffffffce 0xffffffce 0xffffffce 0xffffffce 0xffffffce 0xffffffce 0xffffffce 0xffffffce 0xffffffce 0xffffffce 0xffffffce 0xffffffce 0xffffffce 0xffffffce 0xffffffce 0xffffffce 0xffffffce 0xffffffce 0xffffffce 0xffffffce 0xffffffce 0xffffffce 0xffffffce 0xffffffce 0xffffffce 0xffffffce 0xffffffce 0xffffffce 0xffffffce 0xffffffce 0xffffffce 0xffffffce 0xffffffce 0xffffffce 0xffffffce 0xffffffce 0xffffffce 0xffffffce 0xffffffce 0xffffffce 0xffffffce 0xffffffce 0xffffffce 0xffffffce 0xffffffce 0xffffffce 0xffffffce 0xffffffce 0xffffffce 0xffffffce 0xffffffce 0xffffffce 0xffffffce 0xffffffce 0xffffffce 0xffffffce 0xffffffce 0xffffffce 0xffffffce 0xffffffce 0xffffffce 0xffffffce 0xffffffce 0xffffffce 0xffffffce 0xffffffce 0xffffffce 0xffffffce 0xffffffce 0xffffffce 0xffffffce 0xffffffce 0xffffffce 0xffffffce 0xffffffce 0xffffffce 0xffffffce 0xffffffce 0xffffffce 0xffffffce 0xffffffce 0xffffffce 0xffffffce 0xffffffce 0xffffffce 0xffffffce 0xffffffce 0xffffffce 0xffffffce 0xffffffce 0xffffffce 0xffffffce 0xffffffce 0xffffffce 0xffffffce 0xffffffce 0xffffffce 0xffffffce 0xffffffce 0xffffffce 0xffffffce 0xffffffce 0xffffffce 0xffffffce 0xffffffce 0xffffffce 0xffffffce 0xffffffce 0xffffffce 0xffffffce 0xffffffce 0xffffffce 0xffffffce 0xffffffce 0xffffffce 0xffffffce 0xffffffce 0xffffffce 0xffffffce 0xffffffce 0xffffffce 0xffffffce 0xffffffce 0xffffffce 0xffffffce 0xffffffce 0xffffffce 0xffffffce 0xffffffce 0xffffffce 0xffffffce 0xffffffce 0xffffffce 0xffffffce 0xffffffce 0xffffffce 0xffffffce 0xffffffce 0xffffffce 0xffffffce 0xffffffce 0xffffffce 0xffffffce 0xffffffce 0xffffffce 0xffffffce 0xffffffce 0xffffffce 0xffffffce 0xffffffce 0xffffffce 0xffffffce 0xffffffce 0xffffffce 0xffffffce 0xffffffce 0xffffffce 0xffffffce 0xffffffce 0xffffffce 0xffffffce 0xffffffce 0xffffffce 0xffffffce 0xffffffce 0xffffffce 0xffffffce 0xffffffce 0xffffffce 0xffffffce 0xffffffce 0xffffffce 0xffffffce 0xffffffce 0xffffffce 0xffffffce 0xffffffce 0xffffffce 0xffffffce 0xffffffce 0xffffffce 0xffffffce 0xffffffce 0xffffffce 0xffffffce 0xffffffce 0xffffffce 0xffffffce 0xffffffce 0xffffffce 0xffffffce 0xffffffce 0xffffffce 0xffffffce 0xffffffce 0xffffffce 0xffffffce 0xffffffce 0xffffffce 0xffffffce 0xffffffce 0xffffffce 0xffffffce 0xffffffce 0xffffffce 0xffffffce 0xffffffce 0xffffffce 0xffffffce 0xffffffce 0xffffffce 0xffffffce 0xffffffce 0xffffffce 0xffffffce 0xffffffce 0xffffffce 0xffffffce 0xffffffce 0xffffffce 0xffffffce 0xffffffce 0xffffffce 0xffffffce 0xffffffce 0xffffffce 0xffffffce 0xffffffce 0xffffffce 0xffffffce 0xffffffce 0xffffffce 0xffffffce 0xffffffce 0xffffffce 0xffffffce 0xffffffce 0xffffffce 0xffffffce 0xffffffce 0xffffffce 0xffffffce 0xffffffce 0xffffffce 0xffffffce 0xffffffce 0xffffffce 0xffffffce 0xffffffce 0xffffffce 0xffffffce 0xffffffce 0xffffffce 0xffffffce 0xffffffce 0xffffffce 0xffffffce 0xffffffce 0xffffffce 0xffffffce 0xffffffce 0xffffffce 0xffffffce 0xffffffce 0xffffffce 0xffffffce 0xffffffce 0xffffffce 0xffffffce 0xffffffce 0xffffffce 0xffffffce 0xffffffce 0xffffffce 0xffffffce 0xffffffce 0xffffffce 0xffffffce 0xffffffce 0xffffffce 0xffffffce 0xffffffce 0xffffffce 0xffffffce 0xffffffce 0xffffffce 0xffffffce 0xffffffce 0xffffffce 0xffffffce 0xffffffce 0xffffffce 0xffffffce 0xffffffce 0xffffffce 0xffffffce 0xffffffce 0xffffffce 0xffffffce 0xffffffce 0xffffffce 0xffffffce 0xffffffce 0xffffffce 0xffffffce 0xffffffce 0xffffffce 0xffffffce 0xffffffce 0xffffffce 0xffffffce 0xffffffce 0xffffffce 0xffffffce 0xffffffce 0xffffffce 0xffffffce 0xffffffce 0xffffffce 0xffffffce 0xffffffce 0xffffffce 0xffffffce 0xffffffce 0xffffffce 0xffffffce 0xffffffce 0xffffffce 0xffffffce 0xffffffce 0xffffffce 0xffffffce 0xffffffce 0xffffffce 0xffffffce 0xffffffce 0xffffffce 0xffffffce 0xffffffce 0xffffffce 0xffffffce 0xffffffce 0xffffffce 0xffffffce 0xffffffce 0xffffffce 0xffffffce 0xffffffce 0xffffffce 0xffffffce 0xffffffce 0xffffffce 0xffffffce 0xffffffce 0xffffffce 0xffffffce 0xffffffce 0xffffffce 0xffffffce 0xffffffce 0xffffffce 0xffffffce 0xffffffce 0xffffffce 0xffffffce 0xffffffce 0xffffffce 0xffffffce 0xffffffce 0xffffffce 0xffffffce 0xffffffce 0xffffffce 0xffffffce 0xffffffce 0xffffffce 0xffffffce 0xffffffce 0xffffffce 0xffffffce 0xffffffce 0xffffffce 0xffffffce 0xffffffce 0xffffffce 0xffffffce 0xffffffce 0xffffffce 0xffffffce 0xffffffce 0xffffffce 0xffffffce 0xffffffce 0xffffffce 0xffffffce 0xffffffce 0xffffffce 0xffffffce 0xffffffce 0xffffffce 0xffffffce 0xffffffce 0xffffffce 0xffffffce 0xffffffce 0xffffffce 0xffffffce 0xffffffce 0xffffffce 0xffffffce 0xffffffce 0xffffffce 0xffffffce 0xffffffce 0xffffffce 0xffffffce 0xffffffce 0xffffffce 0xffffffce 0xffffffce 0xffffffce 0xffffffce 0xffffffce 0xffffffce 0xffffffce 0xffffffce 0xffffffce 0xffffffb5 0xffffffb5 0xffffffb5>;
					PS_Config_Lmt_FW_Diff_P = <0x32 0x32 0x32 0x32 0x32 0x32 0x32 0x32 0xffff 0xffff 0x32 0x32 0x32 0x32 0x32 0x32 0x32 0x32 0x32 0x32 0x32 0x32 0x32 0x32 0x32 0x32 0x32 0x32 0x32 0x32 0x32 0x32 0x32 0x32 0x32 0x32 0x32 0x32 0x32 0x32 0x32 0x32 0x32 0x32 0x32 0x32 0x32 0x32 0x32 0x32 0x32 0x32 0x32 0x32 0x32 0x32 0x32 0x32 0x32 0x32 0x32 0x32 0x32 0x32 0x32 0x32 0x32 0x32 0x32 0x32 0x32 0x32 0x32 0x32 0x32 0x32 0x32 0x32 0x32 0x32 0x32 0x32 0x32 0x32 0x32 0x32 0x32 0x32 0x32 0x32 0x32 0x32 0x32 0x32 0x32 0x32 0x32 0x32 0x32 0x32 0x32 0x32 0x32 0x32 0x32 0x32 0x32 0x32 0x32 0x32 0x32 0x32 0x32 0x32 0x32 0x32 0x32 0x32 0x32 0x32 0x32 0x32 0x32 0x32 0x32 0x32 0x32 0x32 0x32 0x32 0x32 0x32 0x32 0x32 0x32 0x32 0x32 0x32 0x32 0x32 0x32 0x32 0x32 0x32 0x32 0x32 0x32 0x32 0x32 0x32 0x32 0x32 0x32 0x32 0x32 0x32 0x32 0x32 0x32 0x32 0x32 0x32 0x32 0x32 0x32 0x32 0x32 0x32 0x32 0x32 0x32 0x32 0x32 0x32 0x32 0x32 0x32 0x32 0x32 0x32 0x32 0x32 0x32 0x32 0x32 0x32 0x32 0x32 0x32 0x32 0x32 0x32 0x32 0x32 0x32 0x32 0x32 0x32 0x32 0x32 0x32 0x32 0x32 0x32 0x32 0x32 0x32 0x32 0x32 0x32 0x32 0x32 0x32 0x32 0x32 0x32 0x32 0x32 0x32 0x32 0x32 0x32 0x32 0x32 0x32 0x32 0x32 0x32 0x32 0x32 0x32 0x32 0x32 0x32 0x32 0x32 0x32 0x32 0x32 0x32 0x32 0x32 0x32 0x32 0x32 0x32 0x32 0x32 0x32 0x32 0x32 0x32 0x32 0x32 0x32 0x32 0x32 0x32 0x32 0x32 0x32 0x32 0x32 0x32 0x32 0x32 0x32 0x32 0x32 0x32 0x32 0x32 0x32 0x32 0x32 0x32 0x32 0x32 0x32 0x32 0x32 0x32 0x32 0x32 0x32 0x32 0x32 0x32 0x32 0x32 0x32 0x32 0x32 0x32 0x32 0x32 0x32 0x32 0x32 0x32 0x32 0x32 0x32 0x32 0x32 0x32 0x32 0x32 0x32 0x32 0x32 0x32 0x32 0x32 0x32 0x32 0x32 0x32 0x32 0x32 0x32 0x32 0x32 0x32 0x32 0x32 0x32 0x32 0x32 0x32 0x32 0x32 0x32 0x32 0x32 0x32 0x32 0x32 0x32 0x32 0x32 0x32 0x32 0x32 0x32 0x32 0x32 0x32 0x32 0x32 0x32 0x32 0x32 0x32 0x32 0x32 0x32 0x32 0x32 0x32 0x32 0x32 0x32 0x32 0x32 0x32 0x32 0x32 0x32 0x32 0x32 0x32 0x32 0x32 0x32 0x32 0x32 0x32 0x32 0x32 0x32 0x32 0x32 0x32 0x32 0x32 0x32 0x32 0x32 0x32 0x32 0x32 0x32 0x32 0x32 0x32 0x32 0x32 0x32 0x32 0x32 0x32 0x32 0x32 0x32 0x32 0x32 0x32 0x32 0x32 0x32 0x32 0x32 0x32 0x32 0x32 0x32 0x32 0x32 0x32 0x32 0x32 0x32 0x32 0x32 0x32 0x32 0x32 0x32 0x32 0x32 0x32 0x32 0x32 0x32 0x32 0x32 0x32 0x32 0x32 0x32 0x32 0x32 0x32 0x32 0x32 0x32 0x32 0x32 0x32 0x32 0x32 0x32 0x32 0x32 0x32 0x32 0x32 0x32 0x32 0x32 0x32 0x32 0x32 0x32 0x32 0x32 0x32 0x32 0x32 0x32 0x32 0x32 0x32 0x32 0x32 0x32 0x32 0x32 0x32 0x32 0x32 0x32 0x32 0x32 0x32 0x32 0x32 0x32 0x32 0x32 0x32 0x32 0x32 0x32 0x32 0x32 0x32 0x32 0x32 0x32 0x32 0x32 0x32 0x32 0x32 0x32 0x32 0x32 0x32 0x32 0x32 0x32 0x32 0x32 0x32 0x32 0x32 0x32 0x32 0x32 0x32 0x32 0x32 0x32 0x32 0x32 0x32 0x32 0x32 0x32 0x32 0x32 0x32 0x32 0x32 0x32 0x32 0x32 0x32 0x32 0x32 0x32 0x32 0x32 0x32 0x32 0x32 0x32 0x32 0x32 0x32 0x32 0x32 0x32 0x32 0x32 0x32 0x32 0x32 0x32 0x32 0x32 0x32 0x32 0x32 0x32 0x32 0x32 0x32 0x32 0x32 0x32 0x32 0x32 0x32 0x4b 0x4b 0x4b>;
					PS_Config_Lmt_FW_Rawdata_N = <0x59c 0x58f 0x59b 0x5a3 0x5a8 0x598 0x594 0x595 0xffff0001 0xffff0001 0x59e 0x5b1 0x5aa 0x576 0x586 0x5c1 0x59b 0x59f 0x5af 0x594 0x59d 0x594 0x5a7 0x5a1 0x5a6 0x5ab 0x5a3 0x59a 0x59d 0x5a9 0x5a6 0x59b 0x5a0 0x59b 0x5ac 0x59d 0x59a 0x5a4 0x592 0x586 0x58c 0x585 0x58a 0x598 0x581 0x5a9 0x58f 0x594 0x58f 0x5a7 0x5a0 0x58b 0x5a0 0x598 0x5a0 0x583 0x58c 0x59e 0x59e 0x598 0x5aa 0x5ae 0x59d 0x5a4 0x5a3 0x598 0x595 0x5ba 0x5be 0x5af 0x5ac 0x5a6 0x59e 0x5ad 0x5a4 0x5b5 0x5c1 0x5bc 0x5b2 0x584 0x5ad 0x5a9 0x595 0x59a 0x598 0x59f 0x5a1 0x59e 0x5a8 0x59d 0x59e 0x57f 0x588 0x599 0x5aa 0x59d 0x5b6 0x59e 0x5c2 0x5a4 0x59f 0x592 0x5ad 0x5a7 0x5a6 0x5ac 0x593 0x57d 0x58b 0x5a3 0x59a 0x5a7 0x59f 0x5aa 0x592 0x59b 0x5a7 0x5b3 0x5a9 0x5a6 0x5b9 0x59b 0x579 0x5a4 0x5a9 0x58f 0x59b 0x59c 0x5a4 0x591 0x594 0x595 0x58f 0x596 0x597 0x586 0x5a6 0x598 0x59e 0x585 0x5a7 0x594 0x59f 0x59a 0x5a3 0x59d 0x584 0x5a2 0x592 0x592 0x5a3 0x5ab 0x5a9 0x59e 0x58e 0x58c 0x59b 0x5ab 0x597 0x5b2 0x5c3 0x5ac 0x59f 0x5a8 0x598 0x595 0x598 0x589 0x5aa 0x5bc 0x5a2 0x5ad 0x599 0x59b 0x5a4 0x5ac 0x59e 0x58f 0x588 0x5ac 0x590 0x5a1 0x59c 0x59d 0x5af 0x5b0 0x596 0x5ab 0x5a4 0x592 0x5a5 0x5a4 0x591 0x58a 0x59a 0x5af 0x5bb 0x59d 0x5a7 0x5aa 0x598 0x597 0x58e 0x58c 0x5a9 0x5b0 0x5a0 0x59e 0x58d 0x597 0x599 0x596 0x59d 0x5a2 0x5a4 0x592 0x5bc 0x58c 0x58f 0x598 0x59e 0x59b 0x5a9 0x593 0x5a0 0x5a9 0x595 0x59a 0x59e 0x5a7 0x5a7 0x583 0x58a 0x59f 0x57c 0x5b0 0x5a6 0x5b6 0x5a3 0x5a8 0x59f 0x598 0x5a4 0x5a9 0x57f 0x57f 0x5af 0x5a6 0x592 0x5a4 0x5a0 0x597 0x59d 0x59f 0x5a3 0x5a0 0x5af 0x5a6 0x586 0x594 0x586 0x5ab 0x593 0x594 0x599 0x598 0x598 0x5a7 0x589 0x5ad 0x5a9 0x58b 0x586 0x59c 0x598 0x599 0x59e 0x595 0x5a4 0x58b 0x5b3 0x5b1 0x5b0 0x592 0x589 0x5a4 0x5ac 0x5a0 0x599 0x595 0x599 0x5b8 0x5b5 0x5b8 0x5c8 0x5b0 0x5c2 0x58c 0x5ad 0x5b2 0x5ab 0x595 0x5a0 0x599 0x5a1 0x591 0x588 0x59b 0x5a3 0x59c 0x5a7 0x59e 0x5a7 0x5a4 0x597 0x5a7 0x595 0x595 0x598 0x5c5 0x5b0 0x58a 0x594 0x59e 0x595 0x5a1 0x58e 0x5ad 0x5a0 0x5a5 0x5a6 0x5a7 0x5aa 0x596 0x59e 0x5a1 0x59e 0x583 0x585 0x5a5 0x59e 0x596 0x5ab 0x5ad 0x5a1 0x592 0x59c 0x593 0x5a9 0x591 0x59b 0x59d 0x58d 0x59a 0x597 0x574 0x595 0x598 0x59d 0x59d 0x5a2 0x58f 0x59e 0x58b 0x59d 0x59a 0x592 0x58e 0x593 0x58f 0x58a 0x58a 0x594 0x5a3 0x59c 0x592 0x589 0x5a6 0x59f 0x5a6 0x5a8 0x5a0 0x595 0x594 0x599 0x598 0x592 0x5ad 0x5a1 0x5a0 0x59b 0x5a6 0x59d 0x5b6 0x5b3 0x59d 0x5a7 0x5a1 0x59a 0x583 0x588 0x58f 0x585 0x591 0x589 0x59d 0x572 0x576 0x57a 0x5ad 0x5b2 0x5a7 0x59a 0x59e 0x5a6 0x58a 0x58f 0x587 0x58f 0x589 0x58f 0x593 0x595 0x594 0x5b3 0x5ad 0x5b9 0x5b0 0x5b5 0x5b0 0x5a6 0x59e 0x5c1 0x58e 0x5b2 0x583 0x594 0x5b2 0x59a 0x583 0x5a1 0x5a6 0x595 0x592 0x58f 0x58a 0x592 0x59b 0x592 0x5aa 0x5ab 0x589 0x587 0x591 0x596 0x592 0x59d 0x5a4 0x59a 0x588 0x597 0x59e 0x58d 0x59e 0x597 0x58e 0x5a0 0x598 0x5af 0x5a0 0x5c5 0x5a7 0x5aa 0x5b9 0x5ad 0x5a1 0x5bb 0x5a1 0x596 0x59e 0x59a 0x5b1 0x5b2 0x5ab 0x592 0x598 0x5ac 0x596 0x591 0x590 0x584 0x57e 0x588 0x596 0x591 0x5a4 0x592 0x57f 0x589 0x5a4 0x5a9 0x59b 0x57b 0x596 0x586 0x5c2 0x5a1 0x5a1 0x5a3 0x597 0x59a 0x5af 0x58c 0x5a3 0x5b4 0x5ac 0x5b9 0x5a3 0x5a3 0x5a4 0x57a 0x59e 0x5b3 0x5b8 0x5aa 0x5af 0x5b0 0x5aa 0x5aa 0x5ac 0x590 0x595 0x598 0x5a7 0x59e 0x595 0x59f 0x5a7 0x598 0x5a7 0x597 0x58e 0x59b 0x59c 0x59a 0x59f 0x598 0x596 0x5a6 0x5a4 0x5a9 0x5a5 0x5a8 0x5b1 0x5b4 0x5bf 0x5aa 0x58b 0x5a9 0x59b 0x595 0x592 0x59e 0x59d 0x59a 0x59a 0x5a7 0x598 0x595 0x59a 0x58c 0x5a7 0x58f 0x5a4 0x588 0x59b 0xf0 0xf0 0xf0>;
					PS_Config_Lmt_FW_Rawdata_P = <0xd17 0xcf8 0xd16 0xd27 0xd33 0xd0f 0xd05 0xd06 0xffff 0xffff 0xd1d 0xd48 0xd37 0xcbf 0xce3 0xd6d 0xd14 0xd1e 0xd44 0xd04 0xd1a 0xd05 0xd30 0xd24 0xd2f 0xd3a 0xd27 0xd13 0xd19 0xd35 0xd2f 0xd14 0xd21 0xd14 0xd3c 0xd1a 0xd13 0xd29 0xd01 0xce5 0xcf1 0xce2 0xced 0xd0f 0xcd8 0xd36 0xcf8 0xd04 0xcf8 0xd32 0xd20 0xcf0 0xd20 0xd0f 0xd20 0xcdc 0xcf1 0xd1d 0xd1b 0xd0f 0xd39 0xd41 0xd19 0xd29 0xd27 0xd0d 0xd08 0xd5d 0xd66 0xd44 0xd3d 0xd2e 0xd1d 0xd40 0xd29 0xd52 0xd6d 0xd61 0xd4b 0xcdf 0xd3e 0xd35 0xd08 0xd12 0xd0f 0xd1e 0xd24 0xd1b 0xd33 0xd19 0xd1d 0xcd3 0xce9 0xd10 0xd37 0xd19 0xd55 0xd1d 0xd71 0xd2b 0xd1e 0xd01 0xd3e 0xd32 0xd2e 0xd3d 0xd02 0xcce 0xcf0 0xd28 0xd13 0xd30 0xd1e 0xd39 0xcff 0xd16 0xd32 0xd4e 0xd35 0xd2f 0xd5c 0xd16 0xcc6 0xd29 0xd36 0xcf8 0xd16 0xd17 0xd2b 0xcfe 0xd04 0xd06 0xcfa 0xd09 0xd0c 0xce5 0xd2f 0xd0f 0xd1d 0xce1 0xd30 0xd05 0xd1e 0xd13 0xd28 0xd1a 0xcdf 0xd25 0xcff 0xcff 0xd27 0xd3a 0xd35 0xd1b 0xcf6 0xcf3 0xd16 0xd3a 0xd0b 0xd4b 0xd72 0xd3c 0xd1e 0xd33 0xd0d 0xd08 0xd0d 0xcec 0xd37 0xd61 0xd25 0xd3e 0xd10 0xd16 0xd2b 0xd3c 0xd1d 0xcf8 0xce8 0xd3d 0xcfb 0xd24 0xd17 0xd19 0xd43 0xd45 0xd09 0xd3a 0xd2b 0xcff 0xd2c 0xd2b 0xcfe 0xced 0xd12 0xd44 0xd60 0xd1a 0xd32 0xd37 0xd0d 0xd0b 0xcf7 0xcf1 0xd35 0xd45 0xd21 0xd1b 0xcf4 0xd0c 0xd10 0xd09 0xd19 0xd25 0xd29 0xcff 0xd63 0xcf3 0xcfa 0xd0f 0xd1b 0xd14 0xd35 0xd02 0xd20 0xd36 0xd06 0xd13 0xd1b 0xd30 0xd30 0xcde 0xced 0xd1e 0xccd 0xd47 0xd2e 0xd55 0xd27 0xd33 0xd1e 0xd0f 0xd29 0xd36 0xcd4 0xcd4 0xd44 0xd2e 0xd01 0xd2b 0xd21 0xd0b 0xd1a 0xd1e 0xd27 0xd20 0xd43 0xd2e 0xce5 0xd04 0xce3 0xd3a 0xd02 0xd05 0xd10 0xd0f 0xd0d 0xd32 0xcec 0xd3e 0xd36 0xcef 0xce5 0xd17 0xd0f 0xd10 0xd1d 0xd08 0xd2b 0xcf0 0xd4c 0xd48 0xd47 0xcff 0xcec 0xd2b 0xd3c 0xd20 0xd10 0xd08 0xd10 0xd59 0xd52 0xd58 0xd7d 0xd47 0xd71 0xcf3 0xd3e 0xd4a 0xd3a 0xd08 0xd21 0xd10 0xd22 0xcfd 0xce8 0xd14 0xd27 0xd17 0xd32 0xd1b 0xd30 0xd29 0xd0c 0xd32 0xd06 0xd06 0xd0d 0xd78 0xd47 0xced 0xd04 0xd1b 0xd08 0xd24 0xcf6 0xd3e 0xd20 0xd2c 0xd2f 0xd32 0xd39 0xd09 0xd1d 0xd24 0xd1b 0xcdc 0xce1 0xd2c 0xd1d 0xd09 0xd3a 0xd3e 0xd24 0xcff 0xd17 0xd02 0xd35 0xcfe 0xd16 0xd19 0xcf4 0xd12 0xd0b 0xcbb 0xd06 0xd0f 0xd1a 0xd1a 0xd25 0xcfa 0xd1d 0xcef 0xd1a 0xd12 0xd01 0xcf6 0xd02 0xcf8 0xced 0xced 0xd05 0xd27 0xd17 0xd01 0xcec 0xd2f 0xd1e 0xd2f 0xd33 0xd21 0xd06 0xd04 0xd10 0xd0d 0xcff 0xd40 0xd24 0xd20 0xd16 0xd2f 0xd19 0xd53 0xd4e 0xd19 0xd30 0xd22 0xd13 0xcde 0xce9 0xcfa 0xce2 0xcfe 0xcec 0xd1a 0xcb5 0xcbe 0xcc7 0xd40 0xd4b 0xd32 0xd12 0xd1d 0xd2e 0xced 0xcf8 0xce6 0xcf8 0xcea 0xcf8 0xd02 0xd08 0xd05 0xd4e 0xd40 0xd5a 0xd45 0xd52 0xd45 0xd2f 0xd1b 0xd6e 0xcf7 0xd4b 0xcdc 0xd05 0xd4b 0xd12 0xcdc 0xd24 0xd2e 0xd08 0xcff 0xcf8 0xced 0xd01 0xd16 0xcff 0xd37 0xd3a 0xcec 0xce6 0xcfe 0xd09 0xcff 0xd19 0xd29 0xd12 0xce9 0xd0b 0xd1b 0xcf4 0xd1b 0xd0b 0xcf7 0xd21 0xd0f 0xd44 0xd21 0xd76 0xd30 0xd39 0xd5c 0xd3e 0xd22 0xd5f 0xd24 0xd09 0xd1d 0xd12 0xd48 0xd4b 0xd3a 0xd01 0xd0f 0xd3d 0xd09 0xcfe 0xcfb 0xcdf 0xcd1 0xce8 0xd09 0xcfe 0xd29 0xcff 0xcd4 0xcea 0xd2b 0xd36 0xd14 0xcca 0xd09 0xce5 0xd6f 0xd22 0xd24 0xd28 0xd0b 0xd12 0xd43 0xcf1 0xd27 0xd4f 0xd3c 0xd5c 0xd27 0xd28 0xd2b 0xcc7 0xd1d 0xd4e 0xd59 0xd37 0xd43 0xd45 0xd37 0xd39 0xd3d 0xcfb 0xd08 0xd0f 0xd30 0xd1d 0xd08 0xd1e 0xd32 0xd0d 0xd32 0xd0c 0xcf6 0xd14 0xd17 0xd13 0xd1e 0xd0d 0xd09 0xd2e 0xd2b 0xd35 0xd2c 0xd33 0xd48 0xd4f 0xd6a 0xd37 0xcef 0xd36 0xd14 0xd06 0xcff 0xd1b 0xd1a 0xd12 0xd13 0xd32 0xd0f 0xd08 0xd12 0xcf1 0xd30 0xcf8 0xd2b 0xce8 0xd16 0xf00 0xf00 0xf00>;
					PS_Config_Lmt_Open_Rawdata_N = <0x486 0x494 0x499 0x4b1 0x4c6 0x4ba 0x4bd 0x4e0 0xffff0001 0xffff0001 0x4b7 0x494 0x496 0x4a0 0x4a8 0x4af 0x4ab 0x487 0x42f 0x438 0x44e 0x470 0x493 0x498 0x49c 0x49e 0x48f 0x484 0x495 0x48f 0x490 0x489 0x487 0x483 0x46e 0x451 0x442 0x44e 0x462 0x488 0x4ab 0x4b4 0x4b4 0x4b8 0x4a6 0x489 0x496 0x493 0x490 0x48c 0x489 0x486 0x470 0x455 0x44e 0x456 0x46b 0x48f 0x4b4 0x4bc 0x4bd 0x4c1 0x4ad 0x49d 0x4af 0x4ab 0x4ab 0x4a8 0x4a3 0x4a0 0x48d 0x474 0x458 0x462 0x47b 0x4a2 0x4c8 0x4cf 0x4cf 0x4d1 0x4bc 0x48e 0x49f 0x49c 0x49a 0x497 0x492 0x48f 0x47d 0x463 0x457 0x45f 0x475 0x49b 0x4c4 0x4d2 0x4d2 0x4d7 0x4bf 0x4b4 0x4c8 0x4c5 0x4c3 0x4bf 0x4b8 0x4b5 0x4a4 0x489 0x470 0x485 0x494 0x4a3 0x4b0 0x4b4 0x4c4 0x4c6 0x4c5 0x4fb 0x4f6 0x4f4 0x4e4 0x4d7 0x4ac 0x47d 0x45f 0x43e 0x488 0x49c 0x4ad 0x4bf 0x4c8 0x4d1 0x4d9 0x4dd 0x4d8 0x517 0x512 0x50a 0x4fe 0x4f2 0x4c6 0x496 0x477 0x456 0x48c 0x4a1 0x4b3 0x4c6 0x4cd 0x4d7 0x4db 0x4e1 0x4dc 0x514 0x510 0x508 0x501 0x4f6 0x4cb 0x498 0x47a 0x458 0x4a5 0x4ba 0x4d0 0x4e2 0x4ed 0x4f8 0x501 0x502 0x4fc 0x535 0x531 0x52e 0x525 0x51c 0x4ec 0x4ba 0x49e 0x47a 0x4b6 0x4cb 0x4e2 0x4f3 0x4fc 0x506 0x50e 0x510 0x50f 0x538 0x532 0x52f 0x52a 0x522 0x4f9 0x4c6 0x4a8 0x484 0x4c2 0x4da 0x4f2 0x505 0x510 0x519 0x51a 0x51d 0x51c 0x55c 0x559 0x556 0x554 0x549 0x520 0x4ea 0x4cb 0x4a6 0x4d9 0x4ed 0x514 0x523 0x531 0x537 0x53a 0x53c 0x53e 0x564 0x55c 0x558 0x555 0x54c 0x522 0x4ed 0x4c2 0x49f 0x4e2 0x4f8 0x51d 0x533 0x53b 0x545 0x549 0x54d 0x550 0x57f 0x579 0x573 0x572 0x569 0x545 0x511 0x4e6 0x4bf 0x4ff 0x517 0x53c 0x551 0x55b 0x562 0x567 0x56c 0x56b 0x58c 0x588 0x583 0x57d 0x57b 0x555 0x522 0x4f3 0x4ce 0x519 0x532 0x558 0x573 0x579 0x582 0x582 0x588 0x586 0x5b0 0x5ad 0x5a9 0x5a6 0x5a0 0x580 0x54c 0x51e 0x4f8 0x519 0x52e 0x556 0x56d 0x578 0x580 0x582 0x587 0x586 0x5ad 0x5a9 0x5a4 0x5a1 0x59e 0x57e 0x54c 0x51c 0x4f6 0x536 0x54d 0x574 0x58c 0x596 0x59d 0x59d 0x5a1 0x59d 0x5c1 0x5be 0x5bb 0x5b6 0x5b5 0x597 0x567 0x538 0x513 0x557 0x56b 0x595 0x5a9 0x5b8 0x5bf 0x5c3 0x5c3 0x5c1 0x5d9 0x5dc 0x5da 0x5d9 0x5d1 0x5b8 0x588 0x55c 0x532 0x569 0x57d 0x5a6 0x5bc 0x5c7 0x5d0 0x5d5 0x5da 0x5d6 0x5ef 0x5f2 0x5ee 0x5ee 0x5eb 0x5d6 0x5a3 0x574 0x54a 0x57a 0x58b 0x5b5 0x5d0 0x5da 0x5e3 0x5e5 0x5e6 0x5e2 0x5ed 0x5f2 0x5ee 0x5ee 0x5eb 0x5da 0x5a9 0x57a 0x552 0x592 0x5a2 0x5ce 0x5eb 0x5f1 0x5f9 0x5fd 0x5fe 0x5f5 0x60f 0x613 0x60e 0x60d 0x607 0x5fd 0x5cf 0x5a1 0x57c 0x5b3 0x5c8 0x5ec 0x61b 0x627 0x62f 0x62e 0x631 0x626 0x60e 0x616 0x610 0x612 0x60c 0x60a 0x5e9 0x5bf 0x598 0x5be 0x5d1 0x5f4 0x622 0x631 0x637 0x638 0x63a 0x62e 0x63c 0x646 0x643 0x647 0x644 0x63f 0x625 0x5f6 0x5cd 0x5e7 0x5f7 0x619 0x641 0x652 0x657 0x65a 0x65b 0x652 0x63b 0x640 0x63e 0x63d 0x637 0x632 0x61e 0x5f2 0x5ca 0x5e9 0x5f7 0x619 0x63f 0x650 0x655 0x659 0x659 0x650 0x65d 0x666 0x663 0x660 0x659 0x656 0x642 0x613 0x5ef 0x610 0x61c 0x63d 0x666 0x678 0x67e 0x68b 0x68b 0x684 0x66c 0x670 0x66c 0x660 0x65e 0x659 0x648 0x61f 0x5fc 0x61c 0x626 0x647 0x665 0x678 0x67c 0x688 0x684 0x67b 0x684 0x68b 0x687 0x67d 0x67f 0x67e 0x676 0x650 0x62e 0x631 0x63c 0x659 0x67c 0x690 0x693 0x69e 0x6a2 0x696 0x682 0x68a 0x684 0x67e 0x67f 0x681 0x678 0x654 0x631 0x63e 0x649 0x66a 0x687 0x69d 0x6a3 0x6ac 0x6ae 0x6a3 0x6a5 0x6ae 0x6a9 0x6a3 0x6a5 0x6a3 0x6a3 0x67e 0x65d 0x54f 0x66b 0x687 0x6a0 0x6b4 0x6b5 0x6bd 0x6bf 0x6b5 0x6a6 0x6ae 0x6aa 0x6a5 0x6a7 0x6a8 0x6ab 0x68d 0x54f 0x582 0x657 0x68a 0x69b 0x6a8 0x6a9 0x6b0 0x6b6 0x6bb 0x6bb 0x6bc 0x6b4 0x6af 0x6b3 0x6b8 0x6be 0x68a 0x591 0xfffffe01 0xfffffe01 0xfffffe01>;
					PS_Config_Lmt_Open_Rawdata_P = <0xa8f 0xaaf 0xabc 0xaf4 0xb25 0xb07 0xb0e 0xb60 0xffff 0xffff 0xb00 0xaaf 0xab5 0xacb 0xadf 0xaee 0xae4 0xa90 0x9c3 0x9d9 0xa0b 0xa5b 0xaac 0xab9 0xac1 0xac6 0xaa3 0xa8b 0xab2 0xaa4 0xaa5 0xa96 0xa90 0xa88 0xa56 0xa12 0x9ef 0xa0b 0xa3b 0xa93 0xae6 0xaf9 0xafb 0xb03 0xad9 0xa95 0xab5 0xaac 0xaa7 0xa9c 0xa95 0xa8f 0xa5b 0xa1c 0xa0b 0xa1f 0xa50 0xaa3 0xaf9 0xb0c 0xb0e 0xb18 0xaea 0xac4 0xaee 0xae4 0xae4 0xadf 0xad2 0xacb 0xa9e 0xa64 0xa23 0xa3b 0xa74 0xad1 0xb29 0xb38 0xb38 0xb3e 0xb0c 0xaa1 0xac8 0xac1 0xabd 0xab6 0xaaa 0xaa4 0xa79 0xa3e 0xa20 0xa34 0xa66 0xabf 0xb1f 0xb41 0xb41 0xb4b 0xb13 0xaf9 0xb29 0xb22 0xb1c 0xb14 0xb03 0xafc 0xad5 0xa95 0xa5b 0xa8c 0xaaf 0xad2 0xaf1 0xafb 0xb1f 0xb25 0xb21 0xba0 0xb93 0xb8f 0xb69 0xb4c 0xae7 0xa7a 0xa33 0x9e7 0xa93 0xac3 0xaea 0xb13 0xb29 0xb3e 0xb50 0xb5a 0xb4d 0xbe0 0xbd5 0xbc2 0xba6 0xb8b 0xb23 0xab5 0xa6c 0xa1f 0xa9c 0xace 0xaf8 0xb23 0xb34 0xb4b 0xb56 0xb64 0xb57 0xbd9 0xbd0 0xbbd 0xbad 0xb93 0xb30 0xab9 0xa73 0xa23 0xad6 0xb09 0xb3b 0xb65 0xb80 0xb99 0xbad 0xbb1 0xba3 0xc26 0xc1e 0xc16 0xc01 0xbec 0xb7d 0xb09 0xac6 0xa73 0xafe 0xb30 0xb65 0xb8e 0xba1 0xbb9 0xbcb 0xbd1 0xbce 0xc2d 0xc21 0xc1a 0xc0d 0xbfa 0xb9c 0xb25 0xadf 0xa8b 0xb1b 0xb52 0xb8a 0xbb8 0xbd0 0xbe5 0xbe7 0xbee 0xbec 0xc81 0xc7a 0xc73 0xc6f 0xc56 0xbf5 0xb79 0xb2f 0xad9 0xb50 0xb80 0xbd9 0xbfe 0xc1d 0xc2c 0xc33 0xc37 0xc3d 0xc94 0xc83 0xc78 0xc71 0xc5d 0xbfa 0xb80 0xb1b 0xac8 0xb65 0xb99 0xbf0 0xc22 0xc36 0xc4c 0xc55 0xc5e 0xc65 0xcd4 0xcc5 0xcb7 0xcb5 0xca0 0xc4c 0xbd4 0xb6e 0xb14 0xbaa 0xbe0 0xc37 0xc68 0xc80 0xc91 0xc9c 0xca7 0xca6 0xcf1 0xce8 0xcdc 0xcd0 0xcca 0xc72 0xbfb 0xb8e 0xb37 0xbe5 0xc1f 0xc79 0xcb7 0xcc5 0xcda 0xcdb 0xce8 0xce3 0xd47 0xd3e 0xd35 0xd2f 0xd20 0xcd5 0xc5d 0xbf1 0xb99 0xbe5 0xc16 0xc73 0xca9 0xcc3 0xcd5 0xcda 0xce6 0xce3 0xd3e 0xd35 0xd29 0xd22 0xd1b 0xcd1 0xc5d 0xbec 0xb93 0xc29 0xc60 0xcb9 0xcf1 0xd09 0xd1a 0xd19 0xd22 0xd19 0xd6e 0xd67 0xd5f 0xd55 0xd51 0xd0b 0xc9c 0xc2f 0xbd8 0xc76 0xca6 0xd06 0xd35 0xd58 0xd68 0xd72 0xd72 0xd6d 0xda6 0xdad 0xda7 0xda6 0xd94 0xd59 0xce8 0xc83 0xc21 0xca0 0xcd0 0xd2e 0xd63 0xd7c 0xd90 0xd9c 0xda7 0xd9f 0xdd8 0xde1 0xdd6 0xdd7 0xdcf 0xd9e 0xd28 0xcb9 0xc57 0xcc7 0xcf0 0xd52 0xd91 0xda7 0xdbe 0xdc2 0xdc5 0xdba 0xdd4 0xde1 0xdd6 0xdd7 0xdcf 0xda9 0xd35 0xcc9 0xc6a 0xcff 0xd25 0xd8b 0xdcf 0xddd 0xdf0 0xdf9 0xdfb 0xde8 0xe23 0xe2e 0xe21 0xe20 0xe12 0xdf9 0xd8e 0xd22 0xccd 0xd4e 0xd7d 0xdd1 0xe3f 0xe5b 0xe6e 0xe6b 0xe72 0xe59 0xe21 0xe35 0xe27 0xe2b 0xe1d 0xe17 0xdca 0xd68 0xd0f 0xd67 0xd92 0xde4 0xe4f 0xe74 0xe82 0xe83 0xe87 0xe6d 0xe8d 0xea3 0xe9c 0xea6 0xe9f 0xe94 0xe56 0xde9 0xd8a 0xdc6 0xdeb 0xe3c 0xe98 0xec1 0xecb 0xed2 0xed4 0xebf 0xe8a 0xe95 0xe91 0xe8e 0xe80 0xe75 0xe46 0xddf 0xd83 0xdca 0xdeb 0xe3c 0xe94 0xebb 0xec6 0xed0 0xed0 0xebb 0xeda 0xeef 0xee7 0xee0 0xed0 0xec9 0xe9b 0xe2c 0xdd8 0xe25 0xe41 0xe90 0xeee 0xf18 0xf26 0xf44 0xf44 0xf35 0xefc 0xf07 0xefd 0xee1 0xedb 0xed0 0xea9 0xe48 0xdf7 0xe43 0xe59 0xea6 0xeec 0xf18 0xf21 0xf3d 0xf35 0xf20 0xf35 0xf46 0xf3c 0xf24 0xf2a 0xf26 0xf15 0xebb 0xe6b 0xe72 0xe8d 0xed0 0xf23 0xf50 0xf57 0xf71 0xf7a 0xf5f 0xf2f 0xf43 0xf35 0xf27 0xf2a 0xf2d 0xf18 0xec4 0xe74 0xe91 0xeaa 0xef7 0xf3c 0xf70 0xf7e 0xf93 0xf96 0xf7c 0xf81 0xf97 0xf8a 0xf7c 0xf82 0xf7e 0xf7c 0xf27 0xed9 0xc63 0xefa 0xf3b 0xf75 0xfa4 0xfa8 0xfba 0xfbe 0xfa8 0xf83 0xf96 0xf8d 0xf81 0xf86 0xf89 0xf8f 0xf49 0xc63 0xcdb 0xecc 0xf42 0xf6a 0xf89 0xf8a 0xf9b 0xfa9 0xfb4 0xfb6 0xfb7 0xfa5 0xf9a 0xfa2 0xfad 0xfbd 0xf43 0xcfd 0x1400 0x1400 0x1400>;
					PS_Config_Lmt_PenRingX_FW_Diff_N = <0xfffffbe6 0xfffffbe6 0xfffffbe6 0xfffffbe6 0xfffffbe6 0xfffffbe6 0xfffffbe6 0xfffffbe6 0xfffffbe6 0xfffffbe6 0xfffffbe6 0xfffffbe6 0xfffffbe6 0xfffffbe6 0xfffffbe6 0xfffffbe6 0xfffffbe6 0xfffffbe6 0xfffffbe6 0xfffffbe6 0xfffffbe6 0xfffffbe6 0xfffffbe6 0xfffffbe6 0xfffffbe6 0xfffffbe6 0xfffffbe6 0xfffffbe6 0xfffffbe6 0xfffffbe6 0xfffffbe6 0xfffffbe6 0xfffffbe6 0xfffffbe6 0xfffffbe6 0xfffffbe6 0xfffffbe6 0xfffffbe6 0xfffffbe6 0xfffffbe6 0xfffffbe6 0xfffffbe6 0xfffffbe6 0xfffffbe6 0xfffffbe6 0xfffffbe6 0xfffffbe6 0xfffffbe6 0xfffffbe6 0xfffffbe6 0xfffffbe6 0xfffffbe6 0xfffffbe6 0xfffffbe6 0xfffffbe6 0xfffffbe6 0xfffffbe6 0xfffffbe6 0xfffffbe6 0xfffffbe6 0xfffffbe6 0xfffffbe6 0xfffffbe6 0xfffffbe6 0xfffffbe6 0xfffffbe6 0xfffffbe6 0xfffffbe6 0xfffffbe6 0xfffffbe6 0xfffffbe6 0xfffffbe6 0xfffffbe6 0xfffffbe6 0xfffffbe6 0xfffffbe6 0xfffffbe6 0xfffffbe6 0xfffffbe6 0xfffffbe6 0xfffffbe6 0xfffffbe6 0xfffffbe6 0xfffffbe6 0xfffffbe6 0xfffffbe6 0xfffffbe6 0xfffffbe6 0xfffffbe6 0xfffffbe6 0xfffffbe6 0xfffffbe6 0xfffffbe6 0xfffffbe6 0xfffffbe6 0xfffffbe6 0xfffffbe6 0xfffffbe6 0xfffffbe6 0xfffffbe6 0xfffffbe6 0xfffffbe6 0xfffffbe6 0xfffffbe6 0xfffffbe6 0xfffffbe6 0xfffffbe6 0xfffffbe6 0xfffffbe6 0xfffffbe6 0xfffffbe6 0xfffffbe6 0xfffffbe6 0xfffffbe6 0xfffffbe6 0xfffffbe6 0xfffffbe6 0xfffffbe6 0xfffffbe6 0xfffffbe6 0xfffffbe6 0xfffffbe6 0xfffffbe6 0xfffffbe6 0xfffffbe6 0xfffffbe6 0xfffffbe6 0xfffffbe6 0xfffffbe6 0xfffffbe6 0xfffffbe6 0xfffffbe6 0xfffffbe6 0xfffffbe6 0xfffffbe6 0xfffffbe6 0xfffffbe6 0xfffffbe6 0xfffffbe6 0xfffffbe6 0xfffffbe6 0xfffffbe6 0xfffffbe6 0xfffffbe6 0xfffffbe6 0xfffffbe6 0xfffffbe6 0xfffffbe6 0xfffffbe6 0xfffffbe6 0xfffffbe6 0xfffffbe6 0xfffffbe6 0xfffffbe6 0xfffffbe6 0xfffffbe6 0xfffffbe6 0xfffffbe6 0xfffffbe6 0xfffffbe6 0xfffffbe6 0xfffffbe6 0xfffffbe6 0xfffffbe6 0xfffffbe6 0xfffffbe6 0xfffffbe6 0xfffffbe6 0xfffffbe6 0xfffffbe6 0xfffffbe6 0xfffffbe6 0xfffffbe6 0xfffffbe6 0xfffffbe6 0xfffffbe6 0xfffffbe6 0xfffffbe6 0xfffffbe6 0xfffffbe6 0xfffffbe6 0xfffffbe6 0xfffffbe6 0xfffffbe6 0xfffffbe6 0xfffffbe6 0xfffffbe6 0xfffffbe6 0xfffffbe6 0xfffffbe6 0xfffffbe6 0xfffffbe6>;
					PS_Config_Lmt_PenRingX_FW_Diff_P = <0x41a 0x41a 0x41a 0x41a 0x41a 0x41a 0x41a 0x41a 0x41a 0x41a 0x41a 0x41a 0x41a 0x41a 0x41a 0x41a 0x41a 0x41a 0x41a 0x41a 0x41a 0x41a 0x41a 0x41a 0x41a 0x41a 0x41a 0x41a 0x41a 0x41a 0x41a 0x41a 0x41a 0x41a 0x41a 0x41a 0x41a 0x41a 0x41a 0x41a 0x41a 0x41a 0x41a 0x41a 0x41a 0x41a 0x41a 0x41a 0x41a 0x41a 0x41a 0x41a 0x41a 0x41a 0x41a 0x41a 0x41a 0x41a 0x41a 0x41a 0x41a 0x41a 0x41a 0x41a 0x41a 0x41a 0x41a 0x41a 0x41a 0x41a 0x41a 0x41a 0x41a 0x41a 0x41a 0x41a 0x41a 0x41a 0x41a 0x41a 0x41a 0x41a 0x41a 0x41a 0x41a 0x41a 0x41a 0x41a 0x41a 0x41a 0x41a 0x41a 0x41a 0x41a 0x41a 0x41a 0x41a 0x41a 0x41a 0x41a 0x41a 0x41a 0x41a 0x41a 0x41a 0x41a 0x41a 0x41a 0x41a 0x41a 0x41a 0x41a 0x41a 0x41a 0x41a 0x41a 0x41a 0x41a 0x41a 0x41a 0x41a 0x41a 0x41a 0x41a 0x41a 0x41a 0x41a 0x41a 0x41a 0x41a 0x41a 0x41a 0x41a 0x41a 0x41a 0x41a 0x41a 0x41a 0x41a 0x41a 0x41a 0x41a 0x41a 0x41a 0x41a 0x41a 0x41a 0x41a 0x41a 0x41a 0x41a 0x41a 0x41a 0x41a 0x41a 0x41a 0x41a 0x41a 0x41a 0x41a 0x41a 0x41a 0x41a 0x41a 0x41a 0x41a 0x41a 0x41a 0x41a 0x41a 0x41a 0x41a 0x41a 0x41a 0x41a 0x41a 0x41a 0x41a 0x41a 0x41a 0x41a 0x41a 0x41a 0x41a 0x41a 0x41a 0x41a 0x41a 0x41a 0x41a 0x41a 0x41a>;
					PS_Config_Lmt_PenRingX_FW_Raw_N = <0xfffffbe6 0xfffffbe6 0xfffffbe6 0xfffffbe6 0xfffffbe6 0xfffffbe6 0xfffffbe6 0xfffffbe6 0xfffffbe6 0xfffffbe6 0xfffffbe6 0xfffffbe6 0xfffffbe6 0xfffffbe6 0xfffffbe6 0xfffffbe6 0xfffffbe6 0xfffffbe6 0xfffffbe6 0xfffffbe6 0xfffffbe6 0xfffffbe6 0xfffffbe6 0xfffffbe6 0xfffffbe6 0xfffffbe6 0xfffffbe6 0xfffffbe6 0xfffffbe6 0xfffffbe6 0xfffffbe6 0xfffffbe6 0xfffffbe6 0xfffffbe6 0xfffffbe6 0xfffffbe6 0xfffffbe6 0xfffffbe6 0xfffffbe6 0xfffffbe6 0xfffffbe6 0xfffffbe6 0xfffffbe6 0xfffffbe6 0xfffffbe6 0xfffffbe6 0xfffffbe6 0xfffffbe6 0xfffffbe6 0xfffffbe6 0xfffffbe6 0xfffffbe6 0xfffffbe6 0xfffffbe6 0xfffffbe6 0xfffffbe6 0xfffffbe6 0xfffffbe6 0xfffffbe6 0xfffffbe6 0xfffffbe6 0xfffffbe6 0xfffffbe6 0xfffffbe6 0xfffffbe6 0xfffffbe6 0xfffffbe6 0xfffffbe6 0xfffffbe6 0xfffffbe6 0xfffffbe6 0xfffffbe6 0xfffffbe6 0xfffffbe6 0xfffffbe6 0xfffffbe6 0xfffffbe6 0xfffffbe6 0xfffffbe6 0xfffffbe6 0xfffffbe6 0xfffffbe6 0xfffffbe6 0xfffffbe6 0xfffffbe6 0xfffffbe6 0xfffffbe6 0xfffffbe6 0xfffffbe6 0xfffffbe6 0xfffffbe6 0xfffffbe6 0xfffffbe6 0xfffffbe6 0xfffffbe6 0xfffffbe6 0xfffffbe6 0xfffffbe6 0xfffffbe6 0xfffffbe6 0xfffffbe6 0xfffffbe6 0xfffffbe6 0xfffffbe6 0xfffffbe6 0xfffffbe6 0xfffffbe6 0xfffffbe6 0xfffffbe6 0xfffffbe6 0xfffffbe6 0xfffffbe6 0xfffffbe6 0xfffffbe6 0xfffffbe6 0xfffffbe6 0xfffffbe6 0xfffffbe6 0xfffffbe6 0xfffffbe6 0xfffffbe6 0xfffffbe6 0xfffffbe6 0xfffffbe6 0xfffffbe6 0xfffffbe6 0xfffffbe6 0xfffffbe6 0xfffffbe6 0xfffffbe6 0xfffffbe6 0xfffffbe6 0xfffffbe6 0xfffffbe6 0xfffffbe6 0xfffffbe6 0xfffffbe6 0xfffffbe6 0xfffffbe6 0xfffffbe6 0xfffffbe6 0xfffffbe6 0xfffffbe6 0xfffffbe6 0xfffffbe6 0xfffffbe6 0xfffffbe6 0xfffffbe6 0xfffffbe6 0xfffffbe6 0xfffffbe6 0xfffffbe6 0xfffffbe6 0xfffffbe6 0xfffffbe6 0xfffffbe6 0xfffffbe6 0xfffffbe6 0xfffffbe6 0xfffffbe6 0xfffffbe6 0xfffffbe6 0xfffffbe6 0xfffffbe6 0xfffffbe6 0xfffffbe6 0xfffffbe6 0xfffffbe6 0xfffffbe6 0xfffffbe6 0xfffffbe6 0xfffffbe6 0xfffffbe6 0xfffffbe6 0xfffffbe6 0xfffffbe6 0xfffffbe6 0xfffffbe6 0xfffffbe6 0xfffffbe6 0xfffffbe6 0xfffffbe6 0xfffffbe6 0xfffffbe6 0xfffffbe6 0xfffffbe6 0xfffffbe6 0xfffffbe6 0xfffffbe6 0xfffffbe6 0xfffffbe6 0xfffffbe6>;
					PS_Config_Lmt_PenRingX_FW_Raw_P = <0x41a 0x41a 0x41a 0x41a 0x41a 0x41a 0x41a 0x41a 0x41a 0x41a 0x41a 0x41a 0x41a 0x41a 0x41a 0x41a 0x41a 0x41a 0x41a 0x41a 0x41a 0x41a 0x41a 0x41a 0x41a 0x41a 0x41a 0x41a 0x41a 0x41a 0x41a 0x41a 0x41a 0x41a 0x41a 0x41a 0x41a 0x41a 0x41a 0x41a 0x41a 0x41a 0x41a 0x41a 0x41a 0x41a 0x41a 0x41a 0x41a 0x41a 0x41a 0x41a 0x41a 0x41a 0x41a 0x41a 0x41a 0x41a 0x41a 0x41a 0x41a 0x41a 0x41a 0x41a 0x41a 0x41a 0x41a 0x41a 0x41a 0x41a 0x41a 0x41a 0x41a 0x41a 0x41a 0x41a 0x41a 0x41a 0x41a 0x41a 0x41a 0x41a 0x41a 0x41a 0x41a 0x41a 0x41a 0x41a 0x41a 0x41a 0x41a 0x41a 0x41a 0x41a 0x41a 0x41a 0x41a 0x41a 0x41a 0x41a 0x41a 0x41a 0x41a 0x41a 0x41a 0x41a 0x41a 0x41a 0x41a 0x41a 0x41a 0x41a 0x41a 0x41a 0x41a 0x41a 0x41a 0x41a 0x41a 0x41a 0x41a 0x41a 0x41a 0x41a 0x41a 0x41a 0x41a 0x41a 0x41a 0x41a 0x41a 0x41a 0x41a 0x41a 0x41a 0x41a 0x41a 0x41a 0x41a 0x41a 0x41a 0x41a 0x41a 0x41a 0x41a 0x41a 0x41a 0x41a 0x41a 0x41a 0x41a 0x41a 0x41a 0x41a 0x41a 0x41a 0x41a 0x41a 0x41a 0x41a 0x41a 0x41a 0x41a 0x41a 0x41a 0x41a 0x41a 0x41a 0x41a 0x41a 0x41a 0x41a 0x41a 0x41a 0x41a 0x41a 0x41a 0x41a 0x41a 0x41a 0x41a 0x41a 0x41a 0x41a 0x41a 0x41a 0x41a 0x41a 0x41a 0x41a 0x41a 0x41a>;
					PS_Config_Lmt_PenRingY_FW_Diff_N = <0xfffffbe6 0xfffffbe6 0xfffffbe6 0xfffffbe6 0xfffffbe6 0xfffffbe6 0xfffffbe6 0xfffffbe6 0xfffffbe6 0xfffffbe6 0xfffffbe6 0xfffffbe6 0xfffffbe6 0xfffffbe6 0xfffffbe6 0xfffffbe6 0xfffffbe6 0xfffffbe6 0xfffffbe6 0xfffffbe6 0xfffffbe6 0xfffffbe6 0xfffffbe6 0xfffffbe6 0xfffffbe6 0xfffffbe6 0xfffffbe6 0xfffffbe6 0xfffffbe6 0xfffffbe6 0xfffffbe6 0xfffffbe6 0xfffffbe6 0xfffffbe6 0xfffffbe6 0xfffffbe6 0xfffffbe6 0xfffffbe6 0xfffffbe6 0xfffffbe6 0xfffffbe6 0xfffffbe6 0xfffffbe6 0xfffffbe6 0xfffffbe6 0xfffffbe6 0xfffffbe6 0xfffffbe6 0xfffffbe6 0xfffffbe6 0xfffffbe6 0xfffffbe6 0xfffffbe6 0xfffffbe6 0xfffffbe6 0xfffffbe6 0xfffffbe6 0xfffffbe6 0xfffffbe6 0xfffffbe6 0xfffffbe6 0xfffffbe6 0xfffffbe6 0xfffffbe6 0xfffffbe6 0xfffffbe6 0xfffffbe6 0xfffffbe6 0xfffffbe6 0xfffffbe6 0xfffffbe6 0xfffffbe6 0xfffffbe6 0xfffffbe6 0xfffffbe6 0xfffffbe6 0xfffffbe6 0xfffffbe6 0xfffffbe6 0xfffffbe6 0xfffffbe6 0xfffffbe6 0xfffffbe6 0xfffffbe6 0xfffffbe6 0xfffffbe6 0xfffffbe6 0xfffffbe6 0xfffffbe6 0xfffffbe6 0xfffffbe6 0xfffffbe6 0xfffffbe6 0xfffffbe6 0xfffffbe6 0xfffffbe6 0xfffffbe6 0xfffffbe6 0xfffffbe6 0xfffffbe6 0xfffffbe6 0xfffffbe6 0xfffffbe6 0xfffffbe6 0xfffffbe6 0xfffffbe6 0xfffffbe6 0xfffffbe6 0xfffffbe6 0xfffffbe6 0xfffffbe6 0xfffffbe6 0xfffffbe6 0xfffffbe6 0xfffffbe6 0xfffffbe6 0xfffffbe6 0xfffffbe6 0xfffffbe6 0xfffffbe6 0xfffffbe6 0xfffffbe6 0xfffffbe6 0xfffffbe6 0xfffffbe6 0xfffffbe6 0xfffffbe6 0xfffffbe6 0xfffffbe6 0xfffffbe6 0xfffffbe6 0xfffffbe6 0xfffffbe6 0xfffffbe6 0xfffffbe6 0xfffffbe6 0xfffffbe6 0xfffffbe6 0xfffffbe6 0xfffffbe6 0xfffffbe6 0xfffffbe6 0xfffffbe6 0xfffffbe6 0xfffffbe6 0xfffffbe6 0xfffffbe6 0xfffffbe6 0xfffffbe6 0xfffffbe6 0xfffffbe6 0xfffffbe6 0xfffffbe6 0xfffffbe6 0xfffffbe6 0xfffffbe6 0xfffffbe6 0xfffffbe6 0xfffffbe6 0xfffffbe6 0xfffffbe6 0xfffffbe6 0xfffffbe6 0xfffffbe6 0xfffffbe6 0xfffffbe6 0xfffffbe6 0xfffffbe6 0xfffffbe6 0xfffffbe6 0xfffffbe6 0xfffffbe6 0xfffffbe6 0xfffffbe6 0xfffffbe6 0xfffffbe6 0xfffffbe6 0xfffffbe6 0xfffffbe6 0xfffffbe6 0xfffffbe6 0xfffffbe6 0xfffffbe6 0xfffffbe6 0xfffffbe6 0xfffffbe6 0xfffffbe6 0xfffffbe6 0xfffffbe6 0xfffffbe6 0xfffffbe6 0xfffffbe6 0xfffffbe6 0xfffffbe6 0xfffffbe6 0xfffffbe6 0xfffffbe6 0xfffffbe6 0xfffffbe6 0xfffffbe6>;
					PS_Config_Lmt_PenRingY_FW_Diff_P = <0x41a 0x41a 0x41a 0x41a 0x41a 0x41a 0x41a 0x41a 0x41a 0x41a 0x41a 0x41a 0x41a 0x41a 0x41a 0x41a 0x41a 0x41a 0x41a 0x41a 0x41a 0x41a 0x41a 0x41a 0x41a 0x41a 0x41a 0x41a 0x41a 0x41a 0x41a 0x41a 0x41a 0x41a 0x41a 0x41a 0x41a 0x41a 0x41a 0x41a 0x41a 0x41a 0x41a 0x41a 0x41a 0x41a 0x41a 0x41a 0x41a 0x41a 0x41a 0x41a 0x41a 0x41a 0x41a 0x41a 0x41a 0x41a 0x41a 0x41a 0x41a 0x41a 0x41a 0x41a 0x41a 0x41a 0x41a 0x41a 0x41a 0x41a 0x41a 0x41a 0x41a 0x41a 0x41a 0x41a 0x41a 0x41a 0x41a 0x41a 0x41a 0x41a 0x41a 0x41a 0x41a 0x41a 0x41a 0x41a 0x41a 0x41a 0x41a 0x41a 0x41a 0x41a 0x41a 0x41a 0x41a 0x41a 0x41a 0x41a 0x41a 0x41a 0x41a 0x41a 0x41a 0x41a 0x41a 0x41a 0x41a 0x41a 0x41a 0x41a 0x41a 0x41a 0x41a 0x41a 0x41a 0x41a 0x41a 0x41a 0x41a 0x41a 0x41a 0x41a 0x41a 0x41a 0x41a 0x41a 0x41a 0x41a 0x41a 0x41a 0x41a 0x41a 0x41a 0x41a 0x41a 0x41a 0x41a 0x41a 0x41a 0x41a 0x41a 0x41a 0x41a 0x41a 0x41a 0x41a 0x41a 0x41a 0x41a 0x41a 0x41a 0x41a 0x41a 0x41a 0x41a 0x41a 0x41a 0x41a 0x41a 0x41a 0x41a 0x41a 0x41a 0x41a 0x41a 0x41a 0x41a 0x41a 0x41a 0x41a 0x41a 0x41a 0x41a 0x41a 0x41a 0x41a 0x41a 0x41a 0x41a 0x41a 0x41a 0x41a 0x41a 0x41a 0x41a 0x41a 0x41a 0x41a 0x41a 0x41a 0x41a 0x41a 0x41a 0x41a 0x41a 0x41a 0x41a 0x41a>;
					PS_Config_Lmt_PenRingY_FW_Raw_N = <0xfffffbe6 0xfffffbe6 0xfffffbe6 0xfffffbe6 0xfffffbe6 0xfffffbe6 0xfffffbe6 0xfffffbe6 0xfffffbe6 0xfffffbe6 0xfffffbe6 0xfffffbe6 0xfffffbe6 0xfffffbe6 0xfffffbe6 0xfffffbe6 0xfffffbe6 0xfffffbe6 0xfffffbe6 0xfffffbe6 0xfffffbe6 0xfffffbe6 0xfffffbe6 0xfffffbe6 0xfffffbe6 0xfffffbe6 0xfffffbe6 0xfffffbe6 0xfffffbe6 0xfffffbe6 0xfffffbe6 0xfffffbe6 0xfffffbe6 0xfffffbe6 0xfffffbe6 0xfffffbe6 0xfffffbe6 0xfffffbe6 0xfffffbe6 0xfffffbe6 0xfffffbe6 0xfffffbe6 0xfffffbe6 0xfffffbe6 0xfffffbe6 0xfffffbe6 0xfffffbe6 0xfffffbe6 0xfffffbe6 0xfffffbe6 0xfffffbe6 0xfffffbe6 0xfffffbe6 0xfffffbe6 0xfffffbe6 0xfffffbe6 0xfffffbe6 0xfffffbe6 0xfffffbe6 0xfffffbe6 0xfffffbe6 0xfffffbe6 0xfffffbe6 0xfffffbe6 0xfffffbe6 0xfffffbe6 0xfffffbe6 0xfffffbe6 0xfffffbe6 0xfffffbe6 0xfffffbe6 0xfffffbe6 0xfffffbe6 0xfffffbe6 0xfffffbe6 0xfffffbe6 0xfffffbe6 0xfffffbe6 0xfffffbe6 0xfffffbe6 0xfffffbe6 0xfffffbe6 0xfffffbe6 0xfffffbe6 0xfffffbe6 0xfffffbe6 0xfffffbe6 0xfffffbe6 0xfffffbe6 0xfffffbe6 0xfffffbe6 0xfffffbe6 0xfffffbe6 0xfffffbe6 0xfffffbe6 0xfffffbe6 0xfffffbe6 0xfffffbe6 0xfffffbe6 0xfffffbe6 0xfffffbe6 0xfffffbe6 0xfffffbe6 0xfffffbe6 0xfffffbe6 0xfffffbe6 0xfffffbe6 0xfffffbe6 0xfffffbe6 0xfffffbe6 0xfffffbe6 0xfffffbe6 0xfffffbe6 0xfffffbe6 0xfffffbe6 0xfffffbe6 0xfffffbe6 0xfffffbe6 0xfffffbe6 0xfffffbe6 0xfffffbe6 0xfffffbe6 0xfffffbe6 0xfffffbe6 0xfffffbe6 0xfffffbe6 0xfffffbe6 0xfffffbe6 0xfffffbe6 0xfffffbe6 0xfffffbe6 0xfffffbe6 0xfffffbe6 0xfffffbe6 0xfffffbe6 0xfffffbe6 0xfffffbe6 0xfffffbe6 0xfffffbe6 0xfffffbe6 0xfffffbe6 0xfffffbe6 0xfffffbe6 0xfffffbe6 0xfffffbe6 0xfffffbe6 0xfffffbe6 0xfffffbe6 0xfffffbe6 0xfffffbe6 0xfffffbe6 0xfffffbe6 0xfffffbe6 0xfffffbe6 0xfffffbe6 0xfffffbe6 0xfffffbe6 0xfffffbe6 0xfffffbe6 0xfffffbe6 0xfffffbe6 0xfffffbe6 0xfffffbe6 0xfffffbe6 0xfffffbe6 0xfffffbe6 0xfffffbe6 0xfffffbe6 0xfffffbe6 0xfffffbe6 0xfffffbe6 0xfffffbe6 0xfffffbe6 0xfffffbe6 0xfffffbe6 0xfffffbe6 0xfffffbe6 0xfffffbe6 0xfffffbe6 0xfffffbe6 0xfffffbe6 0xfffffbe6 0xfffffbe6 0xfffffbe6 0xfffffbe6 0xfffffbe6 0xfffffbe6 0xfffffbe6 0xfffffbe6 0xfffffbe6 0xfffffbe6 0xfffffbe6 0xfffffbe6 0xfffffbe6 0xfffffbe6 0xfffffbe6 0xfffffbe6 0xfffffbe6 0xfffffbe6 0xfffffbe6>;
					PS_Config_Lmt_PenRingY_FW_Raw_P = <0x41a 0x41a 0x41a 0x41a 0x41a 0x41a 0x41a 0x41a 0x41a 0x41a 0x41a 0x41a 0x41a 0x41a 0x41a 0x41a 0x41a 0x41a 0x41a 0x41a 0x41a 0x41a 0x41a 0x41a 0x41a 0x41a 0x41a 0x41a 0x41a 0x41a 0x41a 0x41a 0x41a 0x41a 0x41a 0x41a 0x41a 0x41a 0x41a 0x41a 0x41a 0x41a 0x41a 0x41a 0x41a 0x41a 0x41a 0x41a 0x41a 0x41a 0x41a 0x41a 0x41a 0x41a 0x41a 0x41a 0x41a 0x41a 0x41a 0x41a 0x41a 0x41a 0x41a 0x41a 0x41a 0x41a 0x41a 0x41a 0x41a 0x41a 0x41a 0x41a 0x41a 0x41a 0x41a 0x41a 0x41a 0x41a 0x41a 0x41a 0x41a 0x41a 0x41a 0x41a 0x41a 0x41a 0x41a 0x41a 0x41a 0x41a 0x41a 0x41a 0x41a 0x41a 0x41a 0x41a 0x41a 0x41a 0x41a 0x41a 0x41a 0x41a 0x41a 0x41a 0x41a 0x41a 0x41a 0x41a 0x41a 0x41a 0x41a 0x41a 0x41a 0x41a 0x41a 0x41a 0x41a 0x41a 0x41a 0x41a 0x41a 0x41a 0x41a 0x41a 0x41a 0x41a 0x41a 0x41a 0x41a 0x41a 0x41a 0x41a 0x41a 0x41a 0x41a 0x41a 0x41a 0x41a 0x41a 0x41a 0x41a 0x41a 0x41a 0x41a 0x41a 0x41a 0x41a 0x41a 0x41a 0x41a 0x41a 0x41a 0x41a 0x41a 0x41a 0x41a 0x41a 0x41a 0x41a 0x41a 0x41a 0x41a 0x41a 0x41a 0x41a 0x41a 0x41a 0x41a 0x41a 0x41a 0x41a 0x41a 0x41a 0x41a 0x41a 0x41a 0x41a 0x41a 0x41a 0x41a 0x41a 0x41a 0x41a 0x41a 0x41a 0x41a 0x41a 0x41a 0x41a 0x41a 0x41a 0x41a 0x41a 0x41a 0x41a 0x41a 0x41a 0x41a 0x41a 0x41a>;
					PS_Config_Lmt_PenTipX_FW_Diff_N = <0xfffffbe6 0xfffffbe6 0xfffffbe6 0xfffffbe6 0xfffffbe6 0xfffffbe6 0xfffffbe6 0xfffffbe6 0xfffffbe6 0xfffffbe6 0xfffffbe6 0xfffffbe6 0xfffffbe6 0xfffffbe6 0xfffffbe6 0xfffffbe6 0xfffffbe6 0xfffffbe6 0xfffffbe6 0xfffffbe6 0xfffffbe6 0xfffffbe6 0xfffffbe6 0xfffffbe6 0xfffffbe6 0xfffffbe6 0xfffffbe6 0xfffffbe6 0xfffffbe6 0xfffffbe6 0xfffffbe6 0xfffffbe6 0xfffffbe6 0xfffffbe6 0xfffffbe6 0xfffffbe6 0xfffffbe6 0xfffffbe6 0xfffffbe6 0xfffffbe6 0xfffffbe6 0xfffffbe6 0xfffffbe6 0xfffffbe6 0xfffffbe6 0xfffffbe6 0xfffffbe6 0xfffffbe6 0xfffffbe6 0xfffffbe6 0xfffffbe6 0xfffffbe6 0xfffffbe6 0xfffffbe6 0xfffffbe6 0xfffffbe6 0xfffffbe6 0xfffffbe6 0xfffffbe6 0xfffffbe6 0xfffffbe6 0xfffffbe6 0xfffffbe6 0xfffffbe6 0xfffffbe6 0xfffffbe6 0xfffffbe6 0xfffffbe6 0xfffffbe6 0xfffffbe6 0xfffffbe6 0xfffffbe6 0xfffffbe6 0xfffffbe6 0xfffffbe6 0xfffffbe6 0xfffffbe6 0xfffffbe6 0xfffffbe6 0xfffffbe6 0xfffffbe6 0xfffffbe6 0xfffffbe6 0xfffffbe6 0xfffffbe6 0xfffffbe6 0xfffffbe6 0xfffffbe6 0xfffffbe6 0xfffffbe6 0xfffffbe6 0xfffffbe6 0xfffffbe6 0xfffffbe6 0xfffffbe6 0xfffffbe6 0xfffffbe6 0xfffffbe6 0xfffffbe6 0xfffffbe6 0xfffffbe6 0xfffffbe6 0xfffffbe6 0xfffffbe6 0xfffffbe6 0xfffffbe6 0xfffffbe6 0xfffffbe6 0xfffffbe6 0xfffffbe6 0xfffffbe6 0xfffffbe6 0xfffffbe6 0xfffffbe6 0xfffffbe6 0xfffffbe6 0xfffffbe6 0xfffffbe6 0xfffffbe6 0xfffffbe6 0xfffffbe6 0xfffffbe6 0xfffffbe6 0xfffffbe6 0xfffffbe6 0xfffffbe6 0xfffffbe6 0xfffffbe6 0xfffffbe6 0xfffffbe6 0xfffffbe6 0xfffffbe6 0xfffffbe6 0xfffffbe6 0xfffffbe6 0xfffffbe6 0xfffffbe6 0xfffffbe6 0xfffffbe6 0xfffffbe6 0xfffffbe6 0xfffffbe6 0xfffffbe6 0xfffffbe6 0xfffffbe6 0xfffffbe6 0xfffffbe6 0xfffffbe6 0xfffffbe6 0xfffffbe6 0xfffffbe6 0xfffffbe6 0xfffffbe6 0xfffffbe6 0xfffffbe6 0xfffffbe6 0xfffffbe6 0xfffffbe6 0xfffffbe6 0xfffffbe6 0xfffffbe6 0xfffffbe6 0xfffffbe6 0xfffffbe6 0xfffffbe6 0xfffffbe6 0xfffffbe6 0xfffffbe6 0xfffffbe6 0xfffffbe6 0xfffffbe6 0xfffffbe6 0xfffffbe6 0xfffffbe6 0xfffffbe6 0xfffffbe6 0xfffffbe6 0xfffffbe6 0xfffffbe6 0xfffffbe6 0xfffffbe6 0xfffffbe6 0xfffffbe6 0xfffffbe6 0xfffffbe6 0xfffffbe6 0xfffffbe6 0xfffffbe6 0xfffffbe6 0xfffffbe6 0xfffffbe6 0xfffffbe6>;
					PS_Config_Lmt_PenTipX_FW_Diff_P = <0x41a 0x41a 0x41a 0x41a 0x41a 0x41a 0x41a 0x41a 0x41a 0x41a 0x41a 0x41a 0x41a 0x41a 0x41a 0x41a 0x41a 0x41a 0x41a 0x41a 0x41a 0x41a 0x41a 0x41a 0x41a 0x41a 0x41a 0x41a 0x41a 0x41a 0x41a 0x41a 0x41a 0x41a 0x41a 0x41a 0x41a 0x41a 0x41a 0x41a 0x41a 0x41a 0x41a 0x41a 0x41a 0x41a 0x41a 0x41a 0x41a 0x41a 0x41a 0x41a 0x41a 0x41a 0x41a 0x41a 0x41a 0x41a 0x41a 0x41a 0x41a 0x41a 0x41a 0x41a 0x41a 0x41a 0x41a 0x41a 0x41a 0x41a 0x41a 0x41a 0x41a 0x41a 0x41a 0x41a 0x41a 0x41a 0x41a 0x41a 0x41a 0x41a 0x41a 0x41a 0x41a 0x41a 0x41a 0x41a 0x41a 0x41a 0x41a 0x41a 0x41a 0x41a 0x41a 0x41a 0x41a 0x41a 0x41a 0x41a 0x41a 0x41a 0x41a 0x41a 0x41a 0x41a 0x41a 0x41a 0x41a 0x41a 0x41a 0x41a 0x41a 0x41a 0x41a 0x41a 0x41a 0x41a 0x41a 0x41a 0x41a 0x41a 0x41a 0x41a 0x41a 0x41a 0x41a 0x41a 0x41a 0x41a 0x41a 0x41a 0x41a 0x41a 0x41a 0x41a 0x41a 0x41a 0x41a 0x41a 0x41a 0x41a 0x41a 0x41a 0x41a 0x41a 0x41a 0x41a 0x41a 0x41a 0x41a 0x41a 0x41a 0x41a 0x41a 0x41a 0x41a 0x41a 0x41a 0x41a 0x41a 0x41a 0x41a 0x41a 0x41a 0x41a 0x41a 0x41a 0x41a 0x41a 0x41a 0x41a 0x41a 0x41a 0x41a 0x41a 0x41a 0x41a 0x41a 0x41a 0x41a 0x41a 0x41a 0x41a 0x41a 0x41a 0x41a 0x41a 0x41a 0x41a 0x41a 0x41a>;
					PS_Config_Lmt_PenTipX_FW_Raw_N = <0xfffffbe6 0xfffffbe6 0xfffffbe6 0xfffffbe6 0xfffffbe6 0xfffffbe6 0xfffffbe6 0xfffffbe6 0xfffffbe6 0xfffffbe6 0xfffffbe6 0xfffffbe6 0xfffffbe6 0xfffffbe6 0xfffffbe6 0xfffffbe6 0xfffffbe6 0xfffffbe6 0xfffffbe6 0xfffffbe6 0xfffffbe6 0xfffffbe6 0xfffffbe6 0xfffffbe6 0xfffffbe6 0xfffffbe6 0xfffffbe6 0xfffffbe6 0xfffffbe6 0xfffffbe6 0xfffffbe6 0xfffffbe6 0xfffffbe6 0xfffffbe6 0xfffffbe6 0xfffffbe6 0xfffffbe6 0xfffffbe6 0xfffffbe6 0xfffffbe6 0xfffffbe6 0xfffffbe6 0xfffffbe6 0xfffffbe6 0xfffffbe6 0xfffffbe6 0xfffffbe6 0xfffffbe6 0xfffffbe6 0xfffffbe6 0xfffffbe6 0xfffffbe6 0xfffffbe6 0xfffffbe6 0xfffffbe6 0xfffffbe6 0xfffffbe6 0xfffffbe6 0xfffffbe6 0xfffffbe6 0xfffffbe6 0xfffffbe6 0xfffffbe6 0xfffffbe6 0xfffffbe6 0xfffffbe6 0xfffffbe6 0xfffffbe6 0xfffffbe6 0xfffffbe6 0xfffffbe6 0xfffffbe6 0xfffffbe6 0xfffffbe6 0xfffffbe6 0xfffffbe6 0xfffffbe6 0xfffffbe6 0xfffffbe6 0xfffffbe6 0xfffffbe6 0xfffffbe6 0xfffffbe6 0xfffffbe6 0xfffffbe6 0xfffffbe6 0xfffffbe6 0xfffffbe6 0xfffffbe6 0xfffffbe6 0xfffffbe6 0xfffffbe6 0xfffffbe6 0xfffffbe6 0xfffffbe6 0xfffffbe6 0xfffffbe6 0xfffffbe6 0xfffffbe6 0xfffffbe6 0xfffffbe6 0xfffffbe6 0xfffffbe6 0xfffffbe6 0xfffffbe6 0xfffffbe6 0xfffffbe6 0xfffffbe6 0xfffffbe6 0xfffffbe6 0xfffffbe6 0xfffffbe6 0xfffffbe6 0xfffffbe6 0xfffffbe6 0xfffffbe6 0xfffffbe6 0xfffffbe6 0xfffffbe6 0xfffffbe6 0xfffffbe6 0xfffffbe6 0xfffffbe6 0xfffffbe6 0xfffffbe6 0xfffffbe6 0xfffffbe6 0xfffffbe6 0xfffffbe6 0xfffffbe6 0xfffffbe6 0xfffffbe6 0xfffffbe6 0xfffffbe6 0xfffffbe6 0xfffffbe6 0xfffffbe6 0xfffffbe6 0xfffffbe6 0xfffffbe6 0xfffffbe6 0xfffffbe6 0xfffffbe6 0xfffffbe6 0xfffffbe6 0xfffffbe6 0xfffffbe6 0xfffffbe6 0xfffffbe6 0xfffffbe6 0xfffffbe6 0xfffffbe6 0xfffffbe6 0xfffffbe6 0xfffffbe6 0xfffffbe6 0xfffffbe6 0xfffffbe6 0xfffffbe6 0xfffffbe6 0xfffffbe6 0xfffffbe6 0xfffffbe6 0xfffffbe6 0xfffffbe6 0xfffffbe6 0xfffffbe6 0xfffffbe6 0xfffffbe6 0xfffffbe6 0xfffffbe6 0xfffffbe6 0xfffffbe6 0xfffffbe6 0xfffffbe6 0xfffffbe6 0xfffffbe6 0xfffffbe6 0xfffffbe6 0xfffffbe6 0xfffffbe6 0xfffffbe6 0xfffffbe6 0xfffffbe6 0xfffffbe6 0xfffffbe6 0xfffffbe6 0xfffffbe6 0xfffffbe6 0xfffffbe6 0xfffffbe6 0xfffffbe6>;
					PS_Config_Lmt_PenTipX_FW_Raw_P = <0x41a 0x41a 0x41a 0x41a 0x41a 0x41a 0x41a 0x41a 0x41a 0x41a 0x41a 0x41a 0x41a 0x41a 0x41a 0x41a 0x41a 0x41a 0x41a 0x41a 0x41a 0x41a 0x41a 0x41a 0x41a 0x41a 0x41a 0x41a 0x41a 0x41a 0x41a 0x41a 0x41a 0x41a 0x41a 0x41a 0x41a 0x41a 0x41a 0x41a 0x41a 0x41a 0x41a 0x41a 0x41a 0x41a 0x41a 0x41a 0x41a 0x41a 0x41a 0x41a 0x41a 0x41a 0x41a 0x41a 0x41a 0x41a 0x41a 0x41a 0x41a 0x41a 0x41a 0x41a 0x41a 0x41a 0x41a 0x41a 0x41a 0x41a 0x41a 0x41a 0x41a 0x41a 0x41a 0x41a 0x41a 0x41a 0x41a 0x41a 0x41a 0x41a 0x41a 0x41a 0x41a 0x41a 0x41a 0x41a 0x41a 0x41a 0x41a 0x41a 0x41a 0x41a 0x41a 0x41a 0x41a 0x41a 0x41a 0x41a 0x41a 0x41a 0x41a 0x41a 0x41a 0x41a 0x41a 0x41a 0x41a 0x41a 0x41a 0x41a 0x41a 0x41a 0x41a 0x41a 0x41a 0x41a 0x41a 0x41a 0x41a 0x41a 0x41a 0x41a 0x41a 0x41a 0x41a 0x41a 0x41a 0x41a 0x41a 0x41a 0x41a 0x41a 0x41a 0x41a 0x41a 0x41a 0x41a 0x41a 0x41a 0x41a 0x41a 0x41a 0x41a 0x41a 0x41a 0x41a 0x41a 0x41a 0x41a 0x41a 0x41a 0x41a 0x41a 0x41a 0x41a 0x41a 0x41a 0x41a 0x41a 0x41a 0x41a 0x41a 0x41a 0x41a 0x41a 0x41a 0x41a 0x41a 0x41a 0x41a 0x41a 0x41a 0x41a 0x41a 0x41a 0x41a 0x41a 0x41a 0x41a 0x41a 0x41a 0x41a 0x41a 0x41a 0x41a 0x41a 0x41a 0x41a 0x41a 0x41a>;
					PS_Config_Lmt_PenTipY_FW_Diff_N = <0xfffffbe6 0xfffffbe6 0xfffffbe6 0xfffffbe6 0xfffffbe6 0xfffffbe6 0xfffffbe6 0xfffffbe6 0xfffffbe6 0xfffffbe6 0xfffffbe6 0xfffffbe6 0xfffffbe6 0xfffffbe6 0xfffffbe6 0xfffffbe6 0xfffffbe6 0xfffffbe6 0xfffffbe6 0xfffffbe6 0xfffffbe6 0xfffffbe6 0xfffffbe6 0xfffffbe6 0xfffffbe6 0xfffffbe6 0xfffffbe6 0xfffffbe6 0xfffffbe6 0xfffffbe6 0xfffffbe6 0xfffffbe6 0xfffffbe6 0xfffffbe6 0xfffffbe6 0xfffffbe6 0xfffffbe6 0xfffffbe6 0xfffffbe6 0xfffffbe6 0xfffffbe6 0xfffffbe6 0xfffffbe6 0xfffffbe6 0xfffffbe6 0xfffffbe6 0xfffffbe6 0xfffffbe6 0xfffffbe6 0xfffffbe6 0xfffffbe6 0xfffffbe6 0xfffffbe6 0xfffffbe6 0xfffffbe6 0xfffffbe6 0xfffffbe6 0xfffffbe6 0xfffffbe6 0xfffffbe6 0xfffffbe6 0xfffffbe6 0xfffffbe6 0xfffffbe6 0xfffffbe6 0xfffffbe6 0xfffffbe6 0xfffffbe6 0xfffffbe6 0xfffffbe6 0xfffffbe6 0xfffffbe6 0xfffffbe6 0xfffffbe6 0xfffffbe6 0xfffffbe6 0xfffffbe6 0xfffffbe6 0xfffffbe6 0xfffffbe6 0xfffffbe6 0xfffffbe6 0xfffffbe6 0xfffffbe6 0xfffffbe6 0xfffffbe6 0xfffffbe6 0xfffffbe6 0xfffffbe6 0xfffffbe6 0xfffffbe6 0xfffffbe6 0xfffffbe6 0xfffffbe6 0xfffffbe6 0xfffffbe6 0xfffffbe6 0xfffffbe6 0xfffffbe6 0xfffffbe6 0xfffffbe6 0xfffffbe6 0xfffffbe6 0xfffffbe6 0xfffffbe6 0xfffffbe6 0xfffffbe6 0xfffffbe6 0xfffffbe6 0xfffffbe6 0xfffffbe6 0xfffffbe6 0xfffffbe6 0xfffffbe6 0xfffffbe6 0xfffffbe6 0xfffffbe6 0xfffffbe6 0xfffffbe6 0xfffffbe6 0xfffffbe6 0xfffffbe6 0xfffffbe6 0xfffffbe6 0xfffffbe6 0xfffffbe6 0xfffffbe6 0xfffffbe6 0xfffffbe6 0xfffffbe6 0xfffffbe6 0xfffffbe6 0xfffffbe6 0xfffffbe6 0xfffffbe6 0xfffffbe6 0xfffffbe6 0xfffffbe6 0xfffffbe6 0xfffffbe6 0xfffffbe6 0xfffffbe6 0xfffffbe6 0xfffffbe6 0xfffffbe6 0xfffffbe6 0xfffffbe6 0xfffffbe6 0xfffffbe6 0xfffffbe6 0xfffffbe6 0xfffffbe6 0xfffffbe6 0xfffffbe6 0xfffffbe6 0xfffffbe6 0xfffffbe6 0xfffffbe6 0xfffffbe6 0xfffffbe6 0xfffffbe6 0xfffffbe6 0xfffffbe6 0xfffffbe6 0xfffffbe6 0xfffffbe6 0xfffffbe6 0xfffffbe6 0xfffffbe6 0xfffffbe6 0xfffffbe6 0xfffffbe6 0xfffffbe6 0xfffffbe6 0xfffffbe6 0xfffffbe6 0xfffffbe6 0xfffffbe6 0xfffffbe6 0xfffffbe6 0xfffffbe6 0xfffffbe6 0xfffffbe6 0xfffffbe6 0xfffffbe6 0xfffffbe6 0xfffffbe6 0xfffffbe6 0xfffffbe6 0xfffffbe6 0xfffffbe6 0xfffffbe6 0xfffffbe6 0xfffffbe6 0xfffffbe6 0xfffffbe6 0xfffffbe6 0xfffffbe6 0xfffffbe6 0xfffffbe6>;
					PS_Config_Lmt_PenTipY_FW_Diff_P = <0x41a 0x41a 0x41a 0x41a 0x41a 0x41a 0x41a 0x41a 0x41a 0x41a 0x41a 0x41a 0x41a 0x41a 0x41a 0x41a 0x41a 0x41a 0x41a 0x41a 0x41a 0x41a 0x41a 0x41a 0x41a 0x41a 0x41a 0x41a 0x41a 0x41a 0x41a 0x41a 0x41a 0x41a 0x41a 0x41a 0x41a 0x41a 0x41a 0x41a 0x41a 0x41a 0x41a 0x41a 0x41a 0x41a 0x41a 0x41a 0x41a 0x41a 0x41a 0x41a 0x41a 0x41a 0x41a 0x41a 0x41a 0x41a 0x41a 0x41a 0x41a 0x41a 0x41a 0x41a 0x41a 0x41a 0x41a 0x41a 0x41a 0x41a 0x41a 0x41a 0x41a 0x41a 0x41a 0x41a 0x41a 0x41a 0x41a 0x41a 0x41a 0x41a 0x41a 0x41a 0x41a 0x41a 0x41a 0x41a 0x41a 0x41a 0x41a 0x41a 0x41a 0x41a 0x41a 0x41a 0x41a 0x41a 0x41a 0x41a 0x41a 0x41a 0x41a 0x41a 0x41a 0x41a 0x41a 0x41a 0x41a 0x41a 0x41a 0x41a 0x41a 0x41a 0x41a 0x41a 0x41a 0x41a 0x41a 0x41a 0x41a 0x41a 0x41a 0x41a 0x41a 0x41a 0x41a 0x41a 0x41a 0x41a 0x41a 0x41a 0x41a 0x41a 0x41a 0x41a 0x41a 0x41a 0x41a 0x41a 0x41a 0x41a 0x41a 0x41a 0x41a 0x41a 0x41a 0x41a 0x41a 0x41a 0x41a 0x41a 0x41a 0x41a 0x41a 0x41a 0x41a 0x41a 0x41a 0x41a 0x41a 0x41a 0x41a 0x41a 0x41a 0x41a 0x41a 0x41a 0x41a 0x41a 0x41a 0x41a 0x41a 0x41a 0x41a 0x41a 0x41a 0x41a 0x41a 0x41a 0x41a 0x41a 0x41a 0x41a 0x41a 0x41a 0x41a 0x41a 0x41a 0x41a 0x41a 0x41a 0x41a 0x41a 0x41a 0x41a 0x41a 0x41a 0x41a 0x41a>;
					PS_Config_Lmt_PenTipY_FW_Raw_N = <0xfffffbe6 0xfffffbe6 0xfffffbe6 0xfffffbe6 0xfffffbe6 0xfffffbe6 0xfffffbe6 0xfffffbe6 0xfffffbe6 0xfffffbe6 0xfffffbe6 0xfffffbe6 0xfffffbe6 0xfffffbe6 0xfffffbe6 0xfffffbe6 0xfffffbe6 0xfffffbe6 0xfffffbe6 0xfffffbe6 0xfffffbe6 0xfffffbe6 0xfffffbe6 0xfffffbe6 0xfffffbe6 0xfffffbe6 0xfffffbe6 0xfffffbe6 0xfffffbe6 0xfffffbe6 0xfffffbe6 0xfffffbe6 0xfffffbe6 0xfffffbe6 0xfffffbe6 0xfffffbe6 0xfffffbe6 0xfffffbe6 0xfffffbe6 0xfffffbe6 0xfffffbe6 0xfffffbe6 0xfffffbe6 0xfffffbe6 0xfffffbe6 0xfffffbe6 0xfffffbe6 0xfffffbe6 0xfffffbe6 0xfffffbe6 0xfffffbe6 0xfffffbe6 0xfffffbe6 0xfffffbe6 0xfffffbe6 0xfffffbe6 0xfffffbe6 0xfffffbe6 0xfffffbe6 0xfffffbe6 0xfffffbe6 0xfffffbe6 0xfffffbe6 0xfffffbe6 0xfffffbe6 0xfffffbe6 0xfffffbe6 0xfffffbe6 0xfffffbe6 0xfffffbe6 0xfffffbe6 0xfffffbe6 0xfffffbe6 0xfffffbe6 0xfffffbe6 0xfffffbe6 0xfffffbe6 0xfffffbe6 0xfffffbe6 0xfffffbe6 0xfffffbe6 0xfffffbe6 0xfffffbe6 0xfffffbe6 0xfffffbe6 0xfffffbe6 0xfffffbe6 0xfffffbe6 0xfffffbe6 0xfffffbe6 0xfffffbe6 0xfffffbe6 0xfffffbe6 0xfffffbe6 0xfffffbe6 0xfffffbe6 0xfffffbe6 0xfffffbe6 0xfffffbe6 0xfffffbe6 0xfffffbe6 0xfffffbe6 0xfffffbe6 0xfffffbe6 0xfffffbe6 0xfffffbe6 0xfffffbe6 0xfffffbe6 0xfffffbe6 0xfffffbe6 0xfffffbe6 0xfffffbe6 0xfffffbe6 0xfffffbe6 0xfffffbe6 0xfffffbe6 0xfffffbe6 0xfffffbe6 0xfffffbe6 0xfffffbe6 0xfffffbe6 0xfffffbe6 0xfffffbe6 0xfffffbe6 0xfffffbe6 0xfffffbe6 0xfffffbe6 0xfffffbe6 0xfffffbe6 0xfffffbe6 0xfffffbe6 0xfffffbe6 0xfffffbe6 0xfffffbe6 0xfffffbe6 0xfffffbe6 0xfffffbe6 0xfffffbe6 0xfffffbe6 0xfffffbe6 0xfffffbe6 0xfffffbe6 0xfffffbe6 0xfffffbe6 0xfffffbe6 0xfffffbe6 0xfffffbe6 0xfffffbe6 0xfffffbe6 0xfffffbe6 0xfffffbe6 0xfffffbe6 0xfffffbe6 0xfffffbe6 0xfffffbe6 0xfffffbe6 0xfffffbe6 0xfffffbe6 0xfffffbe6 0xfffffbe6 0xfffffbe6 0xfffffbe6 0xfffffbe6 0xfffffbe6 0xfffffbe6 0xfffffbe6 0xfffffbe6 0xfffffbe6 0xfffffbe6 0xfffffbe6 0xfffffbe6 0xfffffbe6 0xfffffbe6 0xfffffbe6 0xfffffbe6 0xfffffbe6 0xfffffbe6 0xfffffbe6 0xfffffbe6 0xfffffbe6 0xfffffbe6 0xfffffbe6 0xfffffbe6 0xfffffbe6 0xfffffbe6 0xfffffbe6 0xfffffbe6 0xfffffbe6 0xfffffbe6 0xfffffbe6 0xfffffbe6 0xfffffbe6 0xfffffbe6 0xfffffbe6 0xfffffbe6 0xfffffbe6 0xfffffbe6 0xfffffbe6 0xfffffbe6 0xfffffbe6>;
					PS_Config_Lmt_PenTipY_FW_Raw_P = <0x41a 0x41a 0x41a 0x41a 0x41a 0x41a 0x41a 0x41a 0x41a 0x41a 0x41a 0x41a 0x41a 0x41a 0x41a 0x41a 0x41a 0x41a 0x41a 0x41a 0x41a 0x41a 0x41a 0x41a 0x41a 0x41a 0x41a 0x41a 0x41a 0x41a 0x41a 0x41a 0x41a 0x41a 0x41a 0x41a 0x41a 0x41a 0x41a 0x41a 0x41a 0x41a 0x41a 0x41a 0x41a 0x41a 0x41a 0x41a 0x41a 0x41a 0x41a 0x41a 0x41a 0x41a 0x41a 0x41a 0x41a 0x41a 0x41a 0x41a 0x41a 0x41a 0x41a 0x41a 0x41a 0x41a 0x41a 0x41a 0x41a 0x41a 0x41a 0x41a 0x41a 0x41a 0x41a 0x41a 0x41a 0x41a 0x41a 0x41a 0x41a 0x41a 0x41a 0x41a 0x41a 0x41a 0x41a 0x41a 0x41a 0x41a 0x41a 0x41a 0x41a 0x41a 0x41a 0x41a 0x41a 0x41a 0x41a 0x41a 0x41a 0x41a 0x41a 0x41a 0x41a 0x41a 0x41a 0x41a 0x41a 0x41a 0x41a 0x41a 0x41a 0x41a 0x41a 0x41a 0x41a 0x41a 0x41a 0x41a 0x41a 0x41a 0x41a 0x41a 0x41a 0x41a 0x41a 0x41a 0x41a 0x41a 0x41a 0x41a 0x41a 0x41a 0x41a 0x41a 0x41a 0x41a 0x41a 0x41a 0x41a 0x41a 0x41a 0x41a 0x41a 0x41a 0x41a 0x41a 0x41a 0x41a 0x41a 0x41a 0x41a 0x41a 0x41a 0x41a 0x41a 0x41a 0x41a 0x41a 0x41a 0x41a 0x41a 0x41a 0x41a 0x41a 0x41a 0x41a 0x41a 0x41a 0x41a 0x41a 0x41a 0x41a 0x41a 0x41a 0x41a 0x41a 0x41a 0x41a 0x41a 0x41a 0x41a 0x41a 0x41a 0x41a 0x41a 0x41a 0x41a 0x41a 0x41a 0x41a 0x41a 0x41a 0x41a 0x41a 0x41a 0x41a 0x41a 0x41a>;
					PS_Config_Lmt_Short_Rawdata_N = <0x2c70 0x2c70 0x2c70 0x2c70 0x2c70 0x2c70 0x2c70 0x2c70 0x2c70 0x2c70 0x2c70 0x2c70 0x2c70 0x2c70 0x2c70 0x2c70 0x2c70 0x2c70 0x2c70 0x2c70 0x2c70 0x2c70 0x2c70 0x2c70 0x2c70 0x2c70 0x2c70 0x2c70 0x2c70 0x2c70 0x2c70 0x2c70 0x2c70 0x2c70 0x2c70 0x2c70 0x2c70 0x2c70 0x2c70 0x2c70 0x2c70 0x2c70 0x2c70 0x2c70 0x2c70 0x2c70 0x2c70 0x2c70 0x2c70 0x2c70 0x2c70 0x2c70 0x2c70 0x2c70 0x2c70 0x2c70 0x2c70 0x2c70 0x2c70 0x2c70 0x2c70 0x2c70 0x2c70 0x2c70 0x2c70 0x2c70 0x2c70 0x2c70 0x2c70 0x2c70 0x2c70 0x2c70 0x2c70 0x2c70 0x2c70 0x2c70 0x2c70 0x2c70 0x2c70 0x2c70 0x2c70 0x2c70 0x2c70 0x2c70 0x2c70 0x2c70 0x2c70 0x2c70 0x2c70 0x2c70 0x2c70 0x2c70 0x2c70 0x2c70 0x2c70 0x2c70 0x2c70 0x2c70 0x2c70 0x2c70 0x2c70 0x2c70 0x2c70 0x2c70 0x2c70 0x2c70 0x2c70 0x2c70 0x2c70 0x2c70 0x2c70 0x2c70 0x2c70 0x2c70 0x2c70 0x2c70 0x2c70 0x2c70 0x2c70 0x2c70 0x2c70 0x2c70 0x2c70 0x2c70 0x2c70 0x2c70 0x2c70 0x2c70 0x2c70 0x2c70 0x2c70 0x2c70 0x2c70 0x2c70 0x2c70 0x2c70 0x2c70 0x2c70 0x2c70 0x2c70 0x2c70 0x2c70 0x2c70 0x2c70 0x2c70 0x2c70 0x2c70 0x2c70 0x2c70 0x2c70 0x2c70 0x2c70 0x2c70 0x2c70 0x2c70 0x2c70 0x2c70 0x2c70 0x2c70 0x2c70 0x2c70 0x2c70 0x2c70 0x2c70 0x2c70 0x2c70 0x2c70 0x2c70 0x2c70 0x2c70 0x2c70 0x2c70 0x2c70 0x2c70 0x2c70 0x2c70 0x2c70 0x2c70 0x2c70 0x2c70 0x2c70 0x2c70 0x2c70 0x2c70 0x2c70 0x2c70 0x2c70 0x2c70 0x2c70 0x2c70 0x2c70 0x2c70 0x2c70 0x2c70 0x2c70 0x2c70 0x2c70 0x2c70 0x2c70 0x2c70 0x2c70 0x2c70 0x2c70 0x2c70 0x2c70 0x2c70 0x2c70 0x2c70 0x2c70 0x2c70 0x2c70 0x2c70 0x2c70 0x2c70 0x2c70 0x2c70 0x2c70 0x2c70 0x2c70 0x2c70 0x2c70 0x2c70 0x2c70 0x2c70 0x2c70 0x2c70 0x2c70 0x2c70 0x2c70 0x2c70 0x2c70 0x2c70 0x2c70 0x2c70 0x2c70 0x2c70 0x2c70 0x2c70 0x2c70 0x2c70 0x2c70 0x2c70 0x2c70 0x2c70 0x2c70 0x2c70 0x2c70 0x2c70 0x2c70 0x2c70 0x2c70 0x2c70 0x2c70 0x2c70 0x2c70 0x2c70 0x2c70 0x2c70 0x2c70 0x2c70 0x2c70 0x2c70 0x2c70 0x2c70 0x2c70 0x2c70 0x2c70 0x2c70 0x2c70 0x2c70 0x2c70 0x2c70 0x2c70 0x2c70 0x2c70 0x2c70 0x2c70 0x2c70 0x2c70 0x2c70 0x2c70 0x2c70 0x2c70 0x2c70 0x2c70 0x2c70 0x2c70 0x2c70 0x2c70 0x2c70 0x2c70 0x2c70 0x2c70 0x2c70 0x2c70 0x2c70 0x2c70 0x2c70 0x2c70 0x2c70 0x2c70 0x2c70 0x2c70 0x2c70 0x2c70 0x2c70 0x2c70 0x2c70 0x2c70 0x2c70 0x2c70 0x2c70 0x2c70 0x2c70 0x2c70 0x2c70 0x2c70 0x2c70 0x2c70 0x2c70 0x2c70 0x2c70 0x2c70 0x2c70 0x2c70 0x2c70 0x2c70 0x2c70 0x2c70 0x2c70 0x2c70 0x2c70 0x2c70 0x2c70 0x2c70 0x2c70 0x2c70 0x2c70 0x2c70 0x2c70 0x2c70 0x2c70 0x2c70 0x2c70 0x2c70 0x2c70 0x2c70 0x2c70 0x2c70 0x2c70 0x2c70 0x2c70 0x2c70 0x2c70 0x2c70 0x2c70 0x2c70 0x2c70 0x2c70 0x2c70 0x2c70 0x2c70 0x2c70 0x2c70 0x2c70 0x2c70 0x2c70 0x2c70 0x2c70 0x2c70 0x2c70 0x2c70 0x2c70 0x2c70 0x2c70 0x2c70 0x2c70 0x2c70 0x2c70 0x2c70 0x2c70 0x2c70 0x2c70 0x2c70 0x2c70 0x2c70 0x2c70 0x2c70 0x2c70 0x2c70 0x2c70 0x2c70 0x2c70 0x2c70 0x2c70 0x2c70 0x2c70 0x2c70 0x2c70 0x2c70 0x2c70 0x2c70 0x2c70 0x2c70 0x2c70 0x2c70 0x2c70 0x2c70 0x2c70 0x2c70 0x2c70 0x2c70 0x2c70 0x2c70 0x2c70 0x2c70 0x2c70 0x2c70 0x2c70 0x2c70 0x2c70 0x2c70 0x2c70 0x2c70 0x2c70 0x2c70 0x2c70 0x2c70 0x2c70 0x2c70 0x2c70 0x2c70 0x2c70 0x2c70 0x2c70 0x2c70 0x2c70 0x2c70 0x2c70 0x2c70 0x2c70 0x2c70 0x2c70 0x2c70 0x2c70 0x2c70 0x2c70 0x2c70 0x2c70 0x2c70 0x2c70 0x2c70 0x2c70 0x2c70 0x2c70 0x2c70 0x2c70 0x2c70 0x2c70 0x2c70 0x2c70 0x2c70 0x2c70 0x2c70 0x2c70 0x2c70 0x2c70 0x2c70 0x2c70 0x2c70 0x2c70 0x2c70 0x2c70 0x2c70 0x2c70 0x2c70 0x2c70 0x2c70 0x2c70 0x2c70 0x2c70 0x2c70 0x2c70 0x2c70 0x2c70 0x2c70 0x2c70 0x2c70 0x2c70 0x2c70 0x2c70 0x2c70 0x2c70 0x2c70 0x2c70 0x2c70 0x2c70 0x2c70 0x2c70 0x2c70 0x2c70 0x2c70 0x2c70 0x2c70 0x2c70 0x2c70 0x2c70 0x2c70 0x2c70 0x2c70 0x2c70 0x2c70 0x2c70 0x2c70 0x2c70 0x2c70 0x2c70 0x2c70 0x2c70 0x2c70 0x2c70 0x2c70 0x2c70 0x2c70 0x2c70 0x2c70 0x2c70 0x2c70 0x2c70 0x2c70 0x2c70 0x2c70 0x2c70 0x2c70 0x2c70 0x2c70 0x2c70 0x2c70 0x2c70 0x2c70 0x2c70 0x2c70 0x2c70 0x2c70 0x2c70 0x2c70 0x2c70 0x2c70 0x2c70 0x2c70 0x2c70 0x2c70 0x2c70 0x2c70 0x2c70 0x2c70 0x2c70 0x2c70 0x2c70 0x2c70 0x2c70 0x2c70 0x2c70 0x2c70 0x2c70 0x2c70 0x2c70 0x2c70 0x2c70 0x2c70 0x2c70 0x2c70 0x2c70 0x2c70 0x2c70 0x2c70 0x2710 0x2710 0x2710>;
					PS_Config_Lmt_Short_Rawdata_P = <0x36b8 0x36b8 0x36b8 0x36b8 0x36b8 0x36b8 0x36b8 0x36b8 0x36b8 0x36b8 0x36b8 0x36b8 0x36b8 0x36b8 0x36b8 0x36b8 0x36b8 0x36b8 0x36b8 0x36b8 0x36b8 0x36b8 0x36b8 0x36b8 0x36b8 0x36b8 0x36b8 0x36b8 0x36b8 0x36b8 0x36b8 0x36b8 0x36b8 0x36b8 0x36b8 0x36b8 0x36b8 0x36b8 0x36b8 0x36b8 0x36b8 0x36b8 0x36b8 0x36b8 0x36b8 0x36b8 0x36b8 0x36b8 0x36b8 0x36b8 0x36b8 0x36b8 0x36b8 0x36b8 0x36b8 0x36b8 0x36b8 0x36b8 0x36b8 0x36b8 0x36b8 0x36b8 0x36b8 0x36b8 0x36b8 0x36b8 0x36b8 0x36b8 0x36b8 0x36b8 0x36b8 0x36b8 0x36b8 0x36b8 0x36b8 0x36b8 0x36b8 0x36b8 0x36b8 0x36b8 0x36b8 0x36b8 0x36b8 0x36b8 0x36b8 0x36b8 0x36b8 0x36b8 0x36b8 0x36b8 0x36b8 0x36b8 0x36b8 0x36b8 0x36b8 0x36b8 0x36b8 0x36b8 0x36b8 0x36b8 0x36b8 0x36b8 0x36b8 0x36b8 0x36b8 0x36b8 0x36b8 0x36b8 0x36b8 0x36b8 0x36b8 0x36b8 0x36b8 0x36b8 0x36b8 0x36b8 0x36b8 0x36b8 0x36b8 0x36b8 0x36b8 0x36b8 0x36b8 0x36b8 0x36b8 0x36b8 0x36b8 0x36b8 0x36b8 0x36b8 0x36b8 0x36b8 0x36b8 0x36b8 0x36b8 0x36b8 0x36b8 0x36b8 0x36b8 0x36b8 0x36b8 0x36b8 0x36b8 0x36b8 0x36b8 0x36b8 0x36b8 0x36b8 0x36b8 0x36b8 0x36b8 0x36b8 0x36b8 0x36b8 0x36b8 0x36b8 0x36b8 0x36b8 0x36b8 0x36b8 0x36b8 0x36b8 0x36b8 0x36b8 0x36b8 0x36b8 0x36b8 0x36b8 0x36b8 0x36b8 0x36b8 0x36b8 0x36b8 0x36b8 0x36b8 0x36b8 0x36b8 0x36b8 0x36b8 0x36b8 0x36b8 0x36b8 0x36b8 0x36b8 0x36b8 0x36b8 0x36b8 0x36b8 0x36b8 0x36b8 0x36b8 0x36b8 0x36b8 0x36b8 0x36b8 0x36b8 0x36b8 0x36b8 0x36b8 0x36b8 0x36b8 0x36b8 0x36b8 0x36b8 0x36b8 0x36b8 0x36b8 0x36b8 0x36b8 0x36b8 0x36b8 0x36b8 0x36b8 0x36b8 0x36b8 0x36b8 0x36b8 0x36b8 0x36b8 0x36b8 0x36b8 0x36b8 0x36b8 0x36b8 0x36b8 0x36b8 0x36b8 0x36b8 0x36b8 0x36b8 0x36b8 0x36b8 0x36b8 0x36b8 0x36b8 0x36b8 0x36b8 0x36b8 0x36b8 0x36b8 0x36b8 0x36b8 0x36b8 0x36b8 0x36b8 0x36b8 0x36b8 0x36b8 0x36b8 0x36b8 0x36b8 0x36b8 0x36b8 0x36b8 0x36b8 0x36b8 0x36b8 0x36b8 0x36b8 0x36b8 0x36b8 0x36b8 0x36b8 0x36b8 0x36b8 0x36b8 0x36b8 0x36b8 0x36b8 0x36b8 0x36b8 0x36b8 0x36b8 0x36b8 0x36b8 0x36b8 0x36b8 0x36b8 0x36b8 0x36b8 0x36b8 0x36b8 0x36b8 0x36b8 0x36b8 0x36b8 0x36b8 0x36b8 0x36b8 0x36b8 0x36b8 0x36b8 0x36b8 0x36b8 0x36b8 0x36b8 0x36b8 0x36b8 0x36b8 0x36b8 0x36b8 0x36b8 0x36b8 0x36b8 0x36b8 0x36b8 0x36b8 0x36b8 0x36b8 0x36b8 0x36b8 0x36b8 0x36b8 0x36b8 0x36b8 0x36b8 0x36b8 0x36b8 0x36b8 0x36b8 0x36b8 0x36b8 0x36b8 0x36b8 0x36b8 0x36b8 0x36b8 0x36b8 0x36b8 0x36b8 0x36b8 0x36b8 0x36b8 0x36b8 0x36b8 0x36b8 0x36b8 0x36b8 0x36b8 0x36b8 0x36b8 0x36b8 0x36b8 0x36b8 0x36b8 0x36b8 0x36b8 0x36b8 0x36b8 0x36b8 0x36b8 0x36b8 0x36b8 0x36b8 0x36b8 0x36b8 0x36b8 0x36b8 0x36b8 0x36b8 0x36b8 0x36b8 0x36b8 0x36b8 0x36b8 0x36b8 0x36b8 0x36b8 0x36b8 0x36b8 0x36b8 0x36b8 0x36b8 0x36b8 0x36b8 0x36b8 0x36b8 0x36b8 0x36b8 0x36b8 0x36b8 0x36b8 0x36b8 0x36b8 0x36b8 0x36b8 0x36b8 0x36b8 0x36b8 0x36b8 0x36b8 0x36b8 0x36b8 0x36b8 0x36b8 0x36b8 0x36b8 0x36b8 0x36b8 0x36b8 0x36b8 0x36b8 0x36b8 0x36b8 0x36b8 0x36b8 0x36b8 0x36b8 0x36b8 0x36b8 0x36b8 0x36b8 0x36b8 0x36b8 0x36b8 0x36b8 0x36b8 0x36b8 0x36b8 0x36b8 0x36b8 0x36b8 0x36b8 0x36b8 0x36b8 0x36b8 0x36b8 0x36b8 0x36b8 0x36b8 0x36b8 0x36b8 0x36b8 0x36b8 0x36b8 0x36b8 0x36b8 0x36b8 0x36b8 0x36b8 0x36b8 0x36b8 0x36b8 0x36b8 0x36b8 0x36b8 0x36b8 0x36b8 0x36b8 0x36b8 0x36b8 0x36b8 0x36b8 0x36b8 0x36b8 0x36b8 0x36b8 0x36b8 0x36b8 0x36b8 0x36b8 0x36b8 0x36b8 0x36b8 0x36b8 0x36b8 0x36b8 0x36b8 0x36b8 0x36b8 0x36b8 0x36b8 0x36b8 0x36b8 0x36b8 0x36b8 0x36b8 0x36b8 0x36b8 0x36b8 0x36b8 0x36b8 0x36b8 0x36b8 0x36b8 0x36b8 0x36b8 0x36b8 0x36b8 0x36b8 0x36b8 0x36b8 0x36b8 0x36b8 0x36b8 0x36b8 0x36b8 0x36b8 0x36b8 0x36b8 0x36b8 0x36b8 0x36b8 0x36b8 0x36b8 0x36b8 0x36b8 0x36b8 0x36b8 0x36b8 0x36b8 0x36b8 0x36b8 0x36b8 0x36b8 0x36b8 0x36b8 0x36b8 0x36b8 0x36b8 0x36b8 0x36b8 0x36b8 0x36b8 0x36b8 0x36b8 0x36b8 0x36b8 0x36b8 0x36b8 0x36b8 0x36b8 0x36b8 0x36b8 0x36b8 0x36b8 0x36b8 0x36b8 0x36b8 0x36b8 0x36b8 0x36b8 0x36b8 0x36b8 0x36b8 0x36b8 0x36b8 0x36b8 0x36b8 0x36b8 0x36b8 0x36b8 0x36b8 0x36b8 0x36b8 0x36b8 0x36b8 0x36b8 0x36b8 0x36b8 0x36b8 0x36b8 0x36b8 0x36b8 0x36b8 0x36b8 0x36b8 0x36b8 0x36b8 0x36b8 0x36b8 0x36b8 0x36b8 0x36b8 0x36b8 0x36b8 0x36b8 0x36b8 0x36b8>;
					X_Channel = <0x12>;
					Y_Channel = <0x20>;
					compatible = "novatek-mp-criteria-596B";
				};
			};
		};
	};

	fragment@8 {
		target = <0xffffffff>;

		__overlay__ {

			accdetdefault {
				phandle = <0x2>;
			};

			accdeteint@0 {
				phandle = <0x3>;

				pins_cmd_dat {
					bias-disable;
					pinmux = <0x900>;
					slew-rate = <0x0>;
				};
			};
		};
	};

	fragment@9 {
		target = <0xffffffff>;

		__overlay__ {
			mt6370,intr_gpio = <0xffffffff 0xb 0x0>;
			mt6370,intr_gpio_num = <0xb>;
		};
	};
};
