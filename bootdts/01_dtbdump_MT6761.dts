/dts-v1/;

/ {
	#address-cells = <0x2>;
	#size-cells = <0x2>;
	compatible = "mediatek,MT6761";
	interrupt-parent = <0x1>;
	model = "MT6761";

	__symbols__ {
		DPIDLE = "/cpus/idle-states/dpidle";
		MCDI_CLUSTER = "/cpus/idle-states/mcdi-cluster";
		MCDI_CPU = "/cpus/idle-states/mcdi-cpu";
		SODI = "/cpus/idle-states/sodi";
		SODI3 = "/cpus/idle-states/sodi3";
		STANDBY = "/cpus/idle-states/standby";
		SUSPEND = "/cpus/idle-states/suspend";
		accdet = "/accdet";
		apdma = "/dma-controller@11000580";
		apmixed = "/apmixed@1000c000";
		audclk = "/audclk@11220000";
		audgpio = "/mt_soc_dl1_pcm@11220000";
		audio = "/audio@11220000";
		auxadc = "/auxadc@11001000";
		bat_gm30 = "/battery";
		btcvsd_snd = "/mtk-btcvsd-snd@18050000";
		camera_af_hw_node = "/camera_af_hw_node";
		camsys = "/camsys@15000000";
		ccifdriver = "/ccifdriver@10209000";
		charger = "/charger";
		chosen = "/chosen";
		cldmadriver = "/cldmadriver@10014000";
		clk13m = "/clocks/clk13m";
		clk26m = "/clocks/clk26m";
		clk32k = "/clocks/clk32k";
		clock_buffer_ctrl = "/pwrap@1000d000/main_pmic/clock_buffer_ctrl";
		cluster0_opp = "/opp_table0";
		cm_mgr = "/cm_mgr@10200000";
		consys = "/consys@18002000";
		consys_mem = "/reserved-memory/consys-reserve-memory";
		cpu0 = "/cpus/cpu@000";
		cpu1 = "/cpus/cpu@001";
		cpu2 = "/cpus/cpu@002";
		cpu3 = "/cpus/cpu@003";
		cpu_dbgapb = "/cpu_dbgapb@0d410000";
		cpu_freq_segment = "/efuse@11c50000/segment@1c";
		dcm = "/dcm@10001000";
		disp_color0 = "/disp_color0@1400f000";
		disp_mutex0 = "/disp_mutex0@14001000";
		dispsys_config = "/dispsys_config@14000000";
		dsi_te = "/dsi_te";
		dvfsrc = "/dvfsrc@10012000";
		dvfsrc_freq_opp0 = "/dvfsrc@10012000/opp0";
		dvfsrc_freq_opp1 = "/dvfsrc@10012000/opp1";
		dvfsrc_freq_opp2 = "/dvfsrc@10012000/opp2";
		dynamic_options = "/dynamic_options";
		efuse = "/efuse@11c50000";
		efuse_analog7 = "/efuse@11c50000/efuse_analog7@1ac";
		efuse_segment = "/efuse@11c50000/segment@78";
		eint = "/eint@1000b000";
		eta6953 = "/eta6953";
		ext_32k = "/pwrap@1000d000/main_pmic/mtk_rtc/ext_32k";
		extcon_usb = "/extcon_usb";
		fg_init = "/pwrap@1000d000/main_pmic/mtk_rtc/fg_init";
		fg_soc = "/pwrap@1000d000/main_pmic/mtk_rtc/fg_soc";
		fhctl = "/fhctl@1000ce00";
		flashlight_core = "/flashlight_core";
		flashlights_aw3644 = "/flashlights_aw3644";
		flashlights_mt6370 = "/flashlights_mt6370";
		flashlights_ocp8132 = "/flashlights_ocp8132";
		fpsensor_finger = "/fpsensor_finger";
		fpsensor_fp_eint = "/fpsensor_fp_eint";
		gce = "/gce@10238000";
		gce_mbox = "/gce_mbox@10238000";
		ged = "/ged";
		gic = "/interrupt-controller@0c000000";
		gpio = "/gpio@10005000";
		gpio_usage_mapping = "/gpio";
		gpufreq = "/gpufreq";
		hwrng = "/hwrng";
		i2c0 = "/i2c0@11007000";
		i2c1 = "/i2c1@11008000";
		i2c2 = "/i2c2@11009000";
		i2c3 = "/i2c3@1100f000";
		i2c4 = "/i2c4@11011000";
		i2c5 = "/i2c5@11016000";
		i2c6 = "/i2c6@1100d000";
		i2c7 = "/i2c7";
		i2c8 = "/i2c8";
		i2c9 = "/i2c9";
		i2c_common = "/i2c_common";
		infracfg_ao = "/infracfg_ao@10001000";
		io_cfg_bl = "/io_cfg_bl@10002600";
		io_cfg_lb = "/io_cfg_lb@10002400";
		io_cfg_lm = "/io_cfg_lm@10002200";
		io_cfg_lt = "/io_cfg_lt@10002000";
		io_cfg_rb = "/io_cfg_rb@10002a00";
		io_cfg_rr = "/io_cfg_rr@10002800";
		io_cfg_rt = "/io_cfg_rt@10002c00";
		iommu = "/m4u@10205000";
		irq_nfc = "/irq_nfc";
		kd_camera_hw1 = "/kd_camera_hw1@15040000";
		keypad = "/kp@10010000";
		lk_charger = "/lk_charger";
		main_pmic = "/pwrap@1000d000/main_pmic";
		md1_sim1_hot_plug_eint = "/md1_sim1_hot_plug_eint";
		md1_sim2_hot_plug_eint = "/md1_sim2_hot_plug_eint";
		md_auxadc = "/md_auxadc";
		mddriver = "/mddriver@10014000";
		mdp_ccorr = "/mdp_ccorr0@14005000";
		mdp_rdma0 = "/mdp_rdma0@14004000";
		mdp_rsz0 = "/mdp_rsz0@14006000";
		mdp_rsz1 = "/mdp_rsz1@14007000";
		mdp_tdshp0 = "/mdp_tdshp0@1400a000";
		mdp_wdma0 = "/mdp_wdma0@14008000";
		mdp_wrot0 = "/mdp_wrot0@14009000";
		mfg_cfg = "/mfg_cfg@13ffe000";
		mfg_clark = "/mfg_clark@13000000";
		mipi_rx_ana_csi0a = "/mipi_rx_ana_csi0a@11c10000";
		mipi_rx_ana_csi0b = "/mipi_rx_ana_csi0b@11c11000";
		mipi_rx_ana_csi1a = "/mipi_rx_ana_csi1a@11c12000";
		mipi_rx_ana_csi1b = "/mipi_rx_ana_csi1b@11c13000";
		mipi_rx_ana_csi2a = "/mipi_rx_ana_csi2a@11c14000";
		mipi_rx_ana_csi2b = "/mipi_rx_ana_csi2b@11c15000";
		mm_mutex = "/mm_mutex@14016000";
		mmsys_config = "/mmsys_config@14000000";
		mrdump_ext_rst = "/mrdump_ext_rst";
		msdc0 = "/msdc@11230000";
		msdc0_pins_default = "/pinctrl@10005000/msdc0@default";
		msdc0_pins_hs200 = "/pinctrl@10005000/msdc0@hs200";
		msdc0_pins_hs400 = "/pinctrl@10005000/msdc0@hs400";
		msdc0_register_setting_default = "/pinctrl@10005000/msdc0@register_default";
		msdc1 = "/msdc@11240000";
		msdc1_ins = "/msdc1_ins@0";
		msdc1_pins_ddr50 = "/pinctrl@10005000/msdc1@ddr50";
		msdc1_pins_default = "/pinctrl@10005000/msdc1@default";
		msdc1_pins_sdr104 = "/pinctrl@10005000/msdc1@sdr104";
		msdc1_pins_sdr50 = "/pinctrl@10005000/msdc1@sdr50";
		msdc1_register_setting_default = "/pinctrl@10005000/msdc1@register_default";
		msdc2 = "/msdc@11250000";
		msdc3 = "/msdc@11260000";
		msdc3_pins_default = "/pinctrl@10005000/msdc3@default";
		msdc3_register_setting_default = "/pinctrl@10005000/msdc3@register_default";
		mt6357_charger = "/pwrap@1000d000/main_pmic/mt6357_charger";
		mt6357_ts_buck1 = "/pwrap@1000d000/main_pmic/mt6357_ts_buck1";
		mt6357_ts_buck2 = "/pwrap@1000d000/main_pmic/mt6357_ts_buck2";
		mt6357keys = "/pwrap@1000d000/main_pmic/mt6357keys";
		mt6357regulator = "/pwrap@1000d000/main_pmic/mt6357regulator";
		mt6370_chg = "/mt6370_pmu_dts/charger";
		mt6370_pmu = "/mt6370_pmu_dts";
		mt6370_typec = "/type_c_port0";
		mt_pmic_vaud28_ldo_reg = "/pwrap@1000d000/main_pmic/mt6357regulator/ldo_vaud28";
		mt_pmic_vaux18_ldo_reg = "/pwrap@1000d000/main_pmic/mt6357regulator/ldo_vaux18";
		mt_pmic_vcama_ldo_reg = "/pwrap@1000d000/main_pmic/mt6357regulator/ldo_vcama";
		mt_pmic_vcamd_ldo_reg = "/pwrap@1000d000/main_pmic/mt6357regulator/ldo_vcamd";
		mt_pmic_vcamio_ldo_reg = "/pwrap@1000d000/main_pmic/mt6357regulator/ldo_vcamio";
		mt_pmic_vcn18_ldo_reg = "/pwrap@1000d000/main_pmic/mt6357regulator/ldo_vcn18";
		mt_pmic_vcn28_ldo_reg = "/pwrap@1000d000/main_pmic/mt6357regulator/ldo_vcn28";
		mt_pmic_vcn33_bt_ldo_reg = "/pwrap@1000d000/main_pmic/mt6357regulator/ldo_vcn33_bt";
		mt_pmic_vcn33_wifi_ldo_reg = "/pwrap@1000d000/main_pmic/mt6357regulator/ldo_vcn33_wifi";
		mt_pmic_vcore_buck_reg = "/pwrap@1000d000/main_pmic/mt6357regulator/buck_vcore";
		mt_pmic_vdram_ldo_reg = "/pwrap@1000d000/main_pmic/mt6357regulator/ldo_vdram";
		mt_pmic_vefuse_ldo_reg = "/pwrap@1000d000/main_pmic/mt6357regulator/ldo_vefuse";
		mt_pmic_vemc_ldo_reg = "/pwrap@1000d000/main_pmic/mt6357regulator/ldo_vemc";
		mt_pmic_vfe28_ldo_reg = "/pwrap@1000d000/main_pmic/mt6357regulator/ldo_vfe28";
		mt_pmic_vibr_ldo_reg = "/pwrap@1000d000/main_pmic/mt6357regulator/ldo_vibr";
		mt_pmic_vio18_ldo_reg = "/pwrap@1000d000/main_pmic/mt6357regulator/ldo_vio18";
		mt_pmic_vio28_ldo_reg = "/pwrap@1000d000/main_pmic/mt6357regulator/ldo_vio28";
		mt_pmic_vldo28_ldo_reg = "/pwrap@1000d000/main_pmic/mt6357regulator/ldo_vldo28";
		mt_pmic_vmc_ldo_reg = "/pwrap@1000d000/main_pmic/mt6357regulator/ldo_vmc";
		mt_pmic_vmch_ldo_reg = "/pwrap@1000d000/main_pmic/mt6357regulator/ldo_vmch";
		mt_pmic_vmodem_buck_reg = "/pwrap@1000d000/main_pmic/mt6357regulator/buck_vmodem";
		mt_pmic_vpa_buck_reg = "/pwrap@1000d000/main_pmic/mt6357regulator/buck_vpa";
		mt_pmic_vproc_buck_reg = "/pwrap@1000d000/main_pmic/mt6357regulator/buck_vproc";
		mt_pmic_vrf12_ldo_reg = "/pwrap@1000d000/main_pmic/mt6357regulator/ldo_vrf12";
		mt_pmic_vrf18_ldo_reg = "/pwrap@1000d000/main_pmic/mt6357regulator/ldo_vrf18";
		mt_pmic_vs1_buck_reg = "/pwrap@1000d000/main_pmic/mt6357regulator/buck_vs1";
		mt_pmic_vsim1_ldo_reg = "/pwrap@1000d000/main_pmic/mt6357regulator/ldo_vsim1";
		mt_pmic_vsim2_ldo_reg = "/pwrap@1000d000/main_pmic/mt6357regulator/ldo_vsim2";
		mt_pmic_vsram_others_ldo_reg = "/pwrap@1000d000/main_pmic/mt6357regulator/ldo_vsram_others";
		mt_pmic_vsram_proc_ldo_reg = "/pwrap@1000d000/main_pmic/mt6357regulator/ldo_vsram_proc";
		mt_pmic_vusb33_ldo_reg = "/pwrap@1000d000/main_pmic/mt6357regulator/ldo_vusb33";
		mt_pmic_vxo22_ldo_reg = "/pwrap@1000d000/main_pmic/mt6357regulator/ldo_vxo22";
		mtk_charger_type = "/pwrap@1000d000/main_pmic/mtk_charger_type";
		mtk_gauge = "/pwrap@1000d000/main_pmic/mtk_gauge";
		mtk_rtc = "/pwrap@1000d000/main_pmic/mtk_rtc";
		mtk_ts_pmic = "/pwrap@1000d000/main_pmic/mtk_ts_pmic";
		mtkfb = "/mtkfb@0";
		nfc = "/nfc";
		odm = "/odm";
		otg_iddig = "/otg_iddig";
		otg_vbus = "/mt6370_pmu_dts/charger/usb-otg-vbus";
		pbm = "/pbm";
		pd_adapter = "/pd_adapter";
		pdc = "/pdc";
		pericfg = "/pericfg@10003000";
		pio = "/pinctrl@10005000";
		pmic_accdet = "/pwrap@1000d000/main_pmic/pmic_accdet";
		pmic_auxadc = "/pwrap@1000d000/main_pmic/pmic_auxadc";
		pmic_clock_buffer_ctrl = "/pmic_clock_buffer_ctrl";
		pmic_codec = "/pwrap@1000d000/main_pmic/pmic_codec";
		pmic_efuse = "/pwrap@1000d000/main_pmic/pmic_efuse";
		pwm = "/pwm@11006000";
		pwrap = "/pwrap@1000d000";
		radio_md_cfg = "/radio_md_cfg";
		rt9465_slave_chr = "/rt9465_slave_chr";
		scp = "/scp@10500000";
		scp_infra = "/scp_infra@10001000";
		scpsys = "/scpsys@10001000";
		sgm41513 = "/sgm41513";
		silead_fp = "/silead_fp";
		sleep = "/sleep@10006000";
		smart_pa = "/smart_pa";
		smi_common = "/smi_common@14002000";
		smi_larb0 = "/smi_larb0@14003000";
		smi_larb1 = "/smi_larb1@17010000";
		smi_larb2 = "/smi_larb2@15001000";
		spi0 = "/spi0@1100a000";
		spi1 = "/spi1@11010000";
		spi2 = "/spi2@11012000";
		spi3 = "/spi3@11013000";
		spi4 = "/spi4@11014000";
		spi5 = "/spi5@11015000";
		subpmic_pmu_eint = "/mt6370_pmu_eint";
		swtp = "/swtp";
		swtp1 = "/swtp1";
		syscfg_pctl_0 = "/syscfg_pctl_0@10005000";
		sysirq = "/intpol-controller@10200a80";
		tboard_thermistor1 = "/thermal-sensor1";
		tboard_thermistor2 = "/thermal-sensor2";
		tboard_thermistor3 = "/thermal-sensor3";
		tboard_thermistor5 = "/thermal-sensor5";
		tcpc_pd = "/tcpc_pd";
		thermal_efuse = "/efuse@11c50000/segment@190";
		timer = "/timer@10017000";
		topckgen = "/topckgen@10000000";
		toprgu = "/toprgu@10007000";
		touch = "/touch";
		u2_phy_data = "/efuse@11c50000/u2_phy_data@1ac";
		u2phy0 = "/usb-phy@11210000";
		u2port0 = "/usb-phy@11210000/usb-phy@11210000";
		uart0 = "/serial@11020000";
		uart1 = "/serial@11030000";
		usb = "/usb0@11200000";
		vcodecsys = "/vcodecsys@17000000";
		venc_gcon = "/venc_gcon@17000000";
		wifi_mem = "/reserved-memory/wifi-reserve-memory";
	};

	accdet {
		compatible = "mediatek,pmic-accdet";
		phandle = <0x99>;
	};

	aes_top0@10016000 {
		compatible = "mediatek,aes_top0";
		reg = <0x0 0x10016000 0x0 0x1000>;
	};

	amms_control {
		compatible = "mediatek,amms";
		interrupts = <0x0 0x43 0x1>;
	};

	ant_check {
		ant_check_gpio = <0x1e 0x4e 0x0>;
		compatible = "longcheer,ant_check";
	};

	ant_check_div {
		ant_check_div_gpio = <0x1e 0x36 0x0>;
		compatible = "longcheer,ant_check_div";
	};

	ap_ccif0@10209000 {
		compatible = "mediatek,ap_ccif0";
		interrupts = <0x0 0x5c 0x8>;
		reg = <0x0 0x10209000 0x0 0x1000>;
	};

	ap_ccif1@1020b000 {
		compatible = "mediatek,ap_ccif1";
		interrupts = <0x0 0x5e 0x8>;
		reg = <0x0 0x1020b000 0x0 0x1000>;
	};

	ap_ccif2@1023c000 {
		compatible = "mediatek,ap_ccif2";
		interrupts = <0x0 0x57 0x8>;
		reg = <0x0 0x1023c000 0x0 0x1000>;
	};

	ap_ccif3@1023e000 {
		compatible = "mediatek,ap_ccif3";
		interrupts = <0x0 0x5a 0x8>;
		reg = <0x0 0x1023e000 0x0 0x1000>;
	};

	ap_dma@11000000 {
		compatible = "mediatek,ap_dma";
		interrupts = <0x0 0x29 0x8>;
		reg = <0x0 0x11000000 0x0 0x1000>;
	};

	apcldmain@1021b000 {
		compatible = "mediatek,apcldmain";
		reg = <0x0 0x1021b000 0x0 0x100>;
	};

	apcldmain_ao@10014000 {
		compatible = "mediatek,apcldmain_ao";
		reg = <0x0 0x10014000 0x0 0x400>;
	};

	apcldmamisc@1021b800 {
		compatible = "mediatek,apcldmamisc";
		interrupts = <0x0 0x6d 0x4>;
		reg = <0x0 0x1021b800 0x0 0x100>;
	};

	apcldmamisc_ao@10014800 {
		compatible = "mediatek,apcldmamisc_ao";
		reg = <0x0 0x10014800 0x0 0x400>;
	};

	apcldmamisc_ao@10014c00 {
		compatible = "mediatek,apcldmamisc_ao";
		reg = <0x0 0x10014c00 0x0 0x400>;
	};

	apcldmaout@1021b400 {
		compatible = "mediatek,apcldmaout";
		reg = <0x0 0x1021b400 0x0 0x100>;
	};

	apcldmaout_ao@10014400 {
		compatible = "mediatek,apcldmaout_ao";
		reg = <0x0 0x10014400 0x0 0x400>;
	};

	apirq@1000b000 {
		compatible = "mediatek,apirq";
		interrupts = <0x0 0x73 0x4>;
		reg = <0x0 0x1000b000 0x0 0x1000>;
	};

	apmixed@1000c000 {
		#clock-cells = <0x1>;
		compatible = "mediatek,mt6761-apmixedsys", "syscon";
		phandle = <0x20>;
		reg = <0x0 0x1000c000 0x0 0xe00>;
	};

	atf_logger {
		compatible = "mediatek,atf_logger";
		interrupts = <0x0 0x4e 0x1>;
	};

	audclk@11220000 {
		#clock-cells = <0x1>;
		compatible = "mediatek,mt6761-audsys", "syscon";
		phandle = <0x5a>;
		reg = <0x0 0x11220000 0x0 0x1000>;
	};

	audio@11220000 {
		compatible = "mediatek,audio", "syscon";
		mediatek,btcvsd_snd = <0x59>;
		phandle = <0xc4>;
		reg = <0x0 0x11220000 0x0 0x1000>;
	};

	audio_snd_card {
		compatible = "mediatek,audio_snd_card";
	};

	audio_sram@11221000 {
		compatible = "mediatek,audio_sram";
		reg = <0x0 0x11221000 0x0 0x9000>;
	};

	auxadc@11001000 {
		#interconnect-cells = <0x1>;
		#io-channel-cells = <0x1>;
		clock-names = "main";
		clocks = <0x22 0x21>;
		compatible = "mediatek,mt6765-auxadc";
		interrupts = <0x0 0x14 0x2>;
		mediatek,cali-efuse-reg-offset = <0x1a8>;
		mediatek,cali-en-bit = <0x14>;
		mediatek,cali-ge-bit = <0xa>;
		mediatek,cali-oe-bit = <0x0>;
		nvmem = <0x44>;
		nvmem-names = "mtk_efuse";
		phandle = <0x27>;
		reg = <0x0 0x11001000 0x0 0x1000>;
	};

	battery {
		compatible = "mediatek,bat_gm30";
		phandle = <0xe7>;
	};

	bpi_bsi_slv0@1021e000 {
		compatible = "mediatek,bpi_bsi_slv0";
		reg = <0x0 0x1021e000 0x0 0x1000>;
	};

	bpi_bsi_slv1@1021f000 {
		compatible = "mediatek,bpi_bsi_slv1";
		reg = <0x0 0x1021f000 0x0 0x6000>;
	};

	bpi_bsi_slv2@10225000 {
		compatible = "mediatek,bpi_bsi_slv2";
		reg = <0x0 0x10225000 0x0 0x1000>;
	};

	btif@1100c000 {
		clock-names = "btifc", "apdmac";
		clocks = <0x22 0x1a 0x22 0x26>;
		compatible = "mediatek,btif";
		interrupts = <0x0 0x38 0x8 0x0 0x4c 0x8 0x0 0x4d 0x8>;
		reg = <0x0 0x1100c000 0x0 0x1000 0x0 0x11000880 0x0 0x80 0x0 0x11000900 0x0 0x80>;
	};

	bus_dbg@10208000 {
		compatible = "mediatek,bus_dbg-v2";
		interrupts = <0x0 0x55 0x8>;
		mediatek,bus_dbg_con_offset = <0x2fc>;
		reg = <0x0 0x10208000 0x0 0x1000 0x0 0x10001000 0x0 0x1000>;
	};

	cam@15004000 {
		compatible = "mediatek,cam";
		reg = <0x0 0x15004000 0x0 0x1000>;
	};

	cam_dma@15007000 {
		compatible = "mediatek,cam_dma";
		reg = <0x0 0x15007000 0x0 0x1000>;
	};

	cam_inner@1500d000 {
		compatible = "mediatek,cam_inner";
		reg = <0x0 0x1500d000 0x0 0x1000>;
	};

	cam_inner_dma@1500f000 {
		compatible = "mediatek,cam_inner_dma";
		reg = <0x0 0x1500f000 0x0 0x1000>;
	};

	cam_lut@15005000 {
		compatible = "mediatek,cam_lut";
		reg = <0x0 0x15005000 0x0 0x1000>;
	};

	camd@15006000 {
		compatible = "mediatek,camd";
		reg = <0x0 0x15006000 0x0 0x1000>;
	};

	camd_inner@1500e000 {
		compatible = "mediatek,camd_inner";
		reg = <0x0 0x1500e000 0x0 0x1000>;
	};

	camera_af_hw_node {
		camaf_m1_pmic-supply = <0x5e>;
		compatible = "mediatek,camera_af_lens";
		phandle = <0xd5>;
	};

	camsv0@15050000 {
		compatible = "mediatek,camsv0";
		reg = <0x0 0x15050000 0x0 0x1000>;
	};

	camsv1@15051000 {
		compatible = "mediatek,camsv1";
		reg = <0x0 0x15051000 0x0 0x1000>;
	};

	camsys@15000000 {
		#clock-cells = <0x1>;
		compatible = "mediatek,mt6761-camsys", "syscon";
		phandle = <0x11>;
		reg = <0x0 0x15000000 0x0 0x1000>;
	};

	ccifdriver@10209000 {
		clock-names = "infra-ccif-ap", "infra-ccif-md", "infra-ccif1-ap", "infra-ccif1-md", "infra-ccif2-ap", "infra-ccif2-md";
		clocks = <0x22 0x29 0x22 0x2c 0x22 0x23 0x22 0x24 0x22 0x58 0x22 0x59>;
		compatible = "mediatek,ccci_ccif";
		interrupts = <0x0 0x5c 0x8 0x0 0x5d 0x8>;
		mediatek,sram_size = <0x200>;
		phandle = <0xa2>;
		reg = <0x0 0x10209000 0x0 0x1000 0x0 0x1020a000 0x0 0x1000>;
	};

	charger {
		ac_charger_current = <0x1f4000>;
		ac_charger_input_current = <0x2143a0>;
		algorithm_name = "Basic";
		battery_cv = <0x432380>;
		bootmode = <0x26>;
		charger = <0x25>;
		charger_configuration = <0x0>;
		charging_host_charger_current = <0x16e360>;
		compatible = "mediatek,charger";
		enable_dynamic_mivr;
		enable_min_charge_temp;
		enable_sw_jeita;
		gauge = <0x60>;
		jeita_current_t0_to_t1 = <0x77a10>;
		jeita_current_t1_to_t2 = <0x15f900>;
		jeita_current_t2_to_t3 = <0x1e8480>;
		jeita_current_t3_to_t4 = <0x1de840>;
		jeita_temp_above_t4_cv = <0x3e8fa0>;
		jeita_temp_below_t0_cv = <0x432380>;
		jeita_temp_t0_to_t1_cv = <0x432380>;
		jeita_temp_t1_to_t2_cv = <0x432380>;
		jeita_temp_t2_to_t3_cv = <0x432380>;
		jeita_temp_t3_to_t4_cv = <0x3e8fa0>;
		max_charge_temp = <0x32>;
		max_charge_temp_minus_x_degree = <0x2f>;
		max_charger_voltage = <0x632ea0>;
		max_dmivr_charger_current = <0x1b7740>;
		min_charge_temp = <0x0>;
		min_charge_temp_plus_x_degree = <0x6>;
		min_charger_voltage = <0x432380>;
		min_charger_voltage_1 = <0x432380>;
		min_charger_voltage_2 = <0x401640>;
		phandle = <0x2b>;
		pmic = <0x2c>;
		temp_neg_10_thres = <0x0>;
		temp_t0_thres = <0x0>;
		temp_t0_thres_plus_x_degree = <0x1>;
		temp_t1_thres = <0xa>;
		temp_t1_thres_plus_x_degree = <0xb>;
		temp_t2_thres = <0xf>;
		temp_t2_thres_plus_x_degree = <0x10>;
		temp_t3_thres = <0x2d>;
		temp_t3_thres_minus_x_degree = <0x2b>;
		temp_t4_thres = <0x3a>;
		temp_t4_thres_minus_x_degree = <0x38>;
		usb_charger_current = <0x7a120>;
	};

	chipid@08000000 {
		compatible = "mediatek,chipid";
		reg = <0x0 0x8000000 0x0 0x4 0x0 0x8000004 0x0 0x4 0x0 0x8000008 0x0 0x4 0x0 0x800000c 0x0 0x4>;
	};

	chosen {
		bootargs = "console=tty0 console=ttyS0,921600n1 vmalloc=400M \t\t\t\tslub_debug=OFZPU page_owner=on \t\t\t\tswiotlb=noforce \t\t\t\tcgroup.memory=nosocket,nokmem \t\t\t\tandroidboot.hardware=mt6761 \t\t\t\tmaxcpus=8 loop.max_part=7 \t\t\t\tfirmware_class.path=/vendor/firmware";
		phandle = <0x26>;
	};

	cldmadriver@10014000 {
		cldma-infracfg = <0x22>;
		clock-names = "infra-cldma-bclk";
		clocks = <0x22 0x32>;
		compatible = "mediatek,ccci_cldma";
		interrupts = <0x0 0x6d 0x4>;
		mediatek,cldma_capability = <0x6>;
		mediatek,md_generation = <0x1895>;
		mediatek,platform = <0x1a69>;
		phandle = <0xa3>;
		reg = <0x0 0x10014000 0x0 0x1000 0x0 0x1021b000 0x0 0x1000>;
	};

	clocks {

		clk13m {
			#clock-cells = <0x0>;
			clock-frequency = <0xc65d40>;
			compatible = "fixed-clock";
			phandle = <0x30>;
		};

		clk26m {
			#clock-cells = <0x0>;
			clock-frequency = <0x18cba80>;
			compatible = "fixed-clock";
			phandle = <0x21>;
		};

		clk32k {
			#clock-cells = <0x0>;
			clock-frequency = <0x7d00>;
			compatible = "fixed-clock";
			phandle = <0x71>;
		};
	};

	cm_mgr@10200000 {
		cm_mgr,cp_down = <0x64 0x64>;
		cm_mgr,cp_up = <0x64 0x64>;
		cm_mgr,dt_down = <0x0 0x3>;
		cm_mgr,dt_up = <0x0 0x3>;
		cm_mgr,vp_down = <0x64 0x64>;
		cm_mgr,vp_up = <0x64 0x64>;
		cm_mgr_cpu_opp_to_dram = <0x0 0x0 0x0 0x0 0x1 0x1 0x1 0x1 0x1 0x2 0x2 0x2 0x2 0x2 0x2 0x2>;
		compatible = "mediatek,mt6761-cm_mgr";
		phandle = <0xea>;
		reg = <0x0 0x10200000 0x0 0x4000>;
		reg-names = "cm_mgr_base";
		required-opps = <0x2d 0x2e 0x2f>;
		use_cpu_to_dram_map = "enable";
	};

	consys@18002000 {
		#address-cells = <0x2>;
		#size-cells = <0x2>;
		clock-names = "conn";
		clocks = <0x34 0x1>;
		compatible = "mediatek,mt6761-consys";
		interrupts = <0x0 0xd3 0x8 0x0 0xd5 0x8 0x0 0xd6 0x1>;
		memory-region = <0x48>;
		phandle = <0x14>;
		pmic = <0x2c>;
		reg = <0x0 0x18002000 0x0 0x1000 0x0 0x10007000 0x0 0x100 0x0 0x10001000 0x0 0x1000 0x0 0x10006000 0x0 0x1000 0x0 0x18007000 0x0 0x1000 0x0 0x180b1000 0x0 0x1000 0x0 0x180a3000 0x0 0x1000 0x0 0x180a5000 0x0 0x800 0x0 0x180c1000 0x0 0x1000 0x0 0x18004000 0x0 0x1000>;
	};

	cpu_dbgapb@0d410000 {
		compatible = "mediatek,hw_dbg";
		num = <0x8>;
		phandle = <0x65>;
		reg = <0x0 0xd410000 0x0 0x1000 0x0 0xd510000 0x0 0x1000 0x0 0xd610000 0x0 0x1000 0x0 0xd710000 0x0 0x1000 0x0 0xd810000 0x0 0x1000 0x0 0xd910000 0x0 0x1000 0x0 0xda10000 0x0 0x1000 0x0 0xdb10000 0x0 0x1000>;
	};

	cpus {
		#address-cells = <0x1>;
		#size-cells = <0x0>;

		cpu-map {

			cluster0 {

				core0 {
					cpu = <0xa>;
				};

				core1 {
					cpu = <0xb>;
				};

				core2 {
					cpu = <0xc>;
				};

				core3 {
					cpu = <0xd>;
				};
			};
		};

		cpu@000 {
			capacity-dmips-mhz = <0x400>;
			clock-frequency = <0x8b799100>;
			compatible = "arm,cortex-a53";
			cpu-idle-states = <0x3 0x4 0x5 0x6 0x7 0x8 0x9>;
			device_type = "cpu";
			dynamic-power-coefficient = <0x113>;
			enable-method = "psci";
			operating-points-v2 = <0x2>;
			phandle = <0xa>;
			reg = <0x0>;
		};

		cpu@001 {
			capacity-dmips-mhz = <0x400>;
			clock-frequency = <0x8b799100>;
			compatible = "arm,cortex-a53";
			cpu-idle-states = <0x3 0x4 0x5 0x6 0x7 0x8 0x9>;
			device_type = "cpu";
			dynamic-power-coefficient = <0x113>;
			enable-method = "psci";
			operating-points-v2 = <0x2>;
			phandle = <0xb>;
			reg = <0x1>;
		};

		cpu@002 {
			capacity-dmips-mhz = <0x400>;
			clock-frequency = <0x8b799100>;
			compatible = "arm,cortex-a53";
			cpu-idle-states = <0x3 0x4 0x5 0x6 0x7 0x8 0x9>;
			device_type = "cpu";
			dynamic-power-coefficient = <0x113>;
			enable-method = "psci";
			operating-points-v2 = <0x2>;
			phandle = <0xc>;
			reg = <0x2>;
		};

		cpu@003 {
			capacity-dmips-mhz = <0x400>;
			clock-frequency = <0x8b799100>;
			compatible = "arm,cortex-a53";
			cpu-idle-states = <0x3 0x4 0x5 0x6 0x7 0x8 0x9>;
			device_type = "cpu";
			dynamic-power-coefficient = <0x113>;
			enable-method = "psci";
			operating-points-v2 = <0x2>;
			phandle = <0xd>;
			reg = <0x3>;
		};

		idle-states {
			entry-method = "arm,psci";

			dpidle {
				arm,psci-suspend-param = <0x1010004>;
				compatible = "arm,idle-state";
				entry-latency-us = <0x320>;
				exit-latency-us = <0x3e8>;
				min-residency-us = <0x7d0>;
				phandle = <0x8>;
			};

			mcdi-cluster {
				arm,psci-suspend-param = <0x1010001>;
				compatible = "arm,idle-state";
				entry-latency-us = <0x258>;
				exit-latency-us = <0x258>;
				min-residency-us = <0x4b0>;
				phandle = <0x5>;
			};

			mcdi-cpu {
				arm,psci-suspend-param = <0x10001>;
				compatible = "arm,idle-state";
				entry-latency-us = <0x258>;
				exit-latency-us = <0x258>;
				min-residency-us = <0x4b0>;
				phandle = <0x4>;
			};

			sodi {
				arm,psci-suspend-param = <0x1010002>;
				compatible = "arm,idle-state";
				entry-latency-us = <0x320>;
				exit-latency-us = <0x3e8>;
				min-residency-us = <0x7d0>;
				phandle = <0x6>;
			};

			sodi3 {
				arm,psci-suspend-param = <0x1010003>;
				compatible = "arm,idle-state";
				entry-latency-us = <0x320>;
				exit-latency-us = <0x3e8>;
				min-residency-us = <0x7d0>;
				phandle = <0x7>;
			};

			standby {
				arm,psci-suspend-param = <0x1>;
				compatible = "arm,idle-state";
				entry-latency-us = <0x258>;
				exit-latency-us = <0x258>;
				min-residency-us = <0x4b0>;
				phandle = <0x3>;
			};

			suspend {
				arm,psci-suspend-param = <0x1010005>;
				compatible = "arm,idle-state";
				entry-latency-us = <0x320>;
				exit-latency-us = <0x3e8>;
				min-residency-us = <0x7d0>;
				phandle = <0x9>;
			};
		};
	};

	cq_dma@10212000 {
		clock-names = "cqdma";
		clocks = <0x22 0x43>;
		compatible = "mediatek,mt-cqdma-v1";
		interrupts = <0x0 0x39 0x8 0x0 0x3a 0x8 0x0 0x3b 0x8>;
		keep_clock_ao = "yes";
		nr_channel = <0x3>;
		reg = <0x0 0x10212000 0x0 0x80 0x0 0x10212080 0x0 0x80 0x0 0x10212100 0x0 0x68>;
	};

	dbg_apmcu_mp0@0d400000 {
		compatible = "mediatek,dbg_apmcu_mp0";
		reg = <0x0 0xd400000 0x0 0x1000>;
	};

	dbg_apmcu_mp0@0d410000 {
		compatible = "mediatek,dbg_apmcu_mp0";
		reg = <0x0 0xd410000 0x0 0x1000>;
	};

	dbg_apmcu_mp0@0d420000 {
		compatible = "mediatek,dbg_apmcu_mp0";
		reg = <0x0 0xd420000 0x0 0x1000>;
	};

	dbg_apmcu_mp0@0d430000 {
		compatible = "mediatek,dbg_apmcu_mp0";
		reg = <0x0 0xd430000 0x0 0x1000>;
	};

	dbg_apmcu_mp0@0d440000 {
		compatible = "mediatek,dbg_apmcu_mp0";
		reg = <0x0 0xd440000 0x0 0x1000>;
	};

	dbg_apmcu_mp0@0d510000 {
		compatible = "mediatek,dbg_apmcu_mp0";
		reg = <0x0 0xd510000 0x0 0x1000>;
	};

	dbg_apmcu_mp0@0d520000 {
		compatible = "mediatek,dbg_apmcu_mp0";
		reg = <0x0 0xd520000 0x0 0x1000>;
	};

	dbg_apmcu_mp0@0d530000 {
		compatible = "mediatek,dbg_apmcu_mp0";
		reg = <0x0 0xd530000 0x0 0x1000>;
	};

	dbg_apmcu_mp0@0d540000 {
		compatible = "mediatek,dbg_apmcu_mp0";
		reg = <0x0 0xd540000 0x0 0x1000>;
	};

	dbg_apmcu_mp0@0d610000 {
		compatible = "mediatek,dbg_apmcu_mp0";
		reg = <0x0 0xd610000 0x0 0x1000>;
	};

	dbg_apmcu_mp0@0d620000 {
		compatible = "mediatek,dbg_apmcu_mp0";
		reg = <0x0 0xd620000 0x0 0x1000>;
	};

	dbg_apmcu_mp0@0d630000 {
		compatible = "mediatek,dbg_apmcu_mp0";
		reg = <0x0 0xd630000 0x0 0x1000>;
	};

	dbg_apmcu_mp0@0d640000 {
		compatible = "mediatek,dbg_apmcu_mp0";
		reg = <0x0 0xd640000 0x0 0x1000>;
	};

	dbg_apmcu_mp0@0d710000 {
		compatible = "mediatek,dbg_apmcu_mp0";
		reg = <0x0 0xd710000 0x0 0x1000>;
	};

	dbg_apmcu_mp0@0d720000 {
		compatible = "mediatek,dbg_apmcu_mp0";
		reg = <0x0 0xd720000 0x0 0x1000>;
	};

	dbg_apmcu_mp0@0d730000 {
		compatible = "mediatek,dbg_apmcu_mp0";
		reg = <0x0 0xd730000 0x0 0x1000>;
	};

	dbg_apmcu_mp0@0d740000 {
		compatible = "mediatek,dbg_apmcu_mp0";
		reg = <0x0 0xd740000 0x0 0x1000>;
	};

	dbg_apmcu_mp1@0d800000 {
		compatible = "mediatek,dbg_apmcu_mp1";
		reg = <0x0 0xd800000 0x0 0x1000>;
	};

	dbg_apmcu_mp1@0d810000 {
		compatible = "mediatek,dbg_apmcu_mp1";
		reg = <0x0 0xd810000 0x0 0x1000>;
	};

	dbg_apmcu_mp1@0d820000 {
		compatible = "mediatek,dbg_apmcu_mp1";
		reg = <0x0 0xd820000 0x0 0x1000>;
	};

	dbg_apmcu_mp1@0d830000 {
		compatible = "mediatek,dbg_apmcu_mp1";
		reg = <0x0 0xd830000 0x0 0x1000>;
	};

	dbg_apmcu_mp1@0d840000 {
		compatible = "mediatek,dbg_apmcu_mp1";
		reg = <0x0 0xd840000 0x0 0x1000>;
	};

	dbg_apmcu_mp1@0d910000 {
		compatible = "mediatek,dbg_apmcu_mp1";
		reg = <0x0 0xd910000 0x0 0x1000>;
	};

	dbg_apmcu_mp1@0d920000 {
		compatible = "mediatek,dbg_apmcu_mp1";
		reg = <0x0 0xd920000 0x0 0x1000>;
	};

	dbg_apmcu_mp1@0d930000 {
		compatible = "mediatek,dbg_apmcu_mp1";
		reg = <0x0 0xd930000 0x0 0x1000>;
	};

	dbg_apmcu_mp1@0d940000 {
		compatible = "mediatek,dbg_apmcu_mp1";
		reg = <0x0 0xd940000 0x0 0x1000>;
	};

	dbg_apmcu_mp1@0da10000 {
		compatible = "mediatek,dbg_apmcu_mp1";
		reg = <0x0 0xda10000 0x0 0x1000>;
	};

	dbg_apmcu_mp1@0da20000 {
		compatible = "mediatek,dbg_apmcu_mp1";
		reg = <0x0 0xda20000 0x0 0x1000>;
	};

	dbg_apmcu_mp1@0da30000 {
		compatible = "mediatek,dbg_apmcu_mp1";
		reg = <0x0 0xda30000 0x0 0x1000>;
	};

	dbg_apmcu_mp1@0da40000 {
		compatible = "mediatek,dbg_apmcu_mp1";
		reg = <0x0 0xda40000 0x0 0x1000>;
	};

	dbg_apmcu_mp1@0db10000 {
		compatible = "mediatek,dbg_apmcu_mp1";
		reg = <0x0 0xdb10000 0x0 0x1000>;
	};

	dbg_apmcu_mp1@0db20000 {
		compatible = "mediatek,dbg_apmcu_mp1";
		reg = <0x0 0xdb20000 0x0 0x1000>;
	};

	dbg_apmcu_mp1@0db30000 {
		compatible = "mediatek,dbg_apmcu_mp1";
		reg = <0x0 0xdb30000 0x0 0x1000>;
	};

	dbg_apmcu_mp1@0db40000 {
		compatible = "mediatek,dbg_apmcu_mp1";
		reg = <0x0 0xdb40000 0x0 0x1000>;
	};

	dbg_cti@0d020000 {
		compatible = "mediatek,dbg_cti";
		reg = <0x0 0xd020000 0x0 0x10000>;
	};

	dbg_dem@0d0a0000 {
		compatible = "mediatek,dbg_dem";
		interrupts = <0x0 0x54 0x8>;
		reg = <0x0 0xd0a0000 0x0 0x10000>;
	};

	dbg_etr@0d030000 {
		compatible = "mediatek,dbg_etr";
		reg = <0x0 0xd030000 0x0 0x10000>;
	};

	dbg_funnel@0d040000 {
		compatible = "mediatek,dbg_funnel";
		reg = <0x0 0xd040000 0x0 0x10000>;
	};

	dbg_mdsys1@0d0c0000 {
		compatible = "mediatek,dbg_mdsys1";
		reg = <0x0 0xd0c0000 0x0 0x40000>;
	};

	dcm@10001000 {
		compatible = "mediatek,mt6761-dcm";
		phandle = <0x67>;
		reg = <0x0 0x10001000 0x0 0x1000 0x0 0x10200000 0x0 0x4000 0x0 0x10228000 0x0 0x2000 0x0 0x1022a000 0x0 0x2000 0x0 0x10230000 0x0 0x2000 0x0 0x10232000 0x0 0x2000 0x0 0x1022d000 0x0 0x1000 0x0 0x10235000 0x0 0x1000>;
		reg-names = "infra_ao", "mcucfg", "ddrphy0_ao", "dramc0_ao", "ddrphy1_ao", "dramc1_ao", "emi_ch0", "emi_ch1";
	};

	devapc@10207000 {
		clock-names = "devapc-infra-clock";
		clocks = <0x22 0x28>;
		compatible = "mediatek,devapc";
		interrupts = <0x0 0x56 0x8>;
		reg = <0x0 0x10207000 0x0 0x1000>;
	};

	dfd@10200b00 {
		compatible = "mediatek,dfd";
		mediatek,chain_length = <0x61a8>;
		mediatek,check_dfd_support = <0x1>;
		mediatek,dfd_ap_addr_offset = <0x18>;
		mediatek,dfd_infra_base = <0x390>;
		mediatek,dfd_latch_offset = <0x48>;
		mediatek,enabled = <0x1>;
		mediatek,rg_dfd_timeout = <0xa0>;
		reg = <0x0 0x10200b00 0x0 0x10000>;
		reg_base = <0x43>;
	};

	disp_aal0@14011000 {
		compatible = "mediatek,disp_aal0";
		interrupts = <0x0 0xa6 0x8>;
		reg = <0x0 0x14011000 0x0 0x1000>;
	};

	disp_ccorr0@14010000 {
		compatible = "mediatek,disp_ccorr0";
		interrupts = <0x0 0xa5 0x8>;
		reg = <0x0 0x14010000 0x0 0x1000>;
	};

	disp_color0@1400f000 {
		compatible = "mediatek,disp_color0";
		interrupts = <0x0 0xa4 0x8>;
		phandle = <0x3f>;
		reg = <0x0 0x1400f000 0x0 0x1000>;
	};

	disp_dither0@14013000 {
		compatible = "mediatek,disp_dither0";
		interrupts = <0x0 0xa8 0x8>;
		reg = <0x0 0x14013000 0x0 0x1000>;
	};

	disp_gamma0@14012000 {
		compatible = "mediatek,disp_gamma0";
		interrupts = <0x0 0xa7 0x8>;
		reg = <0x0 0x14012000 0x0 0x1000>;
	};

	disp_mutex0@14001000 {
		compatible = "mediatek,disp_mutex0";
		interrupts = <0x0 0x9a 0x8>;
		phandle = <0x41>;
		reg = <0x0 0x14001000 0x0 0x1000>;
	};

	disp_ovl0@1400b000 {
		compatible = "mediatek,disp_ovl0";
		interrupts = <0x0 0xa1 0x8>;
		reg = <0x0 0x1400b000 0x0 0x1000>;
	};

	disp_ovl0_2l@1400c000 {
		compatible = "mediatek,disp_ovl0_2l";
		interrupts = <0x0 0xad 0x8>;
		reg = <0x0 0x1400c000 0x0 0x1000>;
	};

	disp_pwm@1100e000 {
		compatible = "mediatek,disp_pwm";
		reg = <0x0 0x1100e000 0x0 0x1000>;
	};

	disp_rdma0@1400d000 {
		compatible = "mediatek,disp_rdma0";
		interrupts = <0x0 0xa2 0x8>;
		reg = <0x0 0x1400d000 0x0 0x1000>;
	};

	disp_rsz0@14015000 {
		compatible = "mediatek,disp_rsz0";
		interrupts = <0x0 0xdc 0x8>;
		reg = <0x0 0x14015000 0x0 0x1000>;
	};

	disp_wdma0@1400e000 {
		compatible = "mediatek,disp_wdma0";
		interrupts = <0x0 0xa3 0x8>;
		reg = <0x0 0x1400e000 0x0 0x1000>;
	};

	dispsys {
		clock-names = "MMSYS_MTCMOS", "MMSYS_SMI_COMMON", "MMSYS_SMI_LARB0", "MMSYS_GALS_COMM0", "MMSYS_GALS_COMM1", "MMSYS_DISP_OVL0", "MMSYS_DISP_OVL0_2L", "MMSYS_DISP_RDMA0", "MMSYS_DISP_WDMA0", "MMSYS_DISP_COLOR0", "MMSYS_DISP_CCORR0", "MMSYS_DISP_AAL0", "MMSYS_DISP_GAMMA0", "MMSYS_DISP_DITHER0", "MMSYS_DSI0_MM_CK", "MMSYS_DSI0_IF_CK", "MMSYS_26M", "MMSYS_DISP_RSZ0", "APMIXED_MIPI_26M", "TOP_MUX_DISP_PWM", "DISP_PWM", "TOP_26M", "TOP_UNIVPLL2_D4", "TOP_ULPOSC1_D2", "TOP_ULPOSC1_D8";
		clocks = <0x34 0x3 0x10 0x13 0x10 0x14 0x10 0x15 0x10 0x16 0x10 0x7 0x10 0x8 0x10 0xa 0x10 0xb 0x10 0xc 0x10 0xd 0x10 0xe 0x10 0xf 0x10 0x10 0x10 0x11 0x10 0x1c 0x10 0x1d 0x10 0x9 0x20 0x13 0xf 0x7c 0x22 0x31 0x21 0xf 0x1e 0xf 0x2f 0xf 0x31>;
		compatible = "mediatek,dispsys";
		mediatek,larb = <0x31>;
	};

	dispsys_config@14000000 {
		clock-names = "CAM_MDP", "IMG_DL_RELAY", "IMG_DL_ASYNC_TOP";
		clocks = <0x10 0x17 0x10 0x1a 0x10 0x1b>;
		compatible = "mediatek,mmsys_config", "syscon";
		interrupts = <0x0 0xab 0x8>;
		phandle = <0x38>;
		reg = <0x0 0x14000000 0x0 0x1000>;
	};

	dma-controller@11000580 {
		#dma-bits = <0x22>;
		#dma-cells = <0x1>;
		clock-names = "apdma";
		clocks = <0x22 0x26>;
		compatible = "mediatek,mt6577-uart-dma";
		dma-requests = <0x4>;
		interrupts = <0x0 0x35 0x8 0x0 0x36 0x8 0x0 0x37 0x8 0x0 0x3c 0x8>;
		phandle = <0x45>;
		reg = <0x0 0x11000680 0x0 0x80 0x0 0x11000700 0x0 0x80 0x0 0x11000780 0x0 0x80 0x0 0x11000800 0x0 0x80>;
	};

	dram_ctrl {
		compatible = "mediatek,dram-qosctrl";
		required-opps = <0x2d 0x2e>;
	};

	dramc@1022a000 {
		compatible = "mediatek,dramc";
		reg = <0x0 0x1022a000 0x0 0x2000 0x0 0x10232000 0x0 0x2000 0x0 0x1022c000 0x0 0x1000 0x0 0x10234000 0x0 0x1000 0x0 0x10228000 0x0 0x2000 0x0 0x10230000 0x0 0x2000 0x0 0x1022e000 0x0 0x1000 0x0 0x10236000 0x0 0x1000>;
	};

	dsi0@14014000 {
		compatible = "mediatek,dsi0";
		interrupts = <0x0 0xa9 0x8>;
		reg = <0x0 0x14014000 0x0 0x1000>;
	};

	dsi_te {
		compatible = "mediatek, DSI_TE-eint";
		phandle = <0xd2>;
		status = "disabled";
	};

	dvfsp@00110c00 {
		compatible = "mediatek,mt6761-dvfsp";
		nvmem-cell-names = "efuse_segment_cell";
		nvmem-cells = <0x37>;
		reg = <0x0 0x110c00 0x0 0x1400 0x0 0x110c00 0x0 0x1400>;
	};

	dvfsp@10227000 {
		compatible = "mediatek,dvfsp";
		reg = <0x0 0x10227000 0x0 0x1000>;
	};

	dvfsrc@10012000 {
		#address-cells = <0x2>;
		#size-cells = <0x2>;
		compatible = "mediatek,mt6761-dvfsrc";
		phandle = <0x9f>;
		ranges;
		reg = <0x0 0x10012000 0x0 0x1000 0x0 0x10006000 0x0 0x1000>;
		reg-names = "dvfsrc", "spm";

		dvfsrc-debug {
			compatible = "mediatek,mt6761-dvfsrc-debug";
			required-opps = <0x2d 0x2e 0x2f>;
		};

		dvfsrc-met {
			compatible = "mediatek,mt6761-dvfsrc-met";
		};

		dvfsrc-up {
			compatible = "mediatek,mt6761-dvfsrc-up";
		};

		opp0 {
			opp-level = <0x0>;
			phandle = <0x2d>;
		};

		opp1 {
			opp-level = <0x1>;
			phandle = <0x2e>;
		};

		opp2 {
			opp-level = <0x2>;
			phandle = <0x2f>;
		};

		qos@00110b80 {
			compatible = "mediatek,mt6761-qos";
			reg = <0x0 0x110b80 0x0 0x80>;
		};
	};

	dxcc_sec@10210000 {
		compatible = "mediatek,dxcc_sec";
		interrupts = <0x0 0x6a 0x4>;
		reg = <0x0 0x10210000 0x0 0x1000>;
	};

	dynamic_options {
		compatible = "mediatek,dynamic_options";
		phandle = <0xe9>;
	};

	eem_fsm@1100b000 {
		compatible = "mediatek,eem_fsm";
		interrupts = <0x0 0x45 0x8>;
		nvmem = <0x44>;
		nvmem-cell-names = "efuse_segment_cell";
		nvmem-cells = <0x37>;
		nvmem-names = "mtk_efuse";
		reg = <0x0 0x1100b000 0x0 0x1000>;
	};

	efuse@11c50000 {
		#address-cells = <0x1>;
		#size-cells = <0x1>;
		compatible = "mediatek,devinfo";
		phandle = <0x44>;
		reg = <0x0 0x11c50000 0x0 0x10000>;

		efuse_analog7@1ac {
			phandle = <0xcb>;
			reg = <0x1ac 0x4>;
		};

		segment@190 {
			phandle = <0x47>;
			reg = <0x190 0xc>;
		};

		segment@1c {
			phandle = <0x46>;
			reg = <0x1c 0x4>;
		};

		segment@78 {
			phandle = <0x37>;
			reg = <0x78 0x4>;
		};

		u2_phy_data@1ac {
			phandle = <0x4c>;
			reg = <0x1ac 0x4>;
		};
	};

	efuse_dbg@10004000 {
		compatible = "mediatek,efuse_dbg";
		reg = <0x0 0x10004000 0x0 0x1000>;
	};

	eint@1000b000 {
		compatible = "mediatek,eint";
		phandle = <0x6e>;
		reg = <0x0 0x1000b000 0x0 0x1000>;
	};

	emi@10219000 {
		compatible = "mediatek,emi";
		interrupts = <0x0 0x58 0x8>;
		reg = <0x0 0x10219000 0x0 0x1000 0x0 0x10226000 0x0 0x1000 0x0 0x1022d000 0x0 0x1000 0x0 0x10235000 0x0 0x1000>;
	};

	eta6953 {
		compatible = "eta, eta6953_charger";
		phandle = <0xe0>;
	};

	extcon_usb {
		charger = <0x25>;
		compatible = "mediatek,extcon-usb";
		dev-conn = <0x61>;
		id-gpios = <0x1e 0x29 0x0>;
		mediatek,bypss-typec-sink = <0x1>;
		phandle = <0xe2>;
	};

	fdvt@1500b000 {
		clock-names = "FD_CLK_CAM_FDVT";
		clocks = <0x11 0x6>;
		compatible = "mediatek,fdvt";
		interrupts = <0x0 0xb6 0x8>;
		reg = <0x0 0x1500b000 0x0 0x1000>;
	};

	fhctl@1000ce00 {
		compatible = "mediatek,mt6761-fhctl";
		mediatek,apmixed = <0x20>;
		phandle = <0x72>;
		reg = <0x0 0x1000ce00 0x0 0x100>;

		armpll {
			mediatek,fh-cpu-pll;
			mediatek,fh-id = <0x0>;
			mediatek,fh-pll-id = <0x0>;
		};

		mainpll {
			mediatek,fh-id = <0x1>;
			mediatek,fh-pll-id = <0x1>;
		};

		mfgpll {
			mediatek,fh-id = <0x3>;
			mediatek,fh-pll-id = <0x2>;
		};

		mmpll {
			mediatek,fh-id = <0x6>;
			mediatek,fh-pll-id = <0x3>;
		};

		mpll {
			mediatek,fh-id = <0x5>;
			mediatek,fh-pll-id = <0x7>;
		};

		msdcpll {
			mediatek,fh-id = <0x2>;
			mediatek,fh-pll-id = <0x5>;
		};
	};

	flashlight_core {
		compatible = "mediatek,flashlight_core";
		phandle = <0xd6>;
	};

	flashlights_aw3644 {
		compatible = "mediatek,flashlights_aw3644";
		phandle = <0xd9>;
	};

	flashlights_mt6370 {
		compatible = "mediatek,flashlights_mt6370";
		decouple = <0x0>;
		phandle = <0xd8>;

		channel@1 {
			ct = <0x0>;
			part = <0x0>;
			type = <0x0>;
		};

		channel@2 {
			ct = <0x1>;
			part = <0x0>;
			type = <0x0>;
		};
	};

	flashlights_ocp8132 {
		compatible = "mediatek,flashlights_ocp8132";
		decouple = <0x1>;
		phandle = <0xd7>;

		channel@1 {
			ct = <0x0>;
			part = <0x0>;
			type = <0x0>;
		};

		channel@2 {
			ct = <0x1>;
			part = <0x0>;
			type = <0x0>;
		};
	};

	fpsensor_finger {
		compatible = "mediatek,fingerprint", "mediatek,goodix-fp";
		fpc,enable-wakeup;
		phandle = <0x9b>;
	};

	fpsensor_fp_eint {
		compatible = "mediatek,fpsensor_fp_eint";
		int-gpios = <0x1e 0x3 0x0>;
		phandle = <0x9a>;
	};

	gce@10238000 {
		ap_dma_base = <0x18010000 0x17 0xffff0000>;
		audio_base = <0x17000000 0x12 0xffff0000>;
		buf_underrun_event_0 = <0x8c>;
		camsv_0_pass1_done = <0x106>;
		camsv_1_pass1_done = <0x107>;
		camsys1_base = <0x180a0000 0x1c 0xffff0000>;
		camsys2_base = <0x180b0000 0x1d 0xffff0000>;
		camsys_base = <0x18080000 0x1b 0xffff0000>;
		clock-names = "GCE", "GCE_TIMER";
		clocks = <0x22 0x9 0x22 0x18>;
		compatible = "mediatek,gce", "syscon";
		conn_peri_base = <0x18820000 0x7 0xffff0000>;
		dip_cq_thread0_frame_done = <0x103>;
		dip_cq_thread1_frame_done = <0x102>;
		dip_cq_thread2_frame_done = <0x101>;
		disp_2l_ovl0_frame_done = <0x1c>;
		disp_2l_ovl0_sof = <0x8>;
		disp_aal0_frame_done = <0x22>;
		disp_aal0_sof = <0xd>;
		disp_ccorr0_frame_done = <0x21>;
		disp_ccorr0_sof = <0xc>;
		disp_color0_frame_done = <0x20>;
		disp_color0_sof = <0xb>;
		disp_dither0_frame_done = <0x24>;
		disp_dither0_sof = <0xf>;
		disp_dither_base = <0x14010000 0x2 0xffff0000>;
		disp_dsi0_frame_done = <0x25>;
		disp_dsi0_sof = <0x10>;
		disp_gamma0_frame_done = <0x23>;
		disp_gamma0_sof = <0xe>;
		disp_ovl0_frame_done = <0x1b>;
		disp_ovl0_frame_rst_done_pusle = <0x98>;
		disp_ovl0_sof = <0x7>;
		disp_pwm0_sof = <0x13>;
		disp_rdma0_frame_done = <0x1e>;
		disp_rdma0_sof = <0x9>;
		disp_rsz0_frame_done = <0x1d>;
		disp_rsz0_sof = <0x11>;
		disp_wdma0_frame_done = <0x1f>;
		disp_wdma0_rst_done = <0x93>;
		disp_wdma0_sof = <0xa>;
		dsi0_done_event = <0x8f>;
		dsi0_irq_event = <0x8e>;
		dsi0_te_event = <0x8d>;
		g3d_config_base = <0x13000000 0x0 0xffff0000>;
		gce_base = <0x18020000 0x18 0xffff0000>;
		gcpu_base = <0x10050000 0xf 0xffff0000>;
		img_dl_relay_sof = <0x12>;
		imgsys_base = <0x15020000 0x4 0xffff0000>;
		infra_na3_base = <0x10010000 0xb 0xffff0000>;
		infra_na4_base = <0x10020000 0xc 0xffff0000>;
		interrupts = <0x0 0x62 0x8>;
		isp_frame_done_p1_0 = <0x105>;
		isp_frame_done_p1_1 = <0x104>;
		jpgdec_done = <0x123>;
		jpgenc_done = <0x122>;
		kp_base = <0x18840000 0x9 0xffff0000>;
		max_prefetch_cnt = <0x1>;
		mboxes = <0x42 0x0 0x0 0x4 0x42 0x1 0x0 0x4 0x42 0x2 0x0 0x5 0x42 0x3 0x0 0x4 0x42 0x4 0x0 0x4 0x42 0x5 0x0 0x4 0x42 0x6 0xc8 0x3 0x42 0x7 0xffffffff 0x2 0x42 0x8 0x0 0x1 0x42 0x9 0x0 0x1 0x42 0xa 0x0 0x1 0x42 0xb 0x0 0x1 0x42 0xc 0x0 0x1 0x42 0xd 0x0 0x1 0x42 0xe 0x0 0x1 0x42 0xf 0x0 0x1>;
		mcucfg_base = <0x10040000 0xe 0xffff0000>;
		mdp_ccorr0 = <0x40>;
		mdp_ccorr0_frame_done = <0x15>;
		mdp_ccorr0_sof = <0x1>;
		mdp_color0 = <0x3f>;
		mdp_rdma0 = <0x39>;
		mdp_rdma0_frame_done = <0x14>;
		mdp_rdma0_rst_done = <0x97>;
		mdp_rdma0_sof = <0x0>;
		mdp_rsz0 = <0x3a>;
		mdp_rsz0_frame_done = <0x16>;
		mdp_rsz0_sof = <0x2>;
		mdp_rsz1 = <0x3b>;
		mdp_rsz1_frame_done = <0x17>;
		mdp_rsz1_sof = <0x3>;
		mdp_tdshp0 = <0x3e>;
		mdp_tdshp0_frame_done = <0x1a>;
		mdp_tdshp0_sof = <0x6>;
		mdp_wdma0 = <0x3c>;
		mdp_wdma_frame_done = <0x19>;
		mdp_wdma_rst_done = <0x94>;
		mdp_wdma_sof = <0x4>;
		mdp_wrot0 = <0x3d>;
		mdp_wrot0_rst_done = <0x95>;
		mdp_wrot0_sof = <0x5>;
		mdp_wrot0_write_frame_done = <0x18>;
		mediatek,mailbox-gce = <0x42>;
		mipitx0_base = <0x11c80000 0x63 0xffff0000>;
		mm_mutex = <0x41>;
		mm_na_base = <0x14020000 0x3 0xffff0000>;
		mmsys_config = <0x38>;
		mmsys_config_base = <0x14000000 0x1 0xffff0000>;
		msdc2_base = <0x17020000 0x14 0xffff0000>;
		msdc3_base = <0x18000000 0x16 0xffff0000>;
		phandle = <0xa5>;
		prefetch_size = <0x60>;
		pwm_sw_base = <0x1100e000 0x63 0xffff0000>;
		reg = <0x0 0x10238000 0x0 0x4000>;
		scp_base = <0x10030000 0xd 0xffff0000>;
		scp_sram_base = <0x10000000 0xa 0xffff0000>;
		secure_thread = <0x8 0xa>;
		seninf_0_fifo_full = <0x108>;
		seninf_1_fifo_full = <0x109>;
		seninf_2_fifo_full = <0x10a>;
		seninf_3_fifo_full = <0x10b>;
		seninf_4_fifo_full = <0x10c>;
		seninf_5_fifo_full = <0x10d>;
		seninf_6_fifo_full = <0x10e>;
		seninf_7_fifo_full = <0x10f>;
		sram_share_cnt = <0x1>;
		sram_share_engine = <0xa>;
		sram_share_event = <0x2c6>;
		sram_size_cpr_64 = <0x40>;
		stream_done_0 = <0x82>;
		stream_done_1 = <0x83>;
		stream_done_2 = <0x84>;
		stream_done_3 = <0x85>;
		stream_done_4 = <0x86>;
		stream_done_5 = <0x87>;
		stream_done_6 = <0x88>;
		stream_done_7 = <0x89>;
		stream_done_8 = <0x8a>;
		stream_done_9 = <0x8b>;
		thread_count = <0x10>;
		topckgen_base = <0x18830000 0x8 0xffff0000>;
		usb0_base = <0x10200000 0x10 0xffff0000>;
		usb_sif_base = <0x10280000 0x11 0xffff0000>;
		vdec1_base = <0x17030000 0x15 0xffff0000>;
		vdec2_base = <0x18040000 0x19 0xffff0000>;
		vdec3_base = <0x18050000 0x1a 0xffff0000>;
		vdec_base = <0x17010000 0x13 0xffff0000>;
		vdec_gcon_base = <0x18800000 0x5 0xffff0000>;
		venc_128byte_cnt_done = <0x125>;
		venc_done = <0x121>;
		venc_gcon_base = <0x18810000 0x6 0xffff0000>;
		venc_mb_done = <0x124>;
	};

	gce_mbox@10238000 {
		#gce-event-cells = <0x1>;
		#gce-subsys-cells = <0x2>;
		#mbox-cells = <0x3>;
		clock-names = "gce", "gce-timer";
		clocks = <0x22 0x9 0x22 0x18>;
		compatible = "mediatek,mt6761-gce";
		default_tokens = [02 bc 02 bd 02 be 02 bf 02 c0 02 c6 02 c7];
		interrupts = <0x0 0x62 0x8>;
		phandle = <0x42>;
		reg = <0x0 0x10238000 0x0 0x4000>;
	};

	ged {
		compatible = "mediatek,ged";
		gpufreq-supply = <0x5c>;
		phandle = <0x5b>;
	};

	gic500@0c000000 {
		compatible = "mediatek,gic500";
		reg = <0x0 0xc000000 0x0 0x400000>;
	};

	gic_cpu@0c400000 {
		compatible = "mediatek,gic_cpu";
		reg = <0x0 0xc400000 0x0 0x40000>;
	};

	gpio {
		compatible = "mediatek,gpio_usage_mapping";
		phandle = <0x6c>;
	};

	gpio@10005000 {
		compatible = "mediatek,gpio", "syscon";
		phandle = <0x16>;
		reg = <0x0 0x10005000 0x0 0x1000>;
	};

	gpufreq {
		clock-names = "clk_mux", "clk_main_parent", "clk_sub_parent", "mtcmos_mfg_async", "mtcmos_mfg", "mtcmos_mfg_core0";
		clocks = <0xf 0x6d 0xf 0x28 0x21 0x34 0x7 0x34 0x4 0x34 0x6>;
		compatible = "mediatek,mt6761-gpufreq";
		nvmem-cell-names = "efuse_segment_cell";
		nvmem-cells = <0x37>;
		phandle = <0x5c>;
		vcore-supply = <0x36>;
	};

	hacc@1000a000 {
		compatible = "mediatek,hacc";
		interrupts = <0x0 0x85 0x8>;
		reg = <0x0 0x1000a000 0x0 0x1000>;
	};

	hwrng {
		compatible = "mediatek,mt67xx-rng";
		phandle = <0xa1>;
	};

	i2c0@11007000 {
		aed = <0x1a>;
		clock-div = <0x5>;
		clock-names = "main", "dma";
		clocks = <0x22 0xb 0x22 0x26>;
		compatible = "mediatek,i2c";
		eh_cfg = <0x20>;
		gpio_start = <0x10002a00>;
		id = <0x0>;
		interrupts = <0x0 0x1c 0x8>;
		mediatek,hs_only;
		mem_len = <0x200>;
		phandle = <0xaa>;
		pu_cfg = <0x50>;
		reg = <0x0 0x11007000 0x0 0x1000 0x0 0x11000080 0x0 0x80>;
		rsel_cfg = <0x70>;
		scl-gpio-id = <0x53>;
		sda-gpio-id = <0x52>;
	};

	i2c1@11008000 {
		aed = <0x1a>;
		clock-div = <0x5>;
		clock-names = "main", "dma";
		clocks = <0x22 0xb 0x22 0x26>;
		compatible = "mediatek,i2c";
		eh_cfg = <0x20>;
		gpio_start = <0x10002a00>;
		id = <0x1>;
		interrupts = <0x0 0x1d 0x8>;
		mediatek,hs_only;
		mem_len = <0x200>;
		phandle = <0xab>;
		pu_cfg = <0x50>;
		reg = <0x0 0x11008000 0x0 0x1000 0x0 0x11000100 0x0 0x80>;
		rsel_cfg = <0x70>;
		scl-gpio-id = <0x54>;
		sda-gpio-id = <0x51>;
	};

	i2c2@11009000 {
		aed = <0x1a>;
		ch_offset_ccu = <0x200>;
		ch_offset_default = <0x100>;
		clock-div = <0x5>;
		clock-names = "main", "dma";
		clocks = <0x22 0xb 0x22 0x26>;
		compatible = "mediatek,i2c";
		eh_cfg = <0x20>;
		gpio_start = <0x10002800>;
		id = <0x2>;
		interrupts = <0x0 0x1e 0x8>;
		mediatek,hs_only;
		mem_len = <0x200>;
		phandle = <0xac>;
		pu_cfg = <0x60>;
		reg = <0x0 0x11009000 0x0 0x1000 0x0 0x11000180 0x0 0x180>;
		rsel_cfg = <0xa0>;
		scl-gpio-id = <0x67>;
		sda-gpio-id = <0x68>;
	};

	i2c3@1100f000 {
		aed = <0x1a>;
		ch_offset_default = <0x100>;
		clock-div = <0x5>;
		clock-names = "main", "dma";
		clocks = <0x22 0xb 0x22 0x26>;
		compatible = "mediatek,i2c";
		eh_cfg = <0x20>;
		gpio_start = <0x10002600>;
		id = <0x3>;
		interrupts = <0x0 0x1f 0x8>;
		mediatek,hs_only;
		mem_len = <0x200>;
		phandle = <0xad>;
		pu_cfg = <0x90>;
		reg = <0x0 0x1100f000 0x0 0x1000 0x0 0x11000300 0x0 0x100>;
		rsel_cfg = <0xb0>;
		scl-gpio-id = <0x32>;
		sda-gpio-id = <0x33>;
	};

	i2c4@11011000 {
		aed = <0x1a>;
		ch_offset_ccu = <0x200>;
		ch_offset_default = <0x100>;
		clock-div = <0x5>;
		clock-names = "main", "dma";
		clocks = <0x22 0xb 0x22 0x26>;
		compatible = "mediatek,i2c";
		eh_cfg = <0x20>;
		gpio_start = <0x10002800>;
		id = <0x4>;
		interrupts = <0x0 0x20 0x8>;
		mediatek,hs_only;
		mem_len = <0x200>;
		phandle = <0xae>;
		pu_cfg = <0x60>;
		reg = <0x0 0x11011000 0x0 0x1000 0x0 0x11000400 0x0 0x180>;
		rsel_cfg = <0xa0>;
		scl-gpio-id = <0x69>;
		sda-gpio-id = <0x6a>;
	};

	i2c5@11016000 {
		aed = <0x1a>;
		clock-div = <0x5>;
		clock-names = "main", "dma";
		clocks = <0x22 0xb 0x22 0x26>;
		compatible = "mediatek,i2c";
		eh_cfg = <0x20>;
		gpio_start = <0x10002600>;
		id = <0x5>;
		interrupts = <0x0 0x4a 0x8>;
		mediatek,hs_only;
		mem_len = <0x200>;
		phandle = <0xaf>;
		pu_cfg = <0x90>;
		reg = <0x0 0x11016000 0x0 0x1000 0x0 0x11000580 0x0 0x80>;
		rsel_cfg = <0xb0>;
		scl-gpio-id = <0x30>;
		sda-gpio-id = <0x31>;
	};

	i2c6@1100d000 {
		aed = <0x1a>;
		ch_offset_ccu = <0x200>;
		ch_offset_default = <0x100>;
		clock-div = <0x5>;
		clock-names = "main", "dma";
		clocks = <0x22 0xb 0x22 0x26>;
		compatible = "mediatek,i2c";
		eh_cfg = <0x20>;
		gpio_start = <0x10002c00>;
		id = <0x6>;
		interrupts = <0x0 0x4b 0x8>;
		mediatek,hs_only;
		mem_len = <0x200>;
		phandle = <0xb0>;
		pu_cfg = <0x50>;
		reg = <0x0 0x1100d000 0x0 0x1000 0x0 0x11000600 0x0 0x80>;
		rsel_cfg = <0x70>;
		scl-gpio-id = <0xa1>;
		sda-gpio-id = <0xa2>;
	};

	i2c7 {
		phandle = <0xb1>;
	};

	i2c8 {
		phandle = <0xb2>;
	};

	i2c9 {
		phandle = <0xb3>;
	};

	i2c_common {
		check_max_freq = [01];
		cnt_constraint = [01];
		compatible = "mediatek,i2c_common";
		dma_support = [02];
		ext_time_config = [18 01];
		idvfs = [01];
		phandle = <0xa9>;
		set_dt_div = [01];
		set_ltiming = [01];
		ver = [02];
	};

	imp_iic@11017000 {
		compatible = "mediatek,imp_iic";
		reg = <0x0 0x11017000 0x0 0x1000>;
	};

	infra_mbist@1020d000 {
		compatible = "mediatek,infra_mbist";
		reg = <0x0 0x1020d000 0x0 0x1000>;
	};

	infracfg@1020e000 {
		compatible = "mediatek,infracfg";
		reg = <0x0 0x1020e000 0x0 0x1000>;
	};

	infracfg_ao@10001000 {
		#clock-cells = <0x1>;
		compatible = "mediatek,common-infracfg_ao", "mediatek,infracfg_ao", "mediatek,mt6761-infracfg", "syscon";
		interrupts = <0x0 0x5b 0x1>;
		phandle = <0x22>;
		reg = <0x0 0x10001000 0x0 0x1000>;
	};

	interrupt-controller@0c000000 {
		#address-cells = <0x2>;
		#interrupt-cells = <0x3>;
		#redistributor-regions = <0x1>;
		#size-cells = <0x2>;
		compatible = "arm,gic-v3";
		interrupt-controller;
		interrupt-parent = <0xe>;
		interrupts = <0x1 0x9 0x4>;
		phandle = <0xe>;
		reg = <0x0 0xc000000 0x0 0x40000 0x0 0xc080000 0x0 0x200000 0x0 0x10200a80 0x0 0x50>;
	};

	intpol-controller@10200a80 {
		#interrupt-cells = <0x3>;
		compatible = "mediatek,mt6577-sysirq";
		interrupt-controller;
		interrupt-parent = <0xe>;
		phandle = <0x1>;
		reg = <0x0 0x10200a80 0x0 0x50>;
	};

	io_cfg_bl@10002600 {
		compatible = "mediatek,io_cfg_bl";
		phandle = <0x1a>;
		reg = <0x0 0x10002600 0x0 0x200>;
	};

	io_cfg_lb@10002400 {
		compatible = "mediatek,io_cfg_lb";
		phandle = <0x19>;
		reg = <0x0 0x10002400 0x0 0x200>;
	};

	io_cfg_lm@10002200 {
		compatible = "mediatek,io_cfg_lm";
		phandle = <0x18>;
		reg = <0x0 0x10002200 0x0 0x200>;
	};

	io_cfg_lt@10002000 {
		compatible = "mediatek,io_cfg_lt";
		phandle = <0x17>;
		reg = <0x0 0x10002000 0x0 0x200>;
	};

	io_cfg_rb@10002a00 {
		compatible = "mediatek,io_cfg_rb";
		phandle = <0x1c>;
		reg = <0x0 0x10002a00 0x0 0x200>;
	};

	io_cfg_rr@10002800 {
		compatible = "mediatek,io_cfg_rr";
		phandle = <0x1b>;
		reg = <0x0 0x10002800 0x0 0x200>;
	};

	io_cfg_rt@10002c00 {
		compatible = "mediatek,io_cfg_rt";
		phandle = <0x1d>;
		reg = <0x0 0x10002c00 0x0 0x200>;
	};

	iocfg_0@10002000 {
		compatible = "mediatek,iocfg_0";
		reg = <0x0 0x10002000 0x0 0x200>;
	};

	iocfg_1@10002200 {
		compatible = "mediatek,iocfg_1";
		reg = <0x0 0x10002200 0x0 0x200>;
	};

	iocfg_2@10002400 {
		compatible = "mediatek,iocfg_2";
		reg = <0x0 0x10002400 0x0 0x200>;
	};

	iocfg_3@10002600 {
		compatible = "mediatek,iocfg_3";
		reg = <0x0 0x10002600 0x0 0x200>;
	};

	iocfg_4@10002800 {
		compatible = "mediatek,iocfg_4";
		reg = <0x0 0x10002800 0x0 0x200>;
	};

	iocfg_5@10002a00 {
		compatible = "mediatek,iocfg_5";
		reg = <0x0 0x10002a00 0x0 0x200>;
	};

	irq_nfc {
		compatible = "mediatek,irq_nfc-eint";
		phandle = <0xcf>;
	};

	ispsys@15000000 {
		clock-names = "CG_SCP_SYS_DIS", "CG_SCP_SYS_CAM", "CG_CAM_LARB2", "CG_CAM", "CG_CAMTG", "CG_CAM_SENINF", "CG_CAMSV0", "CG_CAMSV1", "CG_MM_SMI_COMM0", "CG_MM_SMI_COMM1", "CG_MM_SMI_COMMON";
		clocks = <0x34 0x3 0x34 0x8 0x11 0x0 0x11 0x1 0x11 0x2 0x11 0x3 0x11 0x4 0x11 0x5 0x10 0x15 0x10 0x16 0x10 0x13>;
		compatible = "mediatek,mt6761-ispsys";
		interrupts = <0x0 0xb3 0x8 0x0 0xb4 0x8 0x0 0xb5 0x8 0x0 0xb8 0x8 0x0 0xb9 0x8 0x0 0xba 0x8 0x0 0xbb 0x8>;
		reg = <0x0 0x15004000 0x0 0x9000 0x0 0x1500d000 0x0 0x1000 0x0 0x15000000 0x0 0x52000 0x0 0x15040000 0x0 0x8000 0x0 0x10215000 0x0 0x3000 0x0 0x10211000 0x0 0x1000>;
	};

	kd_camera_hw1@15040000 {
		clock-names = "CLK_TOP_CAMTG_SEL", "CLK_TOP_CAMTG1_SEL", "CLK_TOP_CAMTG2_SEL", "CLK_TOP_CAMTG3_SEL", "CLK_MCLK_6M", "CLK_MCLK_12M", "CLK_MCLK_13M", "CLK_MCLK_48M", "CLK_MCLK_52M", "CLK_MCLK_24M", "CLK_MCLK_26M", "CLK_CAM_SENINF_CG", "CLK_MIPI_C0_26M_CG", "CLK_MIPI_C1_26M_CG", "CLK_MIPI_ANA_0A_CG", "CLK_TOP_CAMTM_SEL_CG", "CLK_TOP_CAMTM_208_CG", "CLK_SCP_SYS_CAM";
		clocks = <0xf 0x6f 0xf 0x70 0xf 0x71 0xf 0x72 0xf 0x16 0xf 0x15 0xf 0x20 0xf 0x13 0xf 0x1f 0xf 0x14 0x21 0x11 0x3 0x20 0xc 0x20 0x10 0x5d 0x0 0xf 0x86 0xf 0x1d 0x34 0x8>;
		compatible = "mediatek,camera_hw";
		phandle = <0xd4>;
		reg = <0x0 0x15040000 0x0 0x1000>;
	};

	kp@10010000 {
		clock-names = "kpd";
		clocks = <0x21>;
		compatible = "mediatek,kp";
		interrupts = <0x0 0x7c 0x2>;
		phandle = <0x13>;
		reg = <0x0 0x10010000 0x0 0x1000>;
	};

	l2c_parity {
		compatible = "mediatek,l2c_parity-v1";
		interrupts = <0x0 0x0 0x4>;
	};

	lk_charger {
		ac_charger_current = <0x16e360>;
		ac_charger_input_current = <0x30d400>;
		charging_host_charger_current = <0x16e360>;
		compatible = "mediatek,lk_charger";
		enable_anime;
		enable_pd20_reset;
		enable_pe_plus;
		fast_charge_voltage = <0x2dc6c0>;
		max_charger_voltage = <0x632ea0>;
		non_std_ac_charger_current = <0xf9060>;
		pd_charger_current = <0x7a120>;
		phandle = <0xdd>;
		power_path_support;
		ta_ac_charger_current = <0x2dc6c0>;
		temp_t1_threshold = <0x0>;
		temp_t2_threshold = <0xf>;
		temp_t3_threshold = <0x30>;
		temp_t4_threshold = <0x3a>;
		usb_charger_current = <0x7a120>;
	};

	m4u@10205000 {
		#iommu-cells = <0x1>;
		cell-index = <0x0>;
		compatible = "mediatek,iommu_v0";
		interrupts = <0x0 0x66 0x8>;
		mediatek,larbs = <0x31 0x32 0x33>;
		phandle = <0x63>;
		reg = <0x0 0x10205000 0x0 0x1000>;
	};

	mbist@17050000 {
		compatible = "mediatek,mbist";
		reg = <0x0 0x17050000 0x0 0x10000>;
	};

	mbist_ao@10013000 {
		compatible = "mediatek,mbist_ao";
		reg = <0x0 0x10013000 0x0 0x1000>;
	};

	mcdi@00110100 {
		compatible = "mediatek,mt6761-mcdi";
		reg = <0x0 0x110100 0x0 0x800>;
	};

	mcucfg@10200000 {
		compatible = "mediatek,mcucfg";
		interrupts = <0x0 0x0 0x4>;
		reg = <0x0 0x10200000 0x0 0x200>;
	};

	mcucfg@10200200 {
		compatible = "mediatek,mcucfg";
		interrupts = <0x0 0x1 0x8>;
		reg = <0x0 0x10200200 0x0 0x200>;
	};

	mcucfg@10200400 {
		compatible = "mediatek,mcucfg";
		interrupts = <0x0 0x2 0x4>;
		reg = <0x0 0x10200400 0x0 0x200>;
	};

	mcucfg@10200600 {
		compatible = "mediatek,mcucfg";
		interrupts = <0x0 0x3 0x4>;
		reg = <0x0 0x10200600 0x0 0x200>;
	};

	mcucfg@10200800 {
		compatible = "mediatek,mcucfg";
		interrupts = <0x0 0x4 0x4>;
		reg = <0x0 0x10200800 0x0 0x200>;
	};

	mcucfg@10200a00 {
		compatible = "mediatek,mcucfg";
		interrupts = <0x0 0x5 0x8>;
		reg = <0x0 0x10200a00 0x0 0x300>;
	};

	mcucfg@10200f00 {
		compatible = "mediatek,mcucfg";
		interrupts = <0x0 0x6 0x8>;
		reg = <0x0 0x10200f00 0x0 0x100>;
	};

	mcucfg@10201000 {
		compatible = "mediatek,mcucfg";
		interrupts = <0x0 0x7 0x8>;
		reg = <0x0 0x10201000 0x0 0x1000>;
	};

	mcucfg@10202000 {
		compatible = "mediatek,mcucfg";
		interrupts = <0x0 0x8 0x8>;
		reg = <0x0 0x10202000 0x0 0x1000>;
	};

	mcucfg@10203000 {
		compatible = "mediatek,mcucfg";
		interrupts = <0x0 0x9 0x8>;
		reg = <0x0 0x10203000 0x0 0x1000>;
	};

	mcucfg_mp0_counter@10200000 {
		compatible = "mediatek,mcucfg_mp0_counter";
		reg = <0x0 0x10200000 0x0 0x4000>;
	};

	mcupm_reg@10216000 {
		compatible = "mediatek,mcupm_reg";
		reg = <0x0 0x10216000 0x0 0x1000>;
	};

	mcupm_sram0@10217000 {
		compatible = "mediatek,mcupm_sram0";
		reg = <0x0 0x10217000 0x0 0x1000>;
	};

	mcupm_sram1@10218000 {
		compatible = "mediatek,mcupm_sram1";
		reg = <0x0 0x10218000 0x0 0x1000>;
	};

	mcupm_sram2@10211000 {
		compatible = "mediatek,mcupm_sram2";
		reg = <0x0 0x10211000 0x0 0x1000>;
	};

	mcupm_sram3@10213000 {
		compatible = "mediatek,mcupm_sram3";
		reg = <0x0 0x10213000 0x0 0x1000>;
	};

	md1_sim1_hot_plug_eint {
		phandle = <0x6a>;
	};

	md1_sim2_hot_plug_eint {
		phandle = <0x6b>;
	};

	md_auxadc {
		compatible = "mediatek,md_auxadc";
		io-channel-names = "md-channel", "md-battery";
		io-channels = <0x27 0x2>;
		phandle = <0xa4>;
	};

	md_ccif0@1020a000 {
		compatible = "mediatek,md_ccif0";
		reg = <0x0 0x1020a000 0x0 0x1000>;
	};

	md_ccif1@1020c000 {
		compatible = "mediatek,md_ccif1";
		reg = <0x0 0x1020c000 0x0 0x1000>;
	};

	md_ccif2@1023d000 {
		compatible = "mediatek,md_ccif2";
		reg = <0x0 0x1023d000 0x0 0x1000>;
	};

	md_ccif3@1023f000 {
		compatible = "mediatek,md_ccif3";
		reg = <0x0 0x1023f000 0x0 0x1000>;
	};

	mdcldmain@1021c000 {
		compatible = "mediatek,mdcldmain";
		reg = <0x0 0x1021c000 0x0 0x400>;
	};

	mdcldmain_ao@10015000 {
		compatible = "mediatek,mdcldmain_ao";
		reg = <0x0 0x10015000 0x0 0x400>;
	};

	mdcldmamisc@1021c800 {
		compatible = "mediatek,mdcldmamisc";
		reg = <0x0 0x1021c800 0x0 0x1000>;
	};

	mdcldmamisc_ao@10015800 {
		compatible = "mediatek,mdcldmamisc_ao";
		reg = <0x0 0x10015800 0x0 0x400>;
	};

	mdcldmaout@1021c400 {
		compatible = "mediatek,mdcldmaout";
		reg = <0x0 0x1021c400 0x0 0x400>;
	};

	mdcldmaout_ao@10015400 {
		compatible = "mediatek,mdcldmaout_ao";
		reg = <0x0 0x10015400 0x0 0x400>;
	};

	mddriver@10014000 {
		_vcore-supply = <0x36>;
		_vmodem-supply = <0x35>;
		ccci-infracfg = <0x22>;
		clock-names = "scp-sys-md1-main", "infra-cldma-bclk", "infra-ccif-ap", "infra-ccif-md", "infra-ccif1-ap", "infra-ccif1-md", "infra-ccif2-ap", "infra-ccif2-md";
		clocks = <0x34 0x0 0x22 0x32 0x22 0x29 0x22 0x2c 0x22 0x23 0x22 0x24 0x22 0x58 0x22 0x59>;
		compatible = "mediatek,mddriver", "mediatek,mddriver-mt6761";
		interrupts = <0x0 0x6d 0x4 0x0 0x5c 0x8 0x0 0x5d 0x8 0x0 0xcd 0x2>;
		mediatek,ap_plat_info = <0x1a69>;
		mediatek,cldma_capability = <0x6>;
		mediatek,md_generation = <0x1895>;
		mediatek,md_id = <0x0>;
		mediatek,mdhif_type = <0x3>;
		mediatek,offset_apon_md1 = <0x1c24>;
		phandle = <0x15>;
		reg = <0x0 0x10014000 0x0 0x1000 0x0 0x1021b000 0x0 0x1000 0x0 0x10209000 0x0 0x1000 0x0 0x1020a000 0x0 0x1000>;
	};

	mdp_ccorr0@14005000 {
		clock-names = "MDP_CCORR";
		clocks = <0x10 0x1>;
		compatible = "mediatek,mdp_ccorr0";
		interrupts = <0x0 0xaa 0x8>;
		phandle = <0x40>;
		reg = <0x0 0x14005000 0x0 0x1000>;
	};

	mdp_rdma0@14004000 {
		clock-names = "MDP_RDMA0";
		clocks = <0x10 0x0>;
		compatible = "mediatek,mdp_rdma0";
		interrupts = <0x0 0x9b 0x8>;
		phandle = <0x39>;
		reg = <0x0 0x14004000 0x0 0x1000>;
	};

	mdp_rsz0@14006000 {
		clock-names = "MDP_RSZ0";
		clocks = <0x10 0x2>;
		compatible = "mediatek,mdp_rsz0";
		interrupts = <0x0 0x9c 0x8>;
		phandle = <0x3a>;
		reg = <0x0 0x14006000 0x0 0x1000>;
	};

	mdp_rsz1@14007000 {
		clock-names = "MDP_RSZ1";
		clocks = <0x10 0x3>;
		compatible = "mediatek,mdp_rsz1";
		interrupts = <0x0 0x9d 0x8>;
		phandle = <0x3b>;
		reg = <0x0 0x14007000 0x0 0x1000>;
	};

	mdp_tdshp0@1400a000 {
		clock-names = "MDP_TDSHP";
		clocks = <0x10 0x4>;
		compatible = "mediatek,mdp_tdshp0";
		phandle = <0x3e>;
		reg = <0x0 0x1400a000 0x0 0x1000>;
	};

	mdp_wdma0@14008000 {
		clock-names = "MDP_WDMA";
		clocks = <0x10 0x6>;
		compatible = "mediatek,mdp_wdma0";
		interrupts = <0x0 0xa0 0x8>;
		phandle = <0x3c>;
		reg = <0x0 0x14008000 0x0 0x1000>;
	};

	mdp_wrot0@14009000 {
		clock-names = "MDP_WROT0";
		clocks = <0x10 0x5>;
		compatible = "mediatek,mdp_wrot0";
		interrupts = <0x0 0x9f 0x8>;
		phandle = <0x3d>;
		reg = <0x0 0x14009000 0x0 0x1000>;
	};

	memory {
		device_type = "memory";
		reg = <0x0 0x40000000 0x0 0x20000000>;
	};

	mfg_cfg@13ffe000 {
		#clock-cells = <0x1>;
		compatible = "mediatek,mfgcfg", "syscon";
		phandle = <0xcd>;
		reg = <0x0 0x13ffe000 0x0 0x1000>;
	};

	mfg_clark@13000000 {
		clock-frequency = <0x21f98280>;
		compatible = "mediatek,clark";
		ged-supply = <0x5b>;
		interrupt-names = "RGX";
		interrupts = <0x0 0xcb 0x8>;
		phandle = <0xcc>;
		reg = <0x0 0x13000000 0x0 0x80000>;
	};

	mipi_rx_ana_csi0a@11c10000 {
		#clock-cells = <0x1>;
		compatible = "mediatek,mt6761-mipi0a", "syscon";
		phandle = <0x5d>;
		reg = <0x0 0x11c10000 0x0 0x1000>;
	};

	mipi_rx_ana_csi0b@11c11000 {
		#clock-cells = <0x1>;
		compatible = "mediatek,mt6761-mipi0b", "syscon";
		phandle = <0xc6>;
		reg = <0x0 0x11c11000 0x0 0x1000>;
	};

	mipi_rx_ana_csi1@11c20000 {
		compatible = "mediatek,mipi_rx_ana_csi1";
		reg = <0x0 0x11c20000 0x0 0x10000>;
	};

	mipi_rx_ana_csi1a@11c12000 {
		#clock-cells = <0x1>;
		compatible = "mediatek,mt6761-mipi1a", "syscon";
		phandle = <0xc7>;
		reg = <0x0 0x11c12000 0x0 0x1000>;
	};

	mipi_rx_ana_csi1b@11c13000 {
		#clock-cells = <0x1>;
		compatible = "mediatek,mt6761-mipi1b", "syscon";
		phandle = <0xc8>;
		reg = <0x0 0x11c13000 0x0 0x1000>;
	};

	mipi_rx_ana_csi2@11c30000 {
		compatible = "mediatek,mipi_rx_ana_csi2";
		reg = <0x0 0x11c30000 0x0 0x10000>;
	};

	mipi_rx_ana_csi2a@11c14000 {
		#clock-cells = <0x1>;
		compatible = "mediatek,mt6761-mipi2a", "syscon";
		phandle = <0xc9>;
		reg = <0x0 0x11c14000 0x0 0x1000>;
	};

	mipi_rx_ana_csi2b@11c15000 {
		#clock-cells = <0x1>;
		compatible = "mediatek,mt6761-mipi2b", "syscon";
		phandle = <0xca>;
		reg = <0x0 0x11c15000 0x0 0x1000>;
	};

	mipi_tx0@11c80000 {
		compatible = "mediatek,mipi_tx0";
		reg = <0x0 0x11c80000 0x0 0x10000>;
	};

	mm_mutex@14016000 {
		compatible = "mediatek,mm_mutex";
		phandle = <0xd3>;
		reg = <0x0 0x14016000 0x0 0x1000>;
	};

	mmdvfs_pmqos {
		cam_freq = "mm_step0", "mm_step1", "mm_step2";
		clock-names = "mmdvfs_clk_mm_sel_ck", "mmdvfs_clk_mmpll_ck", "mmdvfs_clk_univpll1_d2_ck", "mmdvfs_clk_mmpll_d2_ck";
		clocks = <0xf 0x6b 0xf 0x24 0xf 0x1a 0xf 0x25>;
		compatible = "mediatek,mmdvfs_pmqos";
		disp_freq = "mm_step0", "mm_step1", "mm_step2";
		img_freq = "mm_step0", "mm_step1", "mm_step2";
		mdp_freq = "mm_step0", "mm_step1", "mm_step2";
		mm_step0 = <0x1b4 0x1 0x0 0x1>;
		mm_step0_ext = <0x1b4 0x2 0x6 0x10c4ec>;
		mm_step1 = <0x138 0x1 0x0 0x2>;
		mm_step1_ext = <0x138 0x2 0x6 0x10c4ec>;
		mm_step2 = <0xe3 0x1 0x0 0x3>;
		mm_step2_ext = <0xe3 0x2 0x6 0x117627>;
		vdec_freq = "mm_step0", "mm_step1", "mm_step2";
		venc_freq = "mm_step0", "mm_step1", "mm_step2";
		vopp_steps = <0x0 0x1 0x3>;
	};

	mmsys_config@14000000 {
		#clock-cells = <0x1>;
		compatible = "mediatek,mt6761-mmsys_config", "syscon";
		interrupts = <0x0 0xab 0x8>;
		phandle = <0x10>;
		reg = <0x0 0x14000000 0x0 0x1000>;
	};

	mobicore {
		compatible = "trustonic,mobicore";
		interrupts = <0x0 0xc2 0x1>;
	};

	modem_temp_share@10018000 {
		compatible = "mediatek,modem_temp_share";
		reg = <0x0 0x10018000 0x0 0x1000>;
	};

	mrdump_ext_rst {
		compatible = "mediatek, mrdump_ext_rst-eint";
		force_mode = "EINT";
		mode = "IRQ";
		phandle = <0x97>;
		status = "okay";
	};

	msdc0_pad_macro@11cd0000 {
		compatible = "mediatek,msdc0_pad_macro";
		reg = <0x0 0x11cd0000 0x0 0x10000>;
	};

	msdc0_top@11cd0000 {
		compatible = "mediatek,msdc0_top";
		reg = <0x0 0x11cd0000 0x0 0x1000>;
	};

	msdc1_ins@0 {
		compatible = "mediatek,mt6761-sdcard-ins";
		phandle = <0xc3>;
	};

	msdc1_pad_macro@11c90000 {
		compatible = "mediatek,msdc1_pad_macro";
		reg = <0x0 0x11c90000 0x0 0x10000>;
	};

	msdc1_top@11c90000 {
		compatible = "mediatek,msdc1_top";
		reg = <0x0 0x11c90000 0x0 0x1000>;
	};

	msdc@11230000 {
		bootable;
		bus-width = <0x8>;
		cap-mmc-highspeed;
		clk_src = [01];
		clock-names = "msdc0-clock", "msdc0-hclock", "msdc0-aes-clock";
		clocks = <0x22 0x4f 0x22 0x1c 0x22 0x45>;
		compatible = "mediatek,msdc";
		host_function = [00];
		index = [00];
		infracfg = <0x22>;
		interrupts = <0x0 0x17 0x8>;
		max-frequency = <0xbebc200>;
		mmc-ddr-1_8v;
		mmc-hs200-1_8v;
		mmc-hs400-1_8v;
		no-sd;
		no-sdio;
		non-removable;
		phandle = <0xbf>;
		pinctl = <0x4d>;
		pinctl_hs200 = <0x4f>;
		pinctl_hs400 = <0x4e>;
		reg = <0x0 0x11230000 0x0 0x10000>;
		register_setting = <0x50>;
		status = "okay";
		topckgen = <0xf>;
		vmmc-supply = <0x51>;
	};

	msdc@11240000 {
		bus-width = <0x4>;
		cap-sd-highspeed;
		cd-gpios = <0x1e 0x1 0x0>;
		cd_level = [01];
		clk_src = [02];
		clock-names = "msdc1-clock", "msdc1-hclock";
		clocks = <0x22 0x50 0x22 0x1d>;
		compatible = "mediatek,msdc";
		host_function = [01];
		index = [01];
		interrupts = <0x0 0x18 0x8>;
		max-frequency = <0xbebc200>;
		mediatek,pwrap-regmap = <0x12>;
		no-mmc;
		no-sdio;
		phandle = <0xc0>;
		pinctl = <0x52>;
		pinctl_ddr50 = <0x55>;
		pinctl_sdr104 = <0x53>;
		pinctl_sdr50 = <0x54>;
		reg = <0x0 0x11240000 0x0 0x10000>;
		register_setting = <0x56>;
		sd-uhs-ddr50;
		sd-uhs-sdr104;
		sd-uhs-sdr12;
		sd-uhs-sdr25;
		sd-uhs-sdr50;
		status = "okay";
		vmmc-supply = <0x57>;
		vqmmc-supply = <0x58>;
	};

	msdc@11250000 {
		compatible = "mediatek,msdc2";
		phandle = <0xc1>;
		reg = <0x0 0x11250000 0x0 0x10000>;
		status = "disable";
	};

	msdc@11260000 {
		compatible = "mediatek,msdc3";
		phandle = <0xc2>;
		reg = <0x0 0x11250000 0x0 0x10000>;
		status = "disable";
	};

	mt6370_pmu_dts {
		#interrupt-cells = <0x1>;
		interrupt-controller;
		mt6370,intr_gpio = <0x1e 0x3 0x0>;
		mt6370,intr_gpio_num = <0x3>;
		phandle = <0xeb>;

		bled {
			compatible = "mediatek,mt6370_pmu_bled";
			interrupt-names = "bled_ocp";
			mt,bl_ocp_level = <0x2>;
			mt,bl_ovp_level = <0x3>;
			mt,bled_curr_scale = <0x0>;
			mt,bled_flash_ramp = <0x1>;
			mt,bled_name = "mt6370_pmu_bled";
			mt,bled_ramptime = <0x3>;
			mt,chan_en = <0xf>;
			mt,map_linear;
			mt,max_bled_brightness = <0x200>;
			mt,pwm_avg_cycle = <0x0>;
			mt,pwm_deglitch = <0x1>;
			mt,pwm_fsample = <0x2>;
			mt,pwm_hys = <0x0>;
			mt,pwm_hys_en = <0x1>;
			mt,pwm_lpf_coef = <0x0>;
			mt,use_pwm;
		};

		charger {
			aicr = <0x7a120>;
			bc12_sel = <0x0>;
			bootmode = <0x26>;
			charger = <0x64>;
			charger_name = "primary_chg";
			compatible = "mediatek,mt6370_pmu_charger";
			cv = <0x426030>;
			dc_wdt = <0x3d0900>;
			enable_otg_wdt;
			enable_te;
			enable_wdt;
			ichg = <0x1e8480>;
			ieoc = <0x249f0>;
			interrupt-names = "chg_mivr", "chg_aiclmeasi", "attachi", "ovpctrl_uvp_d_evt", "chg_wdtmri", "chg_vbusov", "chg_tmri", "chg_treg", "dcdti";
			ircmp_resistor = <0x61a8>;
			ircmp_vclamp = <0x7d00>;
			lbp_dt = <0x1>;
			lbp_hys_sel = <0x1>;
			load_switch_name = "primary_load_switch";
			mivr = <0x432380>;
			phandle = <0x64>;
			safety_timer = <0xc>;

			usb-otg-vbus {
				phandle = <0xec>;
				regulator-compatible = "usb-otg-vbus";
				regulator-max-microamp = <0x2dc6c0>;
				regulator-max-microvolt = <0x588040>;
				regulator-min-microamp = <0x7a120>;
				regulator-min-microvolt = <0x426030>;
				regulator-name = "usb-otg-vbus";
			};
		};

		core {
			compatible = "mediatek,mt6370_pmu_core";
			i2cstmr_rst_tmr = <0x0>;
			int_deg = <0x0>;
			int_wdt = <0x0>;
			interrupt-names = "otp", "vdda_ovp", "vdda_uv";
			mrstb_en;
			mrstb_tmr = <0x3>;
		};

		dsv {
			compatible = "mediatek,mt6370_pmu_dsv";
			db_delay = <0x3>;
			db_ext_en = <0x0>;
			db_freq_pm = <0x0>;
			db_periodic_fix = <0x0>;
			db_periodic_mode = <0x0>;
			db_single_pin = <0x0>;
			db_startup = <0x0>;
			db_vbst = <0x1644>;
			db_vneg_20ms = <0x1>;
			db_vneg_disc = <0x0>;
			db_vneg_slew = <0x1>;
			db_vpos_20ms = <0x1>;
			db_vpos_disc = <0x1>;
			db_vpos_slew = <0x1>;
			interrupt-names = "dsv_vneg_ocp", "dsv_vpos_ocp", "dsv_bst_ocp", "dsv_vneg_scp", "dsv_vpos_scp";

			mt6370_dsvn {
				regulator-max-microvolt = <0x5b8d80>;
				regulator-min-microvolt = <0x3d0900>;
				regulator-name = "dsv_neg";
			};

			mt6370_dsvp {
				regulator-max-microvolt = <0x5b8d80>;
				regulator-min-microvolt = <0x3d0900>;
				regulator-name = "dsv_pos";
			};
		};

		ldo {
			compatible = "mediatek,mt6370_pmu_ldo";
			interrupt-names = "ldo_oc";
			ldo_oms = <0x1>;
			ldo_vrc_lt = <0x1>;

			mt6370_ldo {
				regulator-max-microvolt = <0x3d0900>;
				regulator-min-microvolt = <0x186a00>;
				regulator-name = "irtx_ldo";
			};
		};

		mt6370_pmu_fled1 {
			compatible = "mediatek,mt6370_pmu_fled1";
			fled_enable = <0x1>;
			interrupt-names = "fled_lvf", "fled2_short", "fled1_short";
			strobe_cur = <0x124f80>;
			strobe_timeout = <0x960>;
			torch_cur = <0x493e0>;
		};

		mt6370_pmu_fled2 {
			compatible = "mediatek,mt6370_pmu_fled2";
			fled_enable = <0x1>;
			strobe_cur = <0xf4240>;
			strobe_timeout = <0x4b0>;
			torch_cur = <0x30d40>;
		};

		rgbled {
			compatible = "mediatek,mt6370_pmu_rgbled";
			interrupt-names = "isink4_short", "isink3_short", "isink2_short", "isink1_short", "isink4_open", "isink3_open", "isink2_open", "isink1_open";
			mt,led_default_trigger = "cc_mode", "cc_mode", "cc_mode", "none";
			mt,led_name = "mt6370_pmu_led1", "mt6370_pmu_led2", "mt6370_pmu_led3", "mt6370_pmu_led4";
		};
	};

	mt6370_pmu_eint {
		phandle = <0xe4>;
	};

	mt_soc_anc_pcm {
		compatible = "mediatek,mt_soc_pcm_anc";
	};

	mt_soc_codec_dummy_name {
		compatible = "mediatek,mt_soc_codec_dummy";
	};

	mt_soc_dai_name {
		compatible = "mediatek,mt_soc_dai_stub";
	};

	mt_soc_deep_buffer_dl_pcm {
		compatible = "mediatek,mt_soc_pcm_deep_buffer_dl";
	};

	mt_soc_dl1_awb_pcm {
		compatible = "mediatek,mt_soc_pcm_dl1_awb";
	};

	mt_soc_dl1_pcm@11220000 {
		clock-names = "aud_afe_clk", "aud_dac_clk", "aud_dac_predis_clk", "aud_adc_clk", "aud_apll22m_clk", "aud_apll1_tuner_clk", "aud_tml_clk", "aud_infra_clk", "mtkaif_26m_clk", "top_mux_audio", "top_mux_audio_int", "top_sys_pll1_d4", "top_mux_aud_1", "top_apll1_ck", "top_mux_aud_eng1", "top_apll1_d8", "apmixed_apll1", "top_clk26m_clk";
		clocks = <0x5a 0x0 0x5a 0x4 0x5a 0x5 0x5a 0x3 0x5a 0x1 0x5a 0x2 0x5a 0x6 0x22 0x2b 0x22 0x33 0xf 0x78 0xf 0x79 0xf 0x5 0xf 0x7a 0xf 0x2b 0xf 0x7b 0xf 0x2e 0x20 0x6 0x21>;
		compatible = "mediatek,mt_soc_pcm_dl1";
		interrupts = <0x0 0x61 0x8>;
		phandle = <0xc5>;
		reg = <0x0 0x11220000 0x0 0x1000>;
	};

	mt_soc_dl2_pcm {
		compatible = "mediatek,mt_soc_pcm_dl2";
	};

	mt_soc_dummy_pcm {
		compatible = "mediatek,mt_soc_pcm_dummy";
	};

	mt_soc_fm_i2s_awb_pcm {
		compatible = "mediatek,mt_soc_pcm_fm_i2s_awb";
	};

	mt_soc_fm_i2s_pcm {
		compatible = "mediatek,mt_soc_pcm_fm_i2s";
	};

	mt_soc_fm_mrgtx_pcm {
		compatible = "mediatek,mt_soc_pcm_fmtx";
	};

	mt_soc_hp_impedance_pcm {
		compatible = "mediatek,mt_soc_pcm_hp_impedance";
	};

	mt_soc_i2s0_awb_pcm {
		compatible = "mediatek,mt_soc_pcm_i2s0_awb";
	};

	mt_soc_i2s0_pcm {
		compatible = "mediatek,mt_soc_pcm_dl1_i2s0";
	};

	mt_soc_i2s0dl1_pcm {
		compatible = "mediatek,mt_soc_pcm_dl1_i2s0dl1";
	};

	mt_soc_mrgrx_awb_pcm {
		compatible = "mediatek,mt_soc_pcm_mrgrx_awb";
	};

	mt_soc_mrgrx_pcm {
		compatible = "mediatek,mt_soc_pcm_mrgrx";
	};

	mt_soc_pcm_voice_ultra {
		compatible = "mediatek,mt_soc_pcm_voice_ultra";
	};

	mt_soc_pcm_voice_usb {
		compatible = "mediatek,mt_soc_pcm_voice_usb";
	};

	mt_soc_pcm_voice_usb_echoref {
		compatible = "mediatek,mt_soc_pcm_voice_usb_echoref";
	};

	mt_soc_routing_dai_name {
		compatible = "mediatek,mt_soc_dai_routing";
	};

	mt_soc_routing_pcm {
		compatible = "mediatek,mt_soc_pcm_routing";
	};

	mt_soc_tdmrx_pcm {
		compatible = "mediatek,mt_soc_tdm_capture";
	};

	mt_soc_ul1_pcm {
		compatible = "mediatek,mt_soc_pcm_capture";
	};

	mt_soc_ul2_pcm {
		compatible = "mediatek,mt_soc_pcm_capture2";
	};

	mt_soc_uldlloopback_pcm {
		compatible = "mediatek,mt_soc_pcm_uldlloopback";
	};

	mt_soc_voice_md1 {
		compatible = "mediatek,mt_soc_pcm_voice_md1";
	};

	mt_soc_voice_md1_bt {
		compatible = "mediatek,mt_soc_pcm_voice_md1_bt";
	};

	mt_soc_voice_md2 {
		compatible = "mediatek,mt_soc_pcm_voice_md2";
	};

	mt_soc_voice_md2_bt {
		compatible = "mediatek,mt_soc_pcm_voice_md2_bt";
	};

	mt_soc_voip_bt_in {
		compatible = "mediatek,mt_soc_pcm_bt_dai";
	};

	mt_soc_voip_bt_out {
		compatible = "mediatek,mt_soc_pcm_dl1_bt";
	};

	mtk-btcvsd-snd@18050000 {
		compatible = "mediatek,mtk-btcvsd-snd";
		interrupts = <0x0 0xd2 0x8>;
		mediatek,infracfg = <0x22>;
		mediatek,offset = <0xf00 0x800 0x140 0x144 0x148>;
		phandle = <0x59>;
		reg = <0x0 0x18050000 0x0 0x1000 0x0 0x18080000 0x0 0x10000>;
	};

	mtkfb@0 {
		compatible = "mediatek,mtkfb";
		phandle = <0xd1>;
	};

	nfc {
		compatible = "mediatek,nfc-gpio-v2";
		gpio-irq = <0xa>;
		gpio-irq-std = <0x1e 0xa 0x0>;
		gpio-rst = <0xac>;
		gpio-rst-std = <0x1e 0xac 0x0>;
		phandle = <0xce>;
	};

	nfi@11018000 {
		compatible = "mediatek,nfi";
		reg = <0x0 0x11018000 0x0 0x1000>;
	};

	nfiecc@11019000 {
		compatible = "mediatek,nfiecc";
		reg = <0x0 0x11019000 0x0 0x1000>;
	};

	odm {
		compatible = "simple-bus";
		phandle = <0xdc>;
	};

	opp_table0 {
		compatible = "operating-points-v2";
		opp-shared;
		phandle = <0x2>;

		opp0 {
			opp-hz = <0x0 0x32a9f880>;
			opp-microvolt = <0x9eb10>;
		};

		opp1 {
			opp-hz = <0x0 0x36b79180>;
			opp-microvolt = <0xa344e>;
		};

		opp10 {
			opp-hz = <0x0 0x61559a40>;
			opp-microvolt = <0xd8acc>;
		};

		opp11 {
			opp-hz = <0x0 0x6553f100>;
			opp-microvolt = <0xdec74>;
		};

		opp12 {
			opp-hz = <0x0 0x695247c0>;
			opp-microvolt = <0xe4e1c>;
		};

		opp13 {
			opp-hz = <0x0 0x6d509e80>;
			opp-microvolt = <0xeafc4>;
		};

		opp14 {
			opp-hz = <0x0 0x72431940>;
			opp-microvolt = <0xf29d6>;
		};

		opp15 {
			opp-hz = <0x0 0x7744d640>;
			opp-microvolt = <0xfa3e8>;
		};

		opp2 {
			opp-hz = <0x0 0x3ad46cc0>;
			opp-microvolt = <0xa7d8c>;
		};

		opp3 {
			opp-hz = <0x0 0x3ef14800>;
			opp-microvolt = <0xac6ca>;
		};

		opp4 {
			opp-hz = <0x0 0x430e2340>;
			opp-microvolt = <0xb1008>;
		};

		opp5 {
			opp-hz = <0x0 0x487ab000>;
			opp-microvolt = <0xb71b0>;
		};

		opp6 {
			opp-hz = <0x0 0x4df67f00>;
			opp-microvolt = <0xbd358>;
		};

		opp7 {
			opp-hz = <0x0 0x53724e00>;
			opp-microvolt = <0xc3500>;
		};

		opp8 {
			opp-hz = <0x0 0x57616280>;
			opp-microvolt = <0xc96a8>;
		};

		opp9 {
			opp-hz = <0x0 0x5b5fb940>;
			opp-microvolt = <0xcf850>;
		};
	};

	otg_iddig {
		phandle = <0xdb>;
	};

	pbm {
		compatible = "mediatek,pbm";
		io-channel-names = "pmic_batadc";
		io-channels = <0x23 0x0>;
		phandle = <0xe6>;
	};

	pd_adapter {
		adapter_name = "pd_adapter";
		compatible = "mediatek,pd_adapter";
		phandle = <0xdf>;
	};

	pdc {
		compatible = "mediatek,charger,pd";
		dcs_chg1_charger_current = <0x16e360>;
		dcs_chg2_charger_current = <0x16e360>;
		dcs_input_current = <0x30d400>;
		dual_polling_ieoc = <0x6ddd0>;
		gauge = <0x60>;
		ibus_err = <0xe>;
		min_charger_voltage = <0x4630c0>;
		pd_stop_battery_soc = <0x50>;
		pd_vbus_low_bound = <0x4c4b40>;
		pd_vbus_upper_bound = <0x4c4b40>;
		phandle = <0xde>;
		sc_charger_current = <0x2dc6c0>;
		sc_input_current = <0x30d400>;
		slave_mivr_diff = <0x186a0>;
		vsys_watt = <0x4c4b40>;
	};

	pericfg@10003000 {
		#clock-cells = <0x1>;
		compatible = "mediatek,pericfg", "syscon";
		phandle = <0x4a>;
		reg = <0x0 0x10003000 0x0 0x1000>;
	};

	pinctrl@10005000 {
		#gpio-cells = <0x2>;
		#interrupt-cells = <0x2>;
		compatible = "mediatek,mt6761-pinctrl";
		gpio-controller;
		gpio-ranges = <0x1e 0x0 0x0 0xb3>;
		interrupt-controller;
		interrupt-parent = <0xe>;
		interrupts = <0x0 0x73 0x4>;
		phandle = <0x1e>;
		pins-are-numbered;
		reg_bases = <0x16 0x17 0x18 0x19 0x1a 0x1b 0x1c 0x1d>;

		msdc0@default {
			phandle = <0x4d>;

			pins_clk {
				drive-strength = [03];
			};

			pins_cmd {
				drive-strength = [03];
			};

			pins_dat {
				drive-strength = [03];
			};

			pins_ds {
				drive-strength = [03];
			};

			pins_rst {
				drive-strength = [03];
			};
		};

		msdc0@hs200 {
			phandle = <0x4f>;

			pins_clk {
				drive-strength = [04];
			};

			pins_cmd {
				drive-strength = [03];
			};

			pins_dat {
				drive-strength = [04];
			};

			pins_ds {
				drive-strength = [04];
			};

			pins_rst {
				drive-strength = [03];
			};
		};

		msdc0@hs400 {
			phandle = <0x4e>;

			pins_clk {
				drive-strength = [04];
			};

			pins_cmd {
				drive-strength = [03];
			};

			pins_dat {
				drive-strength = [04];
			};

			pins_ds {
				drive-strength = [04];
			};

			pins_rst {
				drive-strength = [03];
			};
		};

		msdc0@register_default {
			cmd_edge = [00];
			phandle = <0x50>;
			rdata_edge = [00];
			wdata_edge = [00];
		};

		msdc1@ddr50 {
			phandle = <0x55>;

			pins_clk {
				drive-strength = [03];
			};

			pins_cmd {
				drive-strength = [03];
			};

			pins_dat {
				drive-strength = [03];
			};
		};

		msdc1@default {
			phandle = <0x52>;

			pins_clk {
				drive-strength = [03];
			};

			pins_cmd {
				drive-strength = [03];
			};

			pins_dat {
				drive-strength = [03];
			};
		};

		msdc1@register_default {
			cmd_edge = [00];
			phandle = <0x56>;
			rdata_edge = [00];
			wdata_edge = [00];
		};

		msdc1@sdr104 {
			phandle = <0x53>;

			pins_clk {
				drive-strength = [03];
			};

			pins_cmd {
				drive-strength = [03];
			};

			pins_dat {
				drive-strength = [03];
			};
		};

		msdc1@sdr50 {
			phandle = <0x54>;

			pins_clk {
				drive-strength = [03];
			};

			pins_cmd {
				drive-strength = [03];
			};

			pins_dat {
				drive-strength = [03];
			};
		};

		msdc3@default {
			phandle = <0x6f>;

			pins_clk {
				drive-strength = [04];
			};

			pins_cmd {
				drive-strength = [04];
			};

			pins_dat {
				drive-strength = [04];
			};
		};

		msdc3@register_default {
			cmd_edge = [01];
			phandle = <0x70>;
			rdata_edge = [01];
			wdata_edge = [01];
		};
	};

	pmic_clock_buffer_ctrl {
		compatible = "mediatek,pmic_clock_buffer";
		mediatek,bblpm-support = "enable";
		mediatek,clkbuf-config = <0x2 0x1 0x1 0x2 0x0 0x0 0x0>;
		mediatek,clkbuf-driving-current = <0x1 0x1 0x1 0x1 0x1 0x1 0x1>;
		mediatek,clkbuf-quantity = <0x7>;
		phandle = <0xe5>;
		pwrap = <0x12>;
		pwrap-dcxo-cfg = <0x18c 0x19c>;
		pwrap-dcxo-en = <0x188 0x0 0x188 0x1 0x188 0x0>;
		sleep = <0x62>;
		spm-pwr-status = <0x180 0x0 0x180 0x1>;
	};

	pmu {
		compatible = "arm,cortex-a7-pmu";
		interrupt-parent = <0xe>;
		interrupts = <0x1 0x7 0x8>;
	};

	psci {
		compatible = "arm,psci-1.0";
		method = "smc";
	};

	pseudo_m4u {
		compatible = "mediatek,mt-pseudo_m4u";
		iommus = <0x63 0x2>;
	};

	pseudo_m4u-larb0 {
		compatible = "mediatek,mt-pseudo_m4u-port";
		iommus = <0x63 0x0 0x63 0x1 0x63 0x2 0x63 0x3 0x63 0x4 0x63 0x5 0x63 0x6 0x63 0x7>;
		mediatek,larbid = <0x0>;
	};

	pseudo_m4u-larb1 {
		compatible = "mediatek,mt-pseudo_m4u-port";
		iommus = <0x63 0x20 0x63 0x21>;
		mediatek,larbid = <0x1>;
	};

	pseudo_m4u-larb2 {
		compatible = "mediatek,mt-pseudo_m4u-port";
		iommus = <0x63 0x40 0x63 0x41>;
		mediatek,larbid = <0x2>;
	};

	pwm@11006000 {
		clock-names = "PWM1-main", "PWM2-main", "PWM3-main", "PWM4-main", "PWM5-main", "PWM6-main", "PWM-HCLK-main", "PWM-main";
		clocks = <0x22 0x10 0x22 0x11 0x22 0x12 0x22 0x13 0x22 0x14 0x22 0x30 0x22 0xf 0x22 0x15>;
		compatible = "mediatek,pwm";
		interrupts = <0x0 0x15 0x8>;
		phandle = <0xa8>;
		reg = <0x0 0x11006000 0x0 0x1000>;
	};

	pwrap@1000d000 {
		clock-names = "spi", "wrap", "ulposc";
		clocks = <0x21 0x22 0x2 0xf 0x85>;
		compatible = "mediatek,mt6761-pwrap", "syscon";
		interrupts = <0x0 0x7b 0x4>;
		phandle = <0x12>;
		reg = <0x0 0x1000d000 0x0 0x1000>;
		reg-names = "pwrap";

		main_pmic {
			#interrupt-cells = <0x2>;
			compatible = "mediatek,mt6357";
			interrupt-controller;
			interrupt-parent = <0x1e>;
			interrupts = <0x90 0x4 0x90 0x0>;
			phandle = <0x2c>;

			clock_buffer_ctrl {
				clkbuf-pmic-dependent = "pmic-drvcurr", "pmic-auxout-sel", "pmic-auxout-xo", "pmic-auxout-drvcurr", "pmic-auxout-bblpm-en";
				compatible = "mediatek,clock_buffer";
				n-clkbuf-pmic-dependent = <0x5>;
				n-pmic-auxout-bblpm-en = <0x1>;
				n-pmic-auxout-drvcurr = <0x7>;
				n-pmic-auxout-sel = <0x6>;
				n-pmic-auxout-xo = <0x7>;
				n-pmic-drvcurr = <0x7>;
				phandle = <0x95>;
				pmic-auxout-bblpm-en = <0x7b6 0x0>;
				pmic-auxout-drvcurr = <0x7b6 0x1 0x7b6 0x7 0x7b6 0x1 0x7b6 0x7 0xffff 0xffff 0x7b6 0x1 0x7b6 0xc>;
				pmic-auxout-sel = <0x7b4 0x0 0x7b4 0x5 0x7b4 0x6 0x7b4 0x7 0x7b4 0x6 0x7b4 0x18>;
				pmic-auxout-xo = <0x7b6 0x0 0x7b6 0x6 0x7b6 0x0 0x7b6 0x6 0xffff 0xffff 0x7b6 0x6 0x7b6 0xc>;
				pmic-bblpm-sw = <0x788 0xc>;
				pmic-dcxo-cw = <0x788>;
				pmic-drvcurr = <0x7b0 0x0 0x7b0 0x2 0x7b0 0x4 0x7b0 0x6 0xffff 0xffff 0x7b0 0xa 0x7b0 0xc>;
				pmic-srclkeni3 = <0x44a 0x0>;
				pmic-xo-en = <0x788 0x2 0x788 0x5 0x788 0x8 0x788 0xb 0xffff 0xffff 0x7a2 0xa 0x7a2 0xd>;
				pmic-xo-mode = <0x788 0x0 0x788 0x3 0x788 0x6 0x788 0x9 0xffff 0xffff 0x7a2 0x8 0x7a2 0xb>;
			};

			mt6357_charger {
				alias_name = "mt6357";
				charger_name = "primary_chg";
				compatible = "mediatek,mt6357-pulse-charger";
				cv = <0x426030>;
				ichg = <0x7a120>;
				phandle = <0x75>;
				vbat_ov_thres = <0x43e6d0>;
				vcdt_hv_thres = <0x6acfc0>;
			};

			mt6357_debug {
				compatible = "mediatek,mt63xx-debug";
			};

			mt6357_ts_buck1 {
				compatible = "mediatek,mt6357_ts_buck1";
				interconnects = <0x2a 0x1>;
				io-channel-names = "pmic_buck1_temp";
				io-channels = <0x23 0x6>;
				phandle = <0x76>;
			};

			mt6357_ts_buck2 {
				compatible = "mediatek,mt6357_ts_buck2";
				interconnects = <0x2a 0x1>;
				io-channel-names = "pmic_buck2_temp";
				io-channels = <0x23 0x7>;
				phandle = <0x77>;
			};

			mt6357keys {
				compatible = "mediatek,mt6357-keys";
				mediatek,long-press-mode = <0x1>;
				phandle = <0x74>;
				power-off-time-sec = <0x0>;

				home {
					linux,keycodes = <0x73>;
				};

				power {
					linux,keycodes = <0x74>;
					wakeup-source;
				};
			};

			mt6357regulator {
				compatible = "mediatek,mt6357-regulator";
				phandle = <0x78>;

				buck_vcore {
					phandle = <0x36>;
					regulator-always-on;
					regulator-enable-ramp-delay = <0xdc>;
					regulator-max-microvolt = <0x1406f4>;
					regulator-min-microvolt = <0x7ea5e>;
					regulator-name = "vcore";
					regulator-ramp-delay = <0x186a>;
				};

				buck_vmodem {
					phandle = <0x35>;
					regulator-always-on;
					regulator-enable-ramp-delay = <0xdc>;
					regulator-max-microvolt = <0x123716>;
					regulator-min-microvolt = <0x7a120>;
					regulator-name = "vmodem";
					regulator-ramp-delay = <0x186a>;
				};

				buck_vpa {
					phandle = <0x7b>;
					regulator-enable-ramp-delay = <0xdc>;
					regulator-max-microvolt = <0x37b1d0>;
					regulator-min-microvolt = <0x7a120>;
					regulator-name = "vpa";
					regulator-ramp-delay = <0xc350>;
				};

				buck_vproc {
					phandle = <0x7a>;
					regulator-always-on;
					regulator-enable-ramp-delay = <0xdc>;
					regulator-max-microvolt = <0x1406f4>;
					regulator-min-microvolt = <0x7ea5e>;
					regulator-name = "vproc";
					regulator-ramp-delay = <0x186a>;
				};

				buck_vs1 {
					phandle = <0x79>;
					regulator-always-on;
					regulator-enable-ramp-delay = <0xdc>;
					regulator-max-microvolt = <0x2191c0>;
					regulator-min-microvolt = <0x124f80>;
					regulator-name = "vs1";
					regulator-ramp-delay = <0x30d4>;
				};

				ldo_vaud28 {
					phandle = <0x8b>;
					regulator-always-on;
					regulator-enable-ramp-delay = <0x108>;
					regulator-max-microvolt = <0x2ab980>;
					regulator-min-microvolt = <0x2ab980>;
					regulator-name = "vaud28";
				};

				ldo_vaux18 {
					phandle = <0x8a>;
					regulator-always-on;
					regulator-enable-ramp-delay = <0x108>;
					regulator-max-microvolt = <0x1b7740>;
					regulator-min-microvolt = <0x1b7740>;
					regulator-name = "vaux18";
				};

				ldo_vcama {
					phandle = <0x85>;
					regulator-enable-ramp-delay = <0x108>;
					regulator-max-microvolt = <0x2ab980>;
					regulator-min-microvolt = <0x2625a0>;
					regulator-name = "vcama";
				};

				ldo_vcamd {
					phandle = <0x86>;
					regulator-enable-ramp-delay = <0x108>;
					regulator-max-microvolt = <0x1b7740>;
					regulator-min-microvolt = <0xf4240>;
					regulator-name = "vcamd";
				};

				ldo_vcamio {
					phandle = <0x87>;
					regulator-enable-ramp-delay = <0x108>;
					regulator-max-microvolt = <0x1b7740>;
					regulator-min-microvolt = <0x1b7740>;
					regulator-name = "vcamio";
				};

				ldo_vcn18 {
					phandle = <0x84>;
					regulator-enable-ramp-delay = <0x108>;
					regulator-max-microvolt = <0x1b7740>;
					regulator-min-microvolt = <0x1b7740>;
					regulator-name = "vcn18";
				};

				ldo_vcn28 {
					phandle = <0x83>;
					regulator-enable-ramp-delay = <0x108>;
					regulator-max-microvolt = <0x2ab980>;
					regulator-min-microvolt = <0x2ab980>;
					regulator-name = "vcn28";
				};

				ldo_vcn33_bt {
					phandle = <0x81>;
					regulator-enable-ramp-delay = <0x108>;
					regulator-max-microvolt = <0x3567e0>;
					regulator-min-microvolt = <0x325aa0>;
					regulator-name = "vcn33_bt";
				};

				ldo_vcn33_wifi {
					phandle = <0x82>;
					regulator-enable-ramp-delay = <0x108>;
					regulator-max-microvolt = <0x3567e0>;
					regulator-min-microvolt = <0x325aa0>;
					regulator-name = "vcn33_wifi";
				};

				ldo_vdram {
					phandle = <0x8e>;
					regulator-always-on;
					regulator-enable-ramp-delay = <0xce4>;
					regulator-max-microvolt = <0x124f80>;
					regulator-min-microvolt = <0x10c8e0>;
					regulator-name = "vdram";
				};

				ldo_vefuse {
					phandle = <0x80>;
					regulator-enable-ramp-delay = <0x108>;
					regulator-max-microvolt = <0x325aa0>;
					regulator-min-microvolt = <0x124f80>;
					regulator-name = "vefuse";
				};

				ldo_vemc {
					phandle = <0x51>;
					regulator-always-on;
					regulator-enable-ramp-delay = <0x2c>;
					regulator-max-microvolt = <0x325aa0>;
					regulator-min-microvolt = <0x2c4020>;
					regulator-name = "vemc";
				};

				ldo_vfe28 {
					phandle = <0x7c>;
					regulator-enable-ramp-delay = <0x108>;
					regulator-max-microvolt = <0x2ab980>;
					regulator-min-microvolt = <0x2ab980>;
					regulator-name = "vfe28";
				};

				ldo_vibr {
					phandle = <0x1f>;
					regulator-enable-ramp-delay = <0x2c>;
					regulator-max-microvolt = <0x325aa0>;
					regulator-min-microvolt = <0x124f80>;
					regulator-name = "vibr";
				};

				ldo_vio18 {
					phandle = <0x8d>;
					regulator-always-on;
					regulator-enable-ramp-delay = <0x108>;
					regulator-max-microvolt = <0x1b7740>;
					regulator-min-microvolt = <0x1b7740>;
					regulator-name = "vio18";
				};

				ldo_vio28 {
					phandle = <0x8c>;
					regulator-always-on;
					regulator-enable-ramp-delay = <0x108>;
					regulator-max-microvolt = <0x2ab980>;
					regulator-min-microvolt = <0x2ab980>;
					regulator-name = "vio28";
				};

				ldo_vldo28 {
					phandle = <0x5e>;
					regulator-enable-ramp-delay = <0x108>;
					regulator-max-microvolt = <0x2dc6c0>;
					regulator-min-microvolt = <0x2ab980>;
					regulator-name = "vldo28";
				};

				ldo_vmc {
					phandle = <0x58>;
					regulator-enable-ramp-delay = <0x2c>;
					regulator-max-microvolt = <0x325aa0>;
					regulator-min-microvolt = <0x1b7740>;
					regulator-name = "vmc";
				};

				ldo_vmch {
					phandle = <0x57>;
					regulator-enable-ramp-delay = <0x2c>;
					regulator-max-microvolt = <0x325aa0>;
					regulator-min-microvolt = <0x2c4020>;
					regulator-name = "vmch";
				};

				ldo_vrf12 {
					phandle = <0x7f>;
					regulator-enable-ramp-delay = <0x6e>;
					regulator-max-microvolt = <0x124f80>;
					regulator-min-microvolt = <0x124f80>;
					regulator-name = "vrf12";
				};

				ldo_vrf18 {
					phandle = <0x7e>;
					regulator-enable-ramp-delay = <0x6e>;
					regulator-max-microvolt = <0x1b7740>;
					regulator-min-microvolt = <0x1b7740>;
					regulator-name = "vrf18";
				};

				ldo_vsim1 {
					phandle = <0x8f>;
					regulator-enable-ramp-delay = <0x108>;
					regulator-max-microvolt = <0x2f4d60>;
					regulator-min-microvolt = <0x19f0a0>;
					regulator-name = "vsim1";
				};

				ldo_vsim2 {
					phandle = <0x90>;
					regulator-enable-ramp-delay = <0x108>;
					regulator-max-microvolt = <0x2f4d60>;
					regulator-min-microvolt = <0x19f0a0>;
					regulator-name = "vsim2";
				};

				ldo_vsram_others {
					phandle = <0x88>;
					regulator-always-on;
					regulator-enable-ramp-delay = <0x6e>;
					regulator-max-microvolt = <0x1406f4>;
					regulator-min-microvolt = <0x7ea5e>;
					regulator-name = "vsram_others";
					regulator-ramp-delay = <0x186a>;
				};

				ldo_vsram_proc {
					phandle = <0x89>;
					regulator-always-on;
					regulator-enable-ramp-delay = <0x6e>;
					regulator-max-microvolt = <0x1406f4>;
					regulator-min-microvolt = <0x7ea5e>;
					regulator-name = "vsram_proc";
					regulator-ramp-delay = <0x186a>;
				};

				ldo_vusb33 {
					phandle = <0x91>;
					regulator-always-on;
					regulator-enable-ramp-delay = <0x108>;
					regulator-max-microvolt = <0x2f4d60>;
					regulator-min-microvolt = <0x2dc6c0>;
					regulator-name = "vusb33";
				};

				ldo_vxo22 {
					phandle = <0x7d>;
					regulator-always-on;
					regulator-enable-ramp-delay = <0x6e>;
					regulator-max-microvolt = <0x249f00>;
					regulator-min-microvolt = <0x2191c0>;
					regulator-name = "vxo22";
				};
			};

			mt63xx-oc-debug {
				compatible = "mediatek,mt63xx-oc-debug";
			};

			mtk_battery_oc_throttling {
				compatible = "mediatek,mt6357-battery_oc_throttling";
				oc-thd-h = <0x123e>;
				oc-thd-l = <0x157c>;
			};

			mtk_charger_type {
				bc12_active = <0x1>;
				compatible = "mediatek,mt6357-charger-type";
				io-channel-names = "pmic_vbus";
				io-channels = <0x23 0x2>;
				phandle = <0x25>;
			};

			mtk_dynamic_loading_throttling {
				compatible = "mediatek,mt6357-dynamic_loading_throttling";
				io-channel-names = "pmic_ptim", "pmic_imix_r", "pmic_isense", "pmic_batadc";
				io-channels = <0x23 0xf 0x23 0x10 0x23 0x1 0x23 0x0>;
				isense_support;
				mediatek,charger = <0x2b>;
				uvlo-level = <0xa28>;
			};

			mtk_gauge {
				CAR_TUNE_VALUE = <0x64>;
				COM_FG_METER_RESISTANCE = <0x64>;
				DIFFERENCE_FULLOCV_ITH = <0x122>;
				EMBEDDED_SEL = <0x1>;
				FG_METER_RESISTANCE = <0x4b>;
				KEEP_100_PERCENT = <0x3>;
				PMIC_MIN_VOL = <0x82dc>;
				PMIC_SHUTDOWN_CURRENT = <0x14>;
				POWERON_SYSTEM_IBOOT = <0x1f4>;
				Q_MAX_SYS_VOLTAGE_BAT0 = <0xd48>;
				Q_MAX_SYS_VOLTAGE_BAT1 = <0xd48>;
				Q_MAX_SYS_VOLTAGE_BAT2 = <0xd48>;
				Q_MAX_SYS_VOLTAGE_BAT3 = <0xd48>;
				RBAT_PULL_UP_R = <0x186a0>;
				RBAT_PULL_UP_VOLT = <0x708>;
				R_FG_VALUE = <0xa>;
				SHUTDOWN_1_TIME = <0x1e>;
				SHUTDOWN_GAUGE0_VOLTAGE = <0x84d0>;
				TEMPERATURE_T0 = <0x32>;
				TEMPERATURE_T1 = <0x19>;
				TEMPERATURE_T2 = <0xa>;
				TEMPERATURE_T3 = <0x0>;
				TEMPERATURE_T4 = <0xfffffff6>;
				TEMPERATURE_T5 = <0xfffffff6>;
				battery0_profile_t0 = <0x0 0xaa14 0x30c 0x1f9 0xa98d 0x308 0x3f1 0xa90e 0x318 0x5ea 0xa890 0x320 0x7e2 0xa811 0x320 0x9db 0xa793 0x320 0xbd3 0xa716 0x321 0xdcc 0xa6a0 0x336 0xfc4 0xa623 0x327 0x11bd 0xa5aa 0x32e 0x13b5 0xa535 0x339 0x15ae 0xa4bd 0x333 0x17a7 0xa440 0x322 0x199f 0xa3d3 0x337 0x1b98 0xa360 0x339 0x1d90 0xa2ea 0x339 0x1f89 0xa275 0x339 0x2181 0xa202 0x339 0x237a 0xa194 0x33c 0x2572 0xa127 0x351 0x276b 0xa0ba 0x352 0x2963 0xa046 0x342 0x2b5c 0x9fda 0x345 0x2d55 0x9f72 0x352 0x2f4d 0x9f06 0x352 0x3146 0x9ea1 0x352 0x333e 0x9e3c 0x352 0x3537 0x9dd7 0x352 0x372f 0x9d78 0x35f 0x3928 0x9d18 0x362 0x3b20 0x9cb5 0x352 0x3d19 0x9c59 0x355 0x3f11 0x9c05 0x37f 0x410a 0x9ba9 0x372 0x4303 0x9b53 0x379 0x44fb 0x9afe 0x384 0x46f4 0x9aaa 0x38a 0x48ec 0x9a57 0x3a2 0x4ae5 0x9a0c 0x3cc 0x4cdd 0x99b0 0x3e2 0x4ed6 0x9947 0x3d9 0x50ce 0x98c4 0x3a2 0x52c7 0x983a 0x364 0x54bf 0x97c8 0x34f 0x56b8 0x976c 0x33a 0x58b1 0x9727 0x339 0x5aa9 0x96e4 0x339 0x5ca2 0x96a6 0x339 0x5e9a 0x966b 0x339 0x6093 0x9630 0x335 0x628b 0x95f5 0x320 0x6484 0x95c3 0x320 0x667c 0x9590 0x320 0x6875 0x9563 0x32d 0x6a6d 0x9539 0x339 0x6c66 0x950f 0x339 0x6e5f 0x94e5 0x339 0x7057 0x94bb 0x339 0x7250 0x9491 0x339 0x7448 0x946d 0x348 0x7641 0x944b 0x352 0x7839 0x942a 0x352 0x7a32 0x9409 0x355 0x7c2a 0x93f0 0x36a 0x7e23 0x93d6 0x37f 0x801b 0x93b7 0x384 0x8214 0x939a 0x390 0x840d 0x937b 0x39d 0x8605 0x9349 0x38e 0x87fe 0x92f7 0x33c 0x89f6 0x92b3 0x339 0x8bef 0x9283 0x349 0x8de7 0x9259 0x352 0x8fe0 0x922f 0x352 0x91d8 0x9203 0x34e 0x93d1 0x91d1 0x339 0x95c9 0x91b0 0x339 0x97c2 0x918e 0x34b 0x99bb 0x9167 0x352 0x9bb3 0x9139 0x352 0x9dac 0x9104 0x352 0x9fa4 0x90c9 0x352 0xa19d 0x9086 0x352 0xa395 0x9042 0x352 0xa58e 0x8ff3 0x343 0xa786 0x8fb9 0x339 0xa97f 0x8f9d 0x339 0xab77 0x8f8d 0x33e 0xad70 0x8f85 0x369 0xaf69 0x8f7c 0x3a6 0xb161 0x8f67 0x3e5 0xb35a 0x8f1f 0x3f5 0xb552 0x8e56 0x3d0 0xb74b 0x8cd5 0x3a1 0xb943 0x8ac3 0x3b6 0xbb3c 0x87e0 0x3f5 0xbd34 0x8397 0x486 0xbf2d 0x7b0b 0x1127 0xc125 0x71de 0xb6d 0xc31e 0x71de 0xb6d>;
				battery0_profile_t0_col = <0x3>;
				battery0_profile_t0_num = <0x64>;
				battery0_profile_t1 = <0x0 0xaa78 0x438 0x1f9 0xa9fa 0x434 0x3f1 0xa983 0x433 0x5ea 0xa908 0x440 0x7e2 0xa88d 0x44c 0x9db 0xa815 0x44c 0xbd3 0xa798 0x44c 0xdcc 0xa722 0x44c 0xfc4 0xa6ac 0x45e 0x11bd 0xa631 0x449 0x13b5 0xa5b7 0x43d 0x15ae 0xa541 0x44c 0x17a7 0xa4cb 0x44c 0x199f 0xa456 0x44c 0x1b98 0xa3e9 0x439 0x1d90 0xa376 0x433 0x1f89 0xa305 0x43e 0x2181 0xa298 0x44c 0x237a 0xa229 0x44c 0x2572 0xa1b4 0x44c 0x276b 0xa146 0x44c 0x2963 0xa0d8 0x45c 0x2b5c 0xa06b 0x465 0x2d55 0x9ffe 0x465 0x2f4d 0x9f94 0x469 0x3146 0x9f38 0x47f 0x333e 0x9efd 0x4d3 0x3537 0x9eb4 0x4e2 0x372f 0x9e43 0x4d5 0x3928 0x9da7 0x4b7 0x3b20 0x9cf6 0x492 0x3d19 0x9c61 0x47f 0x3f11 0x9bf4 0x494 0x410a 0x9bb3 0x4ce 0x4303 0x9b7e 0x4e2 0x44fb 0x9b4b 0x4ec 0x46f4 0x9b11 0x501 0x48ec 0x9ac5 0x514 0x4ae5 0x9a7a 0x514 0x4cdd 0x9a1e 0x527 0x4ed6 0x99bc 0x51e 0x50ce 0x994f 0x509 0x52c7 0x98d4 0x4d0 0x54bf 0x9850 0x45c 0x56b8 0x97db 0x41d 0x58b1 0x9785 0x41a 0x5aa9 0x9738 0x40a 0x5ca2 0x96f1 0x40d 0x5e9a 0x96b1 0x409 0x6093 0x9676 0x3ec 0x628b 0x963b 0x401 0x6484 0x9609 0x401 0x667c 0x95d6 0x401 0x6875 0x95a4 0x401 0x6a6d 0x9575 0x401 0x6c66 0x954b 0x401 0x6e5f 0x9521 0x401 0x7057 0x94f7 0x401 0x7250 0x94d4 0x413 0x7448 0x94b3 0x41a 0x7641 0x9491 0x425 0x7839 0x9470 0x433 0x7a32 0x944e 0x433 0x7c2a 0x942c 0x433 0x7e23 0x9412 0x447 0x801b 0x93f9 0x45c 0x8214 0x93db 0x459 0x840d 0x93bd 0x454 0x8605 0x93a2 0x461 0x87fe 0x9381 0x44d 0x89f6 0x935f 0x438 0x8bef 0x933e 0x423 0x8de7 0x931c 0x40e 0x8fe0 0x92fb 0x401 0x91d8 0x92d7 0x401 0x93d1 0x92ad 0x401 0x95c9 0x928c 0x401 0x97c2 0x9263 0x401 0x99bb 0x923e 0x401 0x9bb3 0x9219 0x401 0x9dac 0x91ef 0x407 0x9fa4 0x91c2 0x418 0xa19d 0x9177 0x403 0xa395 0x913a 0x414 0xa58e 0x90ff 0x429 0xa786 0x90b3 0x428 0xa97f 0x9064 0x421 0xab77 0x9036 0x433 0xad70 0x9025 0x433 0xaf69 0x901c 0x46e 0xb161 0x9007 0x47e 0xb35a 0x8ff3 0x4a1 0xb552 0x8fd2 0x4e1 0xb74b 0x8f6f 0x508 0xb943 0x8e59 0x4c9 0xbb3c 0x8c7b 0x508 0xbd34 0x89f5 0x557 0xbf2d 0x8659 0x5e9 0xc125 0x7f79 0xe15 0xc31e 0x73a0 0xfa0>;
				battery0_profile_t1_col = <0x3>;
				battery0_profile_t1_num = <0x64>;
				battery0_profile_t2 = <0x0 0xaa8c 0x834 0x1f9 0xaa16 0x834 0x3f1 0xa993 0x856 0x5ea 0xa90c 0x866 0x7e2 0xa889 0x866 0x9db 0xa80b 0x861 0xbd3 0xa78e 0x84d 0xdcc 0xa718 0x84d 0xfc4 0xa6a2 0x83b 0x11bd 0xa627 0x826 0x13b5 0xa5ad 0x81b 0x15ae 0xa537 0x81b 0x17a7 0xa4c2 0x81b 0x199f 0xa455 0x81b 0x1b98 0xa3e2 0x808 0x1d90 0xa372 0x802 0x1f89 0xa305 0x80d 0x2181 0xa298 0x81b 0x237a 0xa22a 0x81b 0x2572 0xa1bd 0x81b 0x276b 0xa148 0x81b 0x2963 0xa0df 0x82b 0x2b5c 0xa075 0x834 0x2d55 0xa00b 0x82c 0x2f4d 0x9fad 0x827 0x3146 0x9f6a 0x867 0x333e 0x9f2f 0x8d0 0x3537 0x9ed1 0x8f4 0x372f 0x9e48 0x8e2 0x3928 0x9d99 0x8a5 0x3b20 0x9ce0 0x85b 0x3d19 0x9c43 0x834 0x3f11 0x9bcd 0x834 0x410a 0x9b75 0x846 0x4303 0x9b2c 0x85b 0x44fb 0x9aed 0x87b 0x46f4 0x9ab5 0x8ab 0x48ec 0x9a7f 0x8e1 0x4ae5 0x9a34 0x8cc 0x4cdd 0x99d8 0x8a3 0x4ed6 0x996f 0x86a 0x50ce 0x98ff 0x820 0x52c7 0x988d 0x7d4 0x54bf 0x9821 0x795 0x56b8 0x97bc 0x756 0x58b1 0x9767 0x73f 0x5aa9 0x971a 0x73a 0x5ca2 0x96d8 0x73a 0x5e9a 0x969d 0x742 0x6093 0x9660 0x74a 0x628b 0x961d 0x721 0x6484 0x95eb 0x736 0x667c 0x95bf 0x73a 0x6875 0x9590 0x73a 0x6a6d 0x9561 0x743 0x6c66 0x9537 0x753 0x6e5f 0x950d 0x754 0x7057 0x94e3 0x769 0x7250 0x94c0 0x76c 0x7448 0x949f 0x77b 0x7641 0x947d 0x785 0x7839 0x945c 0x785 0x7a32 0x943b 0x788 0x7c2a 0x9422 0x79d 0x7e23 0x9401 0x79e 0x801b 0x93e5 0x79e 0x8214 0x93cc 0x79e 0x840d 0x93b6 0x79e 0x8605 0x93a5 0x7a2 0x87fe 0x9395 0x7b6 0x89f6 0x9384 0x7b7 0x8bef 0x9379 0x7c7 0x8de7 0x936c 0x7dc 0x8fe0 0x9355 0x7e9 0x91d8 0x9333 0x7e9 0x93d1 0x9311 0x7e9 0x95c9 0x92e7 0x7e9 0x97c2 0x92bd 0x7fb 0x99bb 0x9298 0x81d 0x9bb3 0x926f 0x83e 0x9dac 0x923a 0x858 0x9fa4 0x91ff 0x882 0xa19d 0x91bc 0x8ac 0xa395 0x9180 0x8e9 0xa58e 0x9139 0x919 0xa786 0x90e9 0x94e 0xa97f 0x909d 0x994 0xab77 0x9067 0x9ed 0xad70 0x904e 0xa6c 0xaf69 0x9034 0xad6 0xb161 0x901b 0xb6e 0xb35a 0x8ffd 0xc46 0xb552 0x8fc6 0xd5a 0xb74b 0x8f4d 0xe99 0xb943 0x8e59 0xfe9 0xbb3c 0x8c62 0x10fb 0xbd34 0x89bc 0x1356 0xbf2d 0x85dc 0x1759 0xc125 0x7f29 0x1ee2 0xc31e 0x7422 0x11ad>;
				battery0_profile_t2_col = <0x3>;
				battery0_profile_t2_num = <0x64>;
				battery0_profile_t3 = <0x0 0xaac8 0x1022 0x1f9 0xaa20 0x101e 0x3f1 0xa985 0x1050 0x5ea 0xa8ee 0x104e 0x7e2 0xa85e 0x1036 0x9db 0xa7d7 0x1031 0xbd3 0xa751 0x101c 0xdcc 0xa6d3 0x1007 0xfc4 0xa65c 0x1004 0x11bd 0xa5e1 0xfe8 0x13b5 0xa567 0xfd2 0x15ae 0xa4f1 0xfc6 0x17a7 0xa47b 0xf9b 0x199f 0xa406 0xf71 0x1b98 0xa399 0xf6e 0x1d90 0xa32c 0xf5f 0x1f89 0xa2bf 0xf4a 0x2181 0xa252 0xf20 0x237a 0xa1e4 0xecf 0x2572 0xa177 0xe90 0x276b 0xa10a 0xe51 0x2963 0xa09c 0xe22 0x2b5c 0xa039 0xe10 0x2d55 0x9fe3 0xe28 0x2f4d 0x9f99 0xe70 0x3146 0x9f55 0xed8 0x333e 0x9ef9 0xf18 0x3537 0x9e6c 0xede 0x372f 0x9dc0 0xe70 0x3928 0x9d0e 0xe04 0x3b20 0x9c6c 0xdb5 0x3d19 0x9be0 0xd7a 0x3f11 0x9b7b 0xd7a 0x410a 0x9b25 0xd7a 0x4303 0x9adc 0xd88 0x44fb 0x9a99 0xd9d 0x46f4 0x9a56 0xdb2 0x48ec 0x9a10 0xdc0 0x4ae5 0x99bc 0xd96 0x4cdd 0x9960 0xd59 0x4ed6 0x98fe 0xd1a 0x50ce 0x989a 0xcd0 0x52c7 0x9836 0xc7d 0x54bf 0x97d2 0xc2f 0x56b8 0x9776 0xc05 0x58b1 0x9729 0xbdb 0x5aa9 0x96de 0xbc1 0x5ca2 0x969c 0xbb8 0x5e9a 0x9661 0xbb0 0x6093 0x9626 0xb9f 0x628b 0x95eb 0xb9f 0x6484 0x95c1 0xbb4 0x667c 0x9590 0xbb8 0x6875 0x955e 0xbb8 0x6a6d 0x952f 0xbb8 0x6c66 0x9507 0xbbd 0x6e5f 0x94e5 0xbd2 0x7057 0x94bb 0xbe7 0x7250 0x9498 0xbfc 0x7448 0x9477 0xc12 0x7641 0x9455 0xc1c 0x7839 0x9436 0xc29 0x7a32 0x941c 0xc4b 0x7c2a 0x93fa 0xc36 0x7e23 0x93e8 0xc49 0x801b 0x93d7 0xc6d 0x8214 0x93cb 0xc97 0x840d 0x93c0 0xcba 0x8605 0x93b1 0xcd2 0x87fe 0x93a8 0xcfc 0x89f6 0x9398 0xd26 0x8bef 0x9387 0xd60 0x8de7 0x9376 0xd9f 0x8fe0 0x9362 0xdde 0x91d8 0x9347 0xe1d 0x93d1 0x9325 0xe5c 0x95c9 0x9304 0xe9b 0x97c2 0x92db 0xeec 0x99bb 0x92ac 0xf4e 0x9bb3 0x9279 0xfb7 0x9dac 0x9244 0x1031 0x9fa4 0x9209 0x10d9 0xa19d 0x91c6 0x1181 0xa395 0x917b 0x123c 0xa58e 0x912f 0x1308 0xa786 0x90e4 0x13e5 0xa97f 0x909d 0x14d9 0xab77 0x9065 0x15ed 0xad70 0x903b 0x1714 0xaf69 0x9018 0x1889 0xb161 0x8ff7 0x1a52 0xb35a 0x8fc7 0x1c7d 0xb552 0x8f76 0x1f0d 0xb74b 0x8ee6 0x21fd 0xb943 0x8de1 0x2531 0xbb3c 0x8c03 0x2936 0xbd34 0x8970 0x2f00 0xbf2d 0x85b3 0x357d 0xc125 0x7f92 0x2da3 0xc31e 0x762a 0x165d>;
				battery0_profile_t3_col = <0x3>;
				battery0_profile_t3_num = <0x64>;
				battery0_profile_t4 = <0x0 0xaae6 0x235a 0x1f9 0xaa1c 0x235a 0x3f1 0xa959 0x23af 0x5ea 0xa8a7 0x23d7 0x7e2 0xa807 0x23aa 0x9db 0xa76f 0x233b 0xbd3 0xa6d9 0x22bf 0xdcc 0xa652 0x226b 0xfc4 0xa5c4 0x223c 0x11bd 0xa541 0x21d9 0x13b5 0xa4c3 0x2179 0x15ae 0xa445 0x2121 0x17a7 0xa3c7 0x2097 0x199f 0xa352 0x2058 0x1b98 0xa2de 0x201a 0x1d90 0xa268 0x1fea 0x1f89 0xa1f7 0x1f9f 0x2181 0xa187 0x1f3d 0x237a 0xa114 0x1ee6 0x2572 0xa0af 0x1e7d 0x276b 0xa05a 0x1e50 0x2963 0xa006 0x1e36 0x2b5c 0x9fad 0x1e21 0x2d55 0x9f43 0x1dfc 0x2f4d 0x9ebf 0x1db8 0x3146 0x9e1f 0x1d64 0x333e 0x9d6e 0x1ca6 0x3537 0x9cd2 0x1c62 0x372f 0x9c45 0x1c38 0x3928 0x9bca 0x1c20 0x3b20 0x9b61 0x1c25 0x3d19 0x9b05 0x1c39 0x3f11 0x9ab1 0x1c39 0x410a 0x9a64 0x1c4b 0x4303 0x9a13 0x1c52 0x44fb 0x99c3 0x1c5c 0x46f4 0x9972 0x1c5e 0x48ec 0x9915 0x1c34 0x4ae5 0x98b9 0x1c0a 0x4cdd 0x985c 0x1bf4 0x4ed6 0x9806 0x1bdf 0x50ce 0x97b3 0x1bbe 0x52c7 0x9762 0x1b9c 0x54bf 0x9717 0x1b87 0x56b8 0x96cb 0x1b72 0x58b1 0x9687 0x1b71 0x5aa9 0x9644 0x1b61 0x5ca2 0x960b 0x1b7d 0x5e9a 0x95d5 0x1b8a 0x6093 0x959c 0x1b61 0x628b 0x9569 0x1b8b 0x6484 0x953f 0x1bca 0x667c 0x9515 0x1bc4 0x6875 0x94eb 0x1bd7 0x6a6d 0x94c5 0x1bf7 0x6c66 0x94a3 0x1c0c 0x6e5f 0x9482 0x1c23 0x7057 0x9469 0x1c4d 0x7250 0x9457 0x1c89 0x7448 0x9446 0x1cba 0x7641 0x9436 0x1cf9 0x7839 0x9425 0x1d4d 0x7a32 0x9414 0x1da1 0x7c2a 0x9403 0x1df5 0x7e23 0x93fa 0x1e5d 0x801b 0x93eb 0x1ed6 0x8214 0x93db 0x1f54 0x840d 0x93ca 0x1fca 0x8605 0x93b9 0x203e 0x87fe 0x93a9 0x20e4 0x89f6 0x9398 0x218c 0x8bef 0x9380 0x2234 0x8de7 0x9367 0x22e8 0x8fe0 0x934e 0x23bf 0x91d8 0x9333 0x24b7 0x93d1 0x9311 0x259e 0x95c9 0x92f0 0x269b 0x97c2 0x92c0 0x2786 0x99bb 0x9293 0x2895 0x9bb3 0x9261 0x29c5 0x9dac 0x9229 0x2b06 0x9fa4 0x91f5 0x2c56 0xa19d 0x91b2 0x2da7 0xa395 0x916e 0x2f0a 0xa58e 0x912b 0x307e 0xa786 0x90e8 0x3203 0xa97f 0x90a7 0x3399 0xab77 0x906d 0x353b 0xad70 0x903b 0x36ca 0xaf69 0x9018 0x3881 0xb161 0x8ff7 0x3a2b 0xb35a 0x8fc7 0x3bb8 0xb552 0x8f80 0x3d42 0xb74b 0x8f0f 0x3eea 0xb943 0x8e45 0x40a4 0xbb3c 0x8c89 0x425d 0xbd34 0x8a0d 0x4520 0xbf2d 0x8699 0x3f18 0xc125 0x80be 0x3092 0xc31e 0x7b98 0x23be>;
				battery0_profile_t4_col = <0x3>;
				battery0_profile_t4_num = <0x64>;
				battery1_profile_t0 = <0x0 0xaad2 0x3a2 0x209 0xaa24 0x39e 0x412 0xa98d 0x39d 0x61c 0xa8f9 0x39d 0x825 0xa86f 0x3a9 0xa2e 0xa7e9 0x3ad 0xc37 0xa760 0x3a2 0xe41 0xa6dd 0x3b4 0x104a 0xa652 0x39e 0x1253 0xa5cf 0x39d 0x145c 0xa54d 0x39d 0x1666 0xa4d0 0x3ab 0x186f 0xa452 0x3ab 0x1a78 0xa3d3 0x3a4 0x1c81 0xa359 0x3b6 0x1e8b 0xa2e0 0x3b6 0x2094 0xa266 0x3b6 0x229d 0xa1ec 0x3b6 0x24a6 0xa173 0x3b6 0x26b0 0xa0fe 0x3b6 0x28b9 0xa08a 0x3b6 0x2ac2 0xa012 0x3b6 0x2ccb 0x9fa1 0x3b6 0x2ed5 0x9f30 0x3b6 0x30de 0x9ec8 0x3cb 0x32e7 0x9e59 0x3bd 0x34f0 0x9dee 0x3c5 0x36fa 0x9d85 0x3cf 0x3903 0x9d20 0x3cf 0x3b0c 0x9cc1 0x3d4 0x3d15 0x9c61 0x3e8 0x3f1f 0x9c02 0x3e8 0x4128 0x9ba2 0x3e8 0x4331 0x9b49 0x3f9 0x453a 0x9af2 0x401 0x4743 0x9a9b 0x401 0x494d 0x9a47 0x408 0x4b56 0x99f8 0x41a 0x4d5f 0x99a1 0x41b 0x4f68 0x9953 0x446 0x5172 0x9905 0x45f 0x537b 0x98aa 0x474 0x5584 0x9828 0x441 0x578d 0x9793 0x3e6 0x5997 0x9713 0x3b0 0x5ba0 0x96b7 0x39f 0x5da9 0x9671 0x3b5 0x5fb2 0x9634 0x3b6 0x61bc 0x95f7 0x3b6 0x63c5 0x95ba 0x3a8 0x65ce 0x9586 0x3a8 0x67d7 0x9558 0x3b6 0x69e1 0x9525 0x3b6 0x6bea 0x94fa 0x3b6 0x6df3 0x94ce 0x3b6 0x6ffc 0x94a3 0x3b6 0x7206 0x947e 0x3b6 0x740f 0x945b 0x3b6 0x7618 0x9439 0x3b6 0x7821 0x9416 0x3b6 0x7a2b 0x93f4 0x3b6 0x7c34 0x93da 0x3b6 0x7e3d 0x93c0 0x3b6 0x8046 0x93ad 0x3c8 0x8250 0x939c 0x3de 0x8459 0x938b 0x3e8 0x8662 0x9379 0x3f0 0x886b 0x9368 0x401 0x8a74 0x9355 0x401 0x8c7e 0x9332 0x401 0x8e87 0x92ef 0x3c4 0x9090 0x92b0 0x3b6 0x9299 0x927f 0x3a8 0x94a3 0x925b 0x3b2 0x96ac 0x923f 0x3cf 0x98b5 0x921a 0x3cf 0x9abe 0x91ef 0x3cf 0x9cc8 0x91cc 0x3cf 0x9ed1 0x91aa 0x3cf 0xa0da 0x9187 0x3cf 0xa2e3 0x915f 0x3db 0xa4ed 0x9129 0x3df 0xa6f6 0x90e5 0x3cf 0xa8ff 0x90a9 0x3d2 0xab08 0x906c 0x3e7 0xad12 0x9016 0x3e8 0xaf1b 0x8fb8 0x3e8 0xb124 0x8f64 0x405 0xb32d 0x8ee0 0x425 0xb537 0x8e00 0x433 0xb740 0x8cdb 0x438 0xb949 0x8bbd 0x44d 0xbb52 0x8ab9 0x463 0xbd5c 0x892d 0x43d 0xbf65 0x8704 0x454 0xc16e 0x843d 0x48d 0xc377 0x808c 0x4ec 0xc581 0x7a8d 0x7c0 0xc78a 0x6d86 0x62f 0xc993 0x6d56 0x659>;
				battery1_profile_t0_col = <0x3>;
				battery1_profile_t0_num = <0x64>;
				battery1_profile_t1 = <0x0 0xab36 0x41a 0x209 0xaa88 0x41a 0x412 0xa9f1 0x41a 0x61c 0xa969 0x429 0x825 0xa8e2 0x427 0xa2e 0xa85a 0x423 0xc37 0xa7d6 0x42e 0xe41 0xa74c 0x41c 0x104a 0xa6ca 0x432 0x1253 0xa647 0x433 0x145c 0xa5c5 0x433 0x1666 0xa543 0x433 0x186f 0xa4c0 0x428 0x1a78 0xa441 0x421 0x1c81 0xa3c6 0x42f 0x1e8b 0xa344 0x41b 0x2094 0xa2ca 0x430 0x229d 0xa250 0x433 0x24a6 0xa1dd 0x443 0x26b0 0xa167 0x44c 0x28b9 0xa0f1 0x44c 0x2ac2 0xa07e 0x44c 0x2ccb 0xa005 0x44c 0x2ed5 0x9f94 0x44c 0x30de 0x9f2c 0x461 0x32e7 0x9ebd 0x465 0x34f0 0x9e52 0x474 0x36fa 0x9de9 0x47e 0x3903 0x9d81 0x47e 0x3b0c 0x9d19 0x47e 0x3d15 0x9cb1 0x480 0x3f1f 0x9c52 0x495 0x4128 0x9bfa 0x4ab 0x4331 0x9b9c 0x4c1 0x453a 0x9b42 0x4d6 0x4743 0x9aeb 0x4ec 0x494d 0x9a95 0x4fb 0x4b56 0x9a3f 0x502 0x4d5f 0x99f1 0x52e 0x4f68 0x99a3 0x559 0x5172 0x994d 0x572 0x537b 0x98ea 0x559 0x5584 0x9878 0x52e 0x578d 0x97f7 0x4e8 0x5997 0x9771 0x486 0x5ba0 0x96fb 0x44a 0x5da9 0x96a4 0x434 0x5fb2 0x965e 0x41e 0x61bc 0x961f 0x41a 0x63c5 0x95e2 0x41a 0x65ce 0x95ae 0x425 0x67d7 0x9580 0x42b 0x69e1 0x954d 0x41e 0x6bea 0x9522 0x433 0x6df3 0x94f6 0x433 0x6ffc 0x94cb 0x41f 0x7206 0x94a6 0x42a 0x740f 0x9483 0x433 0x7618 0x9464 0x43d 0x7821 0x9448 0x446 0x7a2b 0x9426 0x433 0x7c34 0x940c 0x433 0x7e3d 0x93f2 0x449 0x8046 0x93df 0x44c 0x8250 0x93ce 0x45b 0x8459 0x93bd 0x465 0x8662 0x93af 0x465 0x886b 0x93a6 0x46a 0x8a74 0x939d 0x47c 0x8c7e 0x938b 0x466 0x8e87 0x937a 0x465 0x9090 0x9362 0x465 0x9299 0x9342 0x457 0x94a3 0x931f 0x442 0x96ac 0x92fd 0x433 0x98b5 0x92d8 0x433 0x9abe 0x92ad 0x434 0x9cc8 0x928a 0x449 0x9ed1 0x9268 0x44c 0xa0da 0x9245 0x44c 0xa2e3 0x9222 0x465 0xa4ed 0x91f4 0x475 0xa6f6 0x91b5 0x46b 0xa8ff 0x9171 0x481 0xab08 0x9134 0x496 0xad12 0x90ef 0x4c1 0xaf1b 0x908d 0x4db 0xb124 0x9024 0x51c 0xb32d 0x8fa6 0x55c 0xb537 0x8ee2 0x570 0xb740 0x8dc5 0x55f 0xb949 0x8c8f 0x55f 0xbb52 0x8b82 0x55f 0xbd5c 0x8a8c 0x587 0xbf65 0x892f 0x591 0xc16e 0x8722 0x5b9 0xc377 0x8451 0x618 0xc581 0x8086 0x6f8 0xc78a 0x7ae6 0xa67 0xc993 0x7148 0xb54>;
				battery1_profile_t1_col = <0x3>;
				battery1_profile_t1_num = <0x64>;
				battery1_profile_t2 = <0x0 0xab36 0x5fa 0x209 0xaa91 0x5f6 0x412 0xaa02 0x5f5 0x61c 0xa977 0x5f5 0x825 0xa8ec 0x5f5 0xa2e 0xa861 0x5ec 0xc37 0xa7d8 0x5e1 0xe41 0xa755 0x5f3 0x104a 0xa6ca 0x5dd 0x1253 0xa647 0x5dc 0x145c 0xa5c5 0x5dc 0x1666 0xa543 0x5dc 0x186f 0xa4c0 0x5dc 0x1a78 0xa441 0x5e3 0x1c81 0xa3c6 0x5f1 0x1e8b 0xa344 0x5dc 0x2094 0xa2ca 0x5dc 0x229d 0xa250 0x5ef 0x24a6 0xa1d7 0x5f5 0x26b0 0xa162 0x602 0x28b9 0xa0ee 0x60e 0x2ac2 0xa076 0x614 0x2ccb 0xa005 0x627 0x2ed5 0x9f94 0x627 0x30de 0x9f24 0x63c 0x32e7 0x9eba 0x652 0x34f0 0x9e4c 0x659 0x36fa 0x9ddf 0x670 0x3903 0x9d74 0x68b 0x3b0c 0x9d07 0x690 0x3d15 0x9ca7 0x6a4 0x3f1f 0x9c3e 0x6a4 0x4128 0x9be6 0x6b8 0x4331 0x9b8f 0x6de 0x453a 0x9b38 0x6fc 0x4743 0x9add 0x708 0x494d 0x9a81 0x70f 0x4b56 0x9a2a 0x725 0x4d5f 0x99d3 0x73a 0x4f68 0x9973 0x73a 0x5172 0x990c 0x715 0x537b 0x989e 0x6e9 0x5584 0x9823 0x699 0x578d 0x97a8 0x63e 0x5997 0x973b 0x603 0x5ba0 0x96de 0x5da 0x5da9 0x968f 0x5c4 0x5fb2 0x9641 0x5ae 0x61bc 0x9601 0x5aa 0x63c5 0x95c4 0x5aa 0x65ce 0x958c 0x5aa 0x67d7 0x955b 0x5aa 0x69e1 0x952e 0x5aa 0x6bea 0x94fa 0x5ab 0x6df3 0x94d8 0x5c1 0x6ffc 0x94ad 0x5c3 0x7206 0x9488 0x5c3 0x740f 0x9465 0x5d0 0x7618 0x9443 0x5d2 0x7821 0x9422 0x5c9 0x7a2b 0x9408 0x5dc 0x7c34 0x93ee 0x5dc 0x7e3d 0x93dd 0x5f2 0x8046 0x93cb 0x5f5 0x8250 0x93ba 0x5f5 0x8459 0x93b2 0x60c 0x8662 0x93af 0x627 0x886b 0x93a6 0x62c 0x8a74 0x939d 0x642 0x8c7e 0x9395 0x658 0x8e87 0x9384 0x66d 0x9090 0x9372 0x683 0x9299 0x9361 0x699 0x94a3 0x934b 0x6a4 0x96ac 0x932c 0x6a4 0x98b5 0x9300 0x6a4 0x9abe 0x92d5 0x6a5 0x9cc8 0x92a9 0x6ba 0x9ed1 0x927e 0x6e3 0xa0da 0x9252 0x70f 0xa2e3 0x921d 0x73a 0xa4ed 0x91d9 0x765 0xa6f6 0x9188 0x79d 0xa8ff 0x912e 0x7f6 0xab08 0x90bd 0x863 0xad12 0x9022 0x8cf 0xaf1b 0x8f46 0x93c 0xb124 0x8e2d 0x951 0xb32d 0x8d0a 0x93c 0xb537 0x8c07 0x936 0xb740 0x8b2f 0x95a 0xb949 0x8a7a 0x9b5 0xbb52 0x89d4 0xa4d 0xbd5c 0x8910 0xb5c 0xbf65 0x87a3 0xd4d 0xc16e 0x855d 0x14e4 0xc377 0x8263 0x2ae6 0xc581 0x7e90 0x2c09 0xc78a 0x7c92 0x2742 0xc993 0x7c92 0x2742>;
				battery1_profile_t2_col = <0x3>;
				battery1_profile_t2_num = <0x64>;
				battery1_profile_t3 = <0x0 0xab2c 0x8b6 0x209 0xaa87 0x909 0x412 0xa9f1 0x915 0x61c 0xa963 0x906 0x825 0xa8d8 0x8fc 0xa2e 0xa84d 0x8eb 0xc37 0xa7c4 0x8ca 0xe41 0xa741 0x8c8 0x104a 0xa6b6 0x8b2 0x1253 0xa633 0x8b1 0x145c 0xa5b1 0x8b1 0x1666 0xa52f 0x8b1 0x186f 0xa4ac 0x8a6 0x1a78 0xa42d 0x89f 0x1c81 0xa3b3 0x8b1 0x1e8b 0xa339 0x8b1 0x2094 0xa2b7 0x8b1 0x229d 0xa244 0x8c4 0x24a6 0xa1cd 0x8ca 0x26b0 0xa153 0x8d7 0x28b9 0xa0dd 0x8e3 0x2ac2 0xa06c 0x8e9 0x2ccb 0x9ffa 0x8f9 0x2ed5 0x9f81 0x8e3 0x30de 0x9f18 0x90d 0x32e7 0x9eb0 0x939 0x34f0 0x9e42 0x964 0x36fa 0x9dcc 0x96e 0x3903 0x9d56 0x968 0x3b0c 0x9ce7 0x979 0x3d15 0x9c7f 0x979 0x3f1f 0x9c16 0x979 0x4128 0x9bb6 0x965 0x4331 0x9b5d 0x971 0x453a 0x9b01 0x979 0x4743 0x9aa1 0x979 0x494d 0x9a3f 0x972 0x4b56 0x99d7 0x95c 0x4d5f 0x996f 0x946 0x4f68 0x9906 0x91b 0x5172 0x9897 0x8dd 0x537b 0x982c 0x8ab 0x5584 0x97c8 0x880 0x578d 0x9769 0x854 0x5997 0x970c 0x829 0x5ba0 0x96b7 0x802 0x5da9 0x9671 0x802 0x5fb2 0x962c 0x802 0x61bc 0x95ed 0x802 0x63c5 0x95b0 0x7f4 0x65ce 0x9578 0x7f4 0x67d7 0x9544 0x802 0x69e1 0x9511 0x802 0x6bea 0x94e6 0x803 0x6df3 0x94ba 0x819 0x6ffc 0x948f 0x81b 0x7206 0x946a 0x81b 0x740f 0x9447 0x81b 0x7618 0x9428 0x825 0x7821 0x940e 0x834 0x7a2b 0x93f4 0x834 0x7c34 0x93da 0x834 0x7e3d 0x93d1 0x85f 0x8046 0x93c9 0x878 0x8250 0x93c0 0x89d 0x8459 0x93b7 0x8c8 0x8662 0x93ab 0x8eb 0x886b 0x939c 0x90b 0x8a74 0x9393 0x94b 0x8c7e 0x9381 0x976 0x8e87 0x9370 0x9a2 0x9090 0x935e 0x9de 0x9299 0x9348 0xa11 0x94a3 0x932d 0xa3d 0x96ac 0x9311 0xa6f 0x98b5 0x92ee 0xab1 0x9abe 0x92cb 0xaf1 0x9cc8 0x9296 0xb1d 0x9ed1 0x9262 0xb6e 0xa0da 0x9228 0xbc5 0xa2e3 0x91e1 0xc28 0xa4ed 0x918c 0xca7 0xa6f6 0x9120 0xd34 0xa8ff 0x9092 0xda3 0xab08 0x8fed 0xe25 0xad12 0x8f15 0xe7d 0xaf1b 0x8e0a 0xeb1 0xb124 0x8cef 0xedc 0xb32d 0x8be6 0xf34 0xb537 0x8b09 0xfee 0xb740 0x8a58 0x1145 0xb949 0x89bc 0x13a5 0xbb52 0x8916 0x187a 0xbd5c 0x885a 0x2c68 0xbf65 0x8764 0x41fa 0xc16e 0x8746 0x413c 0xc377 0x8746 0x413c 0xc581 0x8746 0x413c 0xc78a 0x8746 0x413c 0xc993 0x8746 0x413c>;
				battery1_profile_t3_col = <0x3>;
				battery1_profile_t3_num = <0x64>;
				battery1_profile_t4 = <0x0 0xab04 0x12ac 0x209 0xaa3c 0x12a8 0x412 0xa992 0x1295 0x61c 0xa8f9 0x1270 0x825 0xa86a 0x1244 0xa2e 0xa7e2 0x1219 0xc37 0xa75e 0x11ed 0xe41 0xa6d4 0x11c2 0x104a 0xa652 0x1197 0x1253 0xa5cf 0x1180 0x145c 0xa54d 0x1159 0x1666 0xa4d0 0x113b 0x186f 0xa452 0x111b 0x1a78 0xa3d3 0x10f7 0x1c81 0xa359 0x10e1 0x1e8b 0xa2e0 0x10cb 0x2094 0xa266 0x10b6 0x229d 0xa1ec 0x10b3 0x24a6 0xa193 0x10f3 0x26b0 0xa11c 0x10cb 0x28b9 0xa094 0x1081 0x2ac2 0xa01c 0x1081 0x2ccb 0x9fab 0x1084 0x2ed5 0x9f3a 0x109a 0x30de 0x9eca 0x10c4 0x32e7 0x9e51 0x10de 0x34f0 0x9dd2 0x10c8 0x36fa 0x9d50 0x109c 0x3903 0x9cd1 0x1079 0x3b0c 0x9c57 0x1059 0x3d15 0x9bde 0x101a 0x3f1f 0x9b6d 0xfee 0x4128 0x9b04 0xfc3 0x4331 0x9aa2 0xfa8 0x453a 0x9a3e 0xf93 0x4743 0x99d5 0xf7d 0x494d 0x9970 0xf67 0x4b56 0x990f 0xf4e 0x4d5f 0x98a7 0xf23 0x4f68 0x9847 0xf0d 0x5172 0x97ef 0xf0a 0x537b 0x9798 0xefb 0x5584 0x9746 0xef1 0x578d 0x96f8 0xee8 0x5997 0x96aa 0xed2 0x5ba0 0x965d 0xec4 0x5da9 0x9621 0xeef 0x5fb2 0x95dc 0xedc 0x61bc 0x959d 0xee9 0x63c5 0x9566 0xeff 0x65ce 0x9532 0xf15 0x67d7 0x94fe 0xf23 0x69e1 0x94cb 0xf27 0x6bea 0x94a0 0xf3d 0x6df3 0x9474 0xf53 0x6ffc 0x9449 0xf55 0x7206 0x942b 0xf75 0x740f 0x9410 0xf94 0x7618 0x93fa 0xfbd 0x7821 0x93e9 0xffe 0x7a2b 0x93d8 0x103f 0x7c34 0x93c6 0x1080 0x7e3d 0x93b5 0x10d7 0x8046 0x93a3 0x112e 0x8250 0x9392 0x1194 0x8459 0x937c 0x1200 0x8662 0x9362 0x126d 0x886b 0x9346 0x12da 0x8a74 0x9324 0x134a 0x8c7e 0x930a 0x13e2 0x8e87 0x92df 0x1451 0x9090 0x92bb 0x14cf 0x9299 0x9293 0x1551 0x94a3 0x9267 0x15d4 0x96ac 0x9239 0x164f 0x98b5 0x9202 0x16bb 0x9abe 0x91bc 0x1729 0x9cc8 0x9177 0x17ab 0x9ed1 0x9122 0x182d 0xa0da 0x90be 0x18b0 0xa2e3 0x9051 0x193e 0xa4ed 0x8fd1 0x19cd 0xa6f6 0x8f39 0x1a55 0xa8ff 0x8e92 0x1af3 0xab08 0x8ddb 0x1bb6 0xad12 0x8d14 0x1ca4 0xaf1b 0x8c45 0x1dfd 0xb124 0x8b80 0x201d 0xb32d 0x8aca 0x23cd 0xb537 0x8a23 0x2bbd 0xb740 0x898b 0x3ac8 0xb949 0x88fe 0x457b 0xbb52 0x886d 0x44a7 0xbd5c 0x87fa 0x42e5 0xbf65 0x87fa 0x42e5 0xc16e 0x87fa 0x42e5 0xc377 0x87fa 0x42e5 0xc581 0x87fa 0x42e5 0xc78a 0x87fa 0x42e5 0xc993 0x87fa 0x42e5>;
				battery1_profile_t4_col = <0x3>;
				battery1_profile_t4_num = <0x64>;
				battery2_profile_t0 = <0x0 0xaaf7 0x370 0x201 0xaa57 0x373 0x401 0xa9c8 0x376 0x602 0xa945 0x37c 0x803 0xa8c8 0x381 0xa03 0xa84d 0x383 0xc04 0xa7d3 0x384 0xe05 0xa75c 0x38b 0x1006 0xa6e2 0x387 0x1206 0xa66a 0x38a 0x1407 0xa5f0 0x389 0x1608 0xa578 0x38a 0x1808 0xa501 0x38f 0x1a09 0xa48b 0x38f 0x1c0a 0xa414 0x38f 0x1e0a 0xa39e 0x392 0x200b 0xa329 0x392 0x220c 0xa2b5 0x395 0x240d 0xa242 0x395 0x260d 0xa1d0 0x395 0x280e 0xa161 0x39e 0x2a0f 0xa0f1 0x39a 0x2c0f 0xa083 0x39d 0x2e10 0xa017 0x3a1 0x3011 0x9fad 0x3a2 0x3211 0x9f44 0x3a4 0x3412 0x9edc 0x3a7 0x3613 0x9e77 0x3aa 0x3814 0x9e13 0x3ad 0x3a14 0x9db2 0x3b4 0x3c15 0x9d53 0x3b8 0x3e16 0x9cf6 0x3bd 0x4016 0x9c9b 0x3c4 0x4217 0x9c42 0x3cb 0x4418 0x9beb 0x3d5 0x4618 0x9b96 0x3dc 0x4819 0x9b44 0x3eb 0x4a1a 0x9af4 0x3fe 0x4c1a 0x9aa5 0x413 0x4e1b 0x9a54 0x42e 0x501c 0x9a00 0x44a 0x521d 0x999f 0x44e 0x541d 0x9918 0x40c 0x561e 0x9884 0x3b3 0x581f 0x980f 0x38d 0x5a1f 0x97b5 0x387 0x5c20 0x976b 0x388 0x5e21 0x9728 0x38b 0x6021 0x96eb 0x38b 0x6222 0x96b1 0x387 0x6423 0x967b 0x38d 0x6624 0x9646 0x38c 0x6824 0x9613 0x389 0x6a25 0x95e3 0x388 0x6c26 0x95b4 0x38c 0x6e26 0x9588 0x38f 0x7027 0x955f 0x395 0x7228 0x9536 0x396 0x7428 0x950f 0x399 0x7629 0x94e9 0x39c 0x782a 0x94c5 0x3a0 0x7a2b 0x94a2 0x3a6 0x7c2b 0x9481 0x3aa 0x7e2c 0x9463 0x3b3 0x802d 0x9445 0x3c0 0x822d 0x9428 0x3c9 0x842e 0x940b 0x3d3 0x862f 0x93ec 0x3df 0x882f 0x93c5 0x3e3 0x8a30 0x9384 0x3bb 0x8c31 0x932f 0x38e 0x8e31 0x92ee 0x38b 0x9032 0x92bd 0x397 0x9233 0x9291 0x3a0 0x9434 0x9263 0x3a0 0x9634 0x9232 0x39a 0x9835 0x9205 0x397 0x9a36 0x91de 0x39d 0x9c36 0x91ba 0x3a8 0x9e37 0x9191 0x3b3 0xa038 0x915e 0x3b4 0xa238 0x9120 0x3a7 0xa439 0x90df 0x39f 0xa63a 0x90a6 0x3b0 0xa83b 0x9060 0x3b2 0xaa3b 0x9011 0x38d 0xac3c 0x8fe3 0x37f 0xae3d 0x8fd3 0x390 0xb03d 0x8fc9 0x3ac 0xb23e 0x8fbd 0x3d8 0xb43f 0x8faa 0x41a 0xb63f 0x8f77 0x442 0xb840 0x8eac 0x3ff 0xba41 0x8d37 0x3d9 0xbc42 0x8b26 0x3fd 0xbe42 0x886f 0x440 0xc043 0x84ab 0x4c2 0xc244 0x7d7c 0x77c 0xc444 0x703b 0x725 0xc645 0x703b 0x725>;
				battery2_profile_t0_col = <0x3>;
				battery2_profile_t0_num = <0x64>;
				battery2_profile_t1 = <0x0 0xab7e 0x44c 0x201 0xaadc 0x44c 0x401 0xaa51 0x455 0x602 0xa9d0 0x456 0x803 0xa954 0x454 0xa03 0xa8da 0x454 0xc04 0xa860 0x454 0xe05 0xa7e8 0x454 0x1006 0xa76f 0x458 0x1206 0xa6f6 0x453 0x1407 0xa67d 0x450 0x1608 0xa604 0x450 0x1808 0xa58a 0x450 0x1a09 0xa512 0x44e 0x1c0a 0xa49c 0x454 0x1e0a 0xa424 0x451 0x200b 0xa3ae 0x453 0x220c 0xa33a 0x454 0x240d 0xa2c6 0x456 0x260d 0xa253 0x458 0x280e 0xa1e0 0x459 0x2a0f 0xa170 0x460 0x2c0f 0xa101 0x463 0x2e10 0xa094 0x469 0x3011 0xa028 0x46e 0x3211 0x9fbe 0x472 0x3412 0x9f56 0x479 0x3613 0x9eef 0x480 0x3814 0x9e8a 0x48a 0x3a14 0x9e26 0x494 0x3c15 0x9dc5 0x49e 0x3e16 0x9d65 0x4a9 0x4016 0x9d07 0x4b7 0x4217 0x9cad 0x4c6 0x4418 0x9c54 0x4d9 0x4618 0x9bff 0x4ed 0x4819 0x9bab 0x504 0x4a1a 0x9b57 0x519 0x4c1a 0x9b05 0x534 0x4e1b 0x9ab2 0x54f 0x501c 0x9a5a 0x55d 0x521d 0x99fc 0x562 0x541d 0x998b 0x53e 0x561e 0x9907 0x4e9 0x581f 0x9884 0x495 0x5a1f 0x9813 0x45c 0x5c20 0x97b5 0x440 0x5e21 0x9767 0x435 0x6021 0x9723 0x432 0x6222 0x96e6 0x432 0x6423 0x96ad 0x432 0x6624 0x9676 0x431 0x6824 0x9643 0x431 0x6a25 0x9611 0x433 0x6c26 0x95e2 0x436 0x6e26 0x95b5 0x436 0x7027 0x958b 0x43c 0x7228 0x9562 0x442 0x7428 0x953c 0x445 0x7629 0x9516 0x448 0x782a 0x94f3 0x44f 0x7a2b 0x94d1 0x455 0x7c2b 0x94b0 0x45c 0x7e2c 0x9492 0x469 0x802d 0x9475 0x471 0x822d 0x9458 0x478 0x842e 0x943c 0x480 0x862f 0x9421 0x489 0x882f 0x9405 0x48e 0x8a30 0x93e7 0x48b 0x8c31 0x93c3 0x47e 0x8e31 0x939a 0x46c 0x9032 0x936f 0x456 0x9233 0x9345 0x444 0x9434 0x931b 0x43b 0x9634 0x92ef 0x435 0x9835 0x92c3 0x432 0x9a36 0x929d 0x435 0x9c36 0x9279 0x435 0x9e37 0x9257 0x43b 0xa038 0x922f 0x444 0xa238 0x91fe 0x448 0xa439 0x91c0 0x445 0xa63a 0x9181 0x441 0xa83b 0x9149 0x44d 0xaa3b 0x9106 0x455 0xac3c 0x90b6 0x44d 0xae3d 0x9074 0x444 0xb03d 0x9059 0x44d 0xb23e 0x904d 0x461 0xb43f 0x9041 0x47c 0xb63f 0x9030 0x49f 0xb840 0x900d 0x4d6 0xba41 0x8f96 0x4e8 0xbc42 0x8e7b 0x4db 0xbe42 0x8c97 0x4e5 0xc043 0x8a1d 0x526 0xc244 0x8682 0x5ad 0xc444 0x7ff4 0x7fc 0xc645 0x7396 0xf88>;
				battery2_profile_t1_col = <0x3>;
				battery2_profile_t1_num = <0x64>;
				battery2_profile_t2 = <0x0 0xab92 0x596 0x201 0xaaef 0x599 0x401 0xaa64 0x59f 0x602 0xa9e5 0x59b 0x803 0xa96b 0x596 0xa03 0xa8f3 0x594 0xc04 0xa87b 0x58e 0xe05 0xa802 0x58a 0x1006 0xa789 0x57d 0x1206 0xa710 0x578 0x1407 0xa697 0x575 0x1608 0xa61e 0x570 0x1808 0xa5a5 0x56c 0x1a09 0xa52e 0x56e 0x1c0a 0xa4b5 0x564 0x1e0a 0xa43f 0x567 0x200b 0xa3c9 0x567 0x220c 0xa353 0x568 0x240d 0xa2df 0x568 0x260d 0xa26c 0x568 0x280e 0xa1fa 0x56c 0x2a0f 0xa189 0x573 0x2c0f 0xa119 0x576 0x2e10 0xa0ab 0x581 0x3011 0xa03f 0x588 0x3211 0x9fd3 0x58d 0x3412 0x9f6b 0x595 0x3613 0x9f06 0x5a1 0x3814 0x9ea4 0x5c5 0x3a14 0x9e3d 0x5e6 0x3c15 0x9dd6 0x5fe 0x3e16 0x9d6f 0x60c 0x4016 0x9d0b 0x612 0x4217 0x9caa 0x610 0x4418 0x9c4e 0x60c 0x4618 0x9bfd 0x623 0x4819 0x9ba9 0x63a 0x4a1a 0x9b52 0x64f 0x4c1a 0x9afa 0x65d 0x4e1b 0x9a9f 0x661 0x501c 0x9a3c 0x654 0x521d 0x99d0 0x62f 0x541d 0x9959 0x5f0 0x561e 0x98dd 0x5a0 0x581f 0x986a 0x55d 0x5a1f 0x9802 0x52c 0x5c20 0x97a7 0x50b 0x5e21 0x9758 0x4fa 0x6021 0x9712 0x4f3 0x6222 0x96d3 0x4f3 0x6423 0x9698 0x4f1 0x6624 0x9661 0x4f4 0x6824 0x962c 0x4f7 0x6a25 0x95fa 0x4f9 0x6c26 0x95c9 0x4ff 0x6e26 0x959b 0x4ff 0x7027 0x9570 0x50c 0x7228 0x9547 0x514 0x7428 0x951f 0x51a 0x7629 0x94f8 0x522 0x782a 0x94d4 0x52b 0x7a2b 0x94b1 0x533 0x7c2b 0x9491 0x540 0x7e2c 0x9471 0x547 0x802d 0x9453 0x551 0x822d 0x9436 0x556 0x842e 0x941a 0x55b 0x862f 0x9400 0x560 0x882f 0x93e6 0x560 0x8a30 0x93ce 0x560 0x8c31 0x93b7 0x563 0x8e31 0x93a3 0x56b 0x9032 0x938d 0x573 0x9233 0x9374 0x578 0x9434 0x9355 0x57b 0x9634 0x932f 0x57b 0x9835 0x9303 0x57b 0x9a36 0x92d9 0x584 0x9c36 0x92b3 0x59f 0x9e37 0x928d 0x5c2 0xa038 0x9261 0x5e4 0xa238 0x9229 0x602 0xa439 0x91e7 0x620 0xa63a 0x91a8 0x645 0xa83b 0x916c 0x678 0xaa3b 0x9123 0x6aa 0xac3c 0x90cf 0x6d3 0xae3d 0x9089 0x6fe 0xb03d 0x9063 0x73e 0xb23e 0x904d 0x78f 0xb43f 0x9038 0x7f5 0xb63f 0x901e 0x87c 0xb840 0x8ff0 0x93d 0xba41 0x8f75 0xa1d 0xbc42 0x8e62 0xaef 0xbe42 0x8c83 0xbcd 0xc043 0x89f3 0xd82 0xc244 0x8629 0x10bb 0xc444 0x7efe 0x1ada 0xc645 0x71fa 0xb81>;
				battery2_profile_t2_col = <0x3>;
				battery2_profile_t2_num = <0x64>;
				battery2_profile_t3 = <0x0 0xaba6 0xa8c 0x201 0xaaf1 0xa89 0x401 0xaa5d 0xa9c 0x602 0xa9d8 0xaa2 0x803 0xa95a 0xa9d 0xa03 0xa8e0 0xa93 0xc04 0xa867 0xa83 0xe05 0xa7f0 0xa76 0x1006 0xa777 0xa5f 0x1206 0xa6fe 0xa4a 0x1407 0xa685 0xa3b 0x1608 0xa60d 0xa28 0x1808 0xa594 0xa11 0x1a09 0xa51e 0xa03 0x1c0a 0xa4a6 0x9f3 0x1e0a 0xa430 0x9e2 0x200b 0xa3bb 0x9d4 0x220c 0xa347 0x9c9 0x240d 0xa2d4 0x9bf 0x260d 0xa261 0x9b8 0x280e 0xa1f1 0x9b8 0x2a0f 0xa181 0x9b4 0x2c0f 0xa111 0x9b4 0x2e10 0xa0a3 0x9b4 0x3011 0xa037 0x9ae 0x3211 0x9fcd 0x9ae 0x3412 0x9f68 0x9c0 0x3613 0x9f06 0x9e2 0x3814 0x9e9e 0xa0a 0x3a14 0x9e32 0xa1c 0x3c15 0x9dc5 0xa1e 0x3e16 0x9d58 0xa13 0x4016 0x9cef 0xa03 0x4217 0x9c8a 0x9f1 0x4418 0x9c27 0x9da 0x4618 0x9bcb 0x9cd 0x4819 0x9b77 0x9d4 0x4a1a 0x9b1e 0x9d4 0x4c1a 0x9abc 0x9c6 0x4e1b 0x9a54 0x9a9 0x501c 0x99e8 0x97d 0x521d 0x9976 0x942 0x541d 0x9906 0x906 0x561e 0x989a 0x8cd 0x581f 0x9835 0x8a0 0x5a1f 0x97d9 0x880 0x5c20 0x9784 0x869 0x5e21 0x9738 0x859 0x6021 0x96f0 0x84f 0x6222 0x96b1 0x84c 0x6423 0x9675 0x851 0x6624 0x963d 0x858 0x6824 0x9607 0x85d 0x6a25 0x95d3 0x863 0x6c26 0x95a3 0x86d 0x6e26 0x9576 0x87a 0x7027 0x9548 0x884 0x7228 0x951f 0x88e 0x7428 0x94f6 0x89a 0x7629 0x94cf 0x8a6 0x782a 0x94aa 0x8b2 0x7a2b 0x9488 0x8c2 0x7c2b 0x9467 0x8cf 0x7e2c 0x9448 0x8dc 0x802d 0x942a 0x8e4 0x822d 0x940f 0x8ef 0x842e 0x93f8 0x8ff 0x862f 0x93e5 0x916 0x882f 0x93d4 0x935 0x8a30 0x93c5 0x95d 0x8c31 0x93b6 0x987 0x8e31 0x93a6 0x9b8 0x9032 0x9392 0x9eb 0x9233 0x937a 0xa20 0x9434 0x935d 0xa56 0x9634 0x933c 0xa8e 0x9835 0x9315 0xac3 0x9a36 0x92ea 0xb0b 0x9c36 0x92be 0xb62 0x9e37 0x928e 0xbc1 0xa038 0x9257 0xc28 0xa238 0x9219 0xc9a 0xa439 0x91d6 0xd13 0xa63a 0x9194 0xda1 0xa83b 0x914d 0xe3f 0xaa3b 0x90fd 0xede 0xac3c 0x90af 0xf88 0xae3d 0x906c 0x104b 0xb03d 0x903b 0x1134 0xb23e 0x9016 0x124a 0xb43f 0x8ff4 0x13a0 0xb63f 0x8fc9 0x154c 0xb840 0x8f7d 0x1754 0xba41 0x8ee3 0x19b6 0xbc42 0x8dc4 0x1c9c 0xbe42 0x8bf2 0x20aa 0xc043 0x8960 0x276c 0xc244 0x858e 0x3715 0xc444 0x7fbf 0x2def 0xc645 0x7955 0x1de6>;
				battery2_profile_t3_col = <0x3>;
				battery2_profile_t3_num = <0x64>;
				battery2_profile_t4 = <0x0 0xabab 0x16bc 0x201 0xaac6 0x16b9 0x401 0xaa0b 0x16d4 0x602 0xa967 0x16e0 0x803 0xa8cf 0x16cf 0xa03 0xa840 0x16ab 0xc04 0xa7b9 0x1681 0xe05 0xa736 0x165d 0x1006 0xa6b4 0x162b 0x1206 0xa636 0x1602 0x1407 0xa5b9 0x15da 0x1608 0xa53d 0x15b5 0x1808 0xa4c3 0x158f 0x1a09 0xa44b 0x1560 0x1c0a 0xa3d4 0x1542 0x1e0a 0xa361 0x1524 0x200b 0xa2ee 0x150c 0x220c 0xa27c 0x14fd 0x240d 0xa20b 0x14ee 0x260d 0xa19b 0x14dc 0x280e 0xa12a 0x14ce 0x2a0f 0xa0bb 0x14b3 0x2c0f 0xa050 0x14a2 0x2e10 0x9fef 0x14ba 0x3011 0x9f8c 0x14d1 0x3211 0x9f21 0x14da 0x3412 0x9ead 0x14d4 0x3613 0x9e33 0x14b2 0x3814 0x9db9 0x1487 0x3a14 0x9d3f 0x1459 0x3c15 0x9cca 0x142f 0x3e16 0x9c5b 0x1406 0x4016 0x9bf0 0x13dd 0x4217 0x9b8c 0x13be 0x4418 0x9b30 0x13b2 0x4618 0x9ad6 0x13ae 0x4819 0x9a72 0x1388 0x4a1a 0x9a0c 0x1368 0x4c1a 0x99a5 0x1343 0x4e1b 0x993f 0x1321 0x501c 0x98dc 0x1311 0x521d 0x987c 0x12f7 0x541d 0x9822 0x12ea 0x561e 0x97cb 0x12d7 0x581f 0x9779 0x12d1 0x5a1f 0x972b 0x12d3 0x5c20 0x96e1 0x12d5 0x5e21 0x969c 0x12d8 0x6021 0x965d 0x12ec 0x6222 0x9620 0x12fd 0x6423 0x95e6 0x1310 0x6624 0x95b0 0x1324 0x6824 0x957d 0x1340 0x6a25 0x954d 0x1362 0x6c26 0x951f 0x1380 0x6e26 0x94f3 0x139e 0x7027 0x94ca 0x13bf 0x7228 0x94a5 0x13e3 0x7428 0x9487 0x1414 0x7629 0x946d 0x144e 0x782a 0x9456 0x1490 0x7a2b 0x9443 0x14df 0x7c2b 0x942f 0x1527 0x7e2c 0x941d 0x1594 0x802d 0x940c 0x1603 0x822d 0x93f9 0x1676 0x842e 0x93e6 0x16f1 0x862f 0x93d3 0x1779 0x882f 0x93bd 0x1808 0x8a30 0x93a5 0x18a0 0x8c31 0x938e 0x194f 0x8e31 0x9373 0x1a06 0x9032 0x9354 0x1ac1 0x9233 0x9334 0x1b8b 0x9434 0x9312 0x1c65 0x9634 0x92eb 0x1d3e 0x9835 0x92c2 0x1e29 0x9a36 0x9294 0x1f23 0x9c36 0x9261 0x202c 0x9e37 0x922b 0x213d 0xa038 0x91f0 0x225f 0xa238 0x91b3 0x2395 0xa439 0x9173 0x24de 0xa63a 0x912c 0x263d 0xa83b 0x90e5 0x27c3 0xaa3b 0x90a1 0x297b 0xac3c 0x9063 0x2b6f 0xae3d 0x902a 0x2daa 0xb03d 0x8ff7 0x3046 0xb23e 0x8fc6 0x3367 0xb43f 0x8f8e 0x3703 0xb63f 0x8f43 0x3b87 0xb840 0x8ecb 0x40a4 0xba41 0x8e0b 0x469c 0xbc42 0x8cf7 0x4c0e 0xbe42 0x8b7e 0x4b4d 0xc043 0x894a 0x45cb 0xc244 0x86e5 0x3fce 0xc444 0x86e5 0x3fce 0xc645 0x86e5 0x3fce>;
				battery2_profile_t4_col = <0x3>;
				battery2_profile_t4_num = <0x64>;
				battery3_profile_t0 = <0x0 0xab0e 0x384 0x1ff 0xaa7d 0x384 0x3ff 0xaa01 0x39b 0x5fe 0xa98a 0x3a5 0x7fd 0xa90f 0x398 0x9fd 0xa891 0x38d 0xbfc 0xa81a 0x3a5 0xdfc 0xa7a3 0x3a5 0xffb 0xa723 0x3a5 0x11fa 0xa6aa 0x3a5 0x13fa 0xa633 0x3a5 0x15f9 0xa5b8 0x3a5 0x17f8 0xa53a 0x3a5 0x19f8 0xa4c3 0x3a5 0x1bf7 0xa44c 0x3a5 0x1df6 0xa3d4 0x3a5 0x1ff6 0xa35d 0x3a5 0x21f5 0xa2e6 0x3a5 0x23f5 0xa272 0x3b1 0x25f4 0xa201 0x3c7 0x27f3 0xa18a 0x3c7 0x29f3 0xa11b 0x3c7 0x2bf2 0xa0a5 0x3ae 0x2df1 0xa03a 0x3cd 0x2ff1 0x9fca 0x3ca 0x31f0 0x9f59 0x3b0 0x33ef 0x9ef3 0x3cc 0x35ef 0x9e8d 0x3e8 0x37ee 0x9e26 0x3e8 0x39ee 0x9dc0 0x3e8 0x3bed 0x9d5a 0x3e8 0x3dec 0x9cf4 0x3da 0x3fec 0x9c90 0x3d0 0x41eb 0x9c34 0x3e8 0x43ea 0x9bde 0x3e8 0x45ea 0x9b89 0x404 0x47e9 0x9b2d 0x409 0x49e8 0x9ad5 0x41b 0x4be8 0x9a7f 0x438 0x4de7 0x9a2a 0x454 0x4fe7 0x99d4 0x470 0x51e6 0x9976 0x48d 0x53e5 0x9901 0x474 0x55e5 0x987c 0x42d 0x57e4 0x97f9 0x3e8 0x59e3 0x978b 0x3c7 0x5be3 0x9738 0x3c0 0x5de2 0x96ec 0x3a7 0x5fe1 0x96b0 0x3c4 0x61e1 0x9675 0x3c7 0x63e0 0x9639 0x3c7 0x65e0 0x95fd 0x3b7 0x67df 0x95c5 0x3a5 0x69de 0x9593 0x3ab 0x6bde 0x9569 0x3c6 0x6ddd 0x9536 0x3a9 0x6fdc 0x950a 0x3a5 0x71dc 0x94df 0x3a5 0x73db 0x94b4 0x3a5 0x75da 0x948d 0x3af 0x77da 0x946b 0x3c7 0x79d9 0x9448 0x3c7 0x7bd9 0x9426 0x3c7 0x7dd8 0x9404 0x3c7 0x7fd7 0x93e8 0x3d9 0x81d7 0x93ca 0x3e8 0x83d6 0x93ab 0x3f0 0x85d5 0x9390 0x409 0x87d5 0x936e 0x409 0x89d4 0x933c 0x3ee 0x8bd3 0x92ee 0x3bc 0x8dd3 0x92a8 0x3a5 0x8fd2 0x9274 0x3a5 0x91d2 0x9249 0x3a5 0x93d1 0x921f 0x3a5 0x95d0 0x91f4 0x3a5 0x97d0 0x91c9 0x3a5 0x99cf 0x91a5 0x3ba 0x9bce 0x9183 0x3c7 0x9dce 0x915e 0x3d2 0x9fcd 0x912f 0x3e8 0xa1cc 0x90f3 0x3e6 0xa3cc 0x90a6 0x3ad 0xa5cb 0x9068 0x3be 0xa7cb 0x9021 0x3c7 0xa9ca 0x8fd4 0x3a9 0xabc9 0x8f9c 0x38e 0xadc9 0x8f8d 0x3aa 0xafc8 0x8f84 0x3c7 0xb1c7 0x8f7b 0x3ff 0xb3c7 0x8f6c 0x438 0xb5c6 0x8f4a 0x471 0xb7c5 0x8ec6 0x44a 0xb9c5 0x8d9e 0x3f9 0xbbc4 0x8bcb 0x432 0xbdc4 0x895d 0x46b 0xbfc3 0x85d0 0x4da 0xc1c2 0x7ff7 0x764 0xc3c2 0x764d 0x1f31 0xc5c1 0x6fa4 0xbb8>;
				battery3_profile_t0_col = <0x3>;
				battery3_profile_t0_num = <0x64>;
				battery3_profile_t1 = <0x0 0xab4a 0x42e 0x1ff 0xaac2 0x42b 0x3ff 0xaa40 0x42b 0x5fe 0xa9c6 0x42b 0x7fd 0xa94f 0x438 0x9fd 0xa8d5 0x443 0xbfc 0xa855 0x42b 0xdfc 0xa7d5 0x42b 0xffb 0xa75d 0x42b 0x11fa 0xa6df 0x42b 0x13fa 0xa665 0x43c 0x15f9 0xa5ee 0x44c 0x17f8 0xa574 0x444 0x19f8 0xa4f5 0x42b 0x1bf7 0xa47e 0x42b 0x1df6 0xa406 0x42b 0x1ff6 0xa395 0x440 0x21f5 0xa322 0x44c 0x23f5 0xa2aa 0x44c 0x25f4 0xa235 0x452 0x27f3 0xa1c6 0x46c 0x29f3 0xa14e 0x44f 0x2bf2 0xa0df 0x465 0x2df1 0xa070 0x46d 0x2ff1 0xa001 0x46d 0x31f0 0x9f95 0x478 0x33ef 0x9f35 0x494 0x35ef 0x9ef1 0x4b0 0x37ee 0x9ea4 0x4cd 0x39ee 0x9e1e 0x4a2 0x3bed 0x9d82 0x4a2 0x3dec 0x9ced 0x4b0 0x3fec 0x9c6f 0x4b9 0x41eb 0x9c0e 0x4d5 0x43ea 0x9bca 0x4f2 0x45ea 0x9b96 0x50e 0x47e9 0x9b55 0x52b 0x49e8 0x9b0c 0x547 0x4be8 0x9abb 0x564 0x4de7 0x9a64 0x580 0x4fe7 0x9a05 0x599 0x51e6 0x999f 0x599 0x53e5 0x9929 0x564 0x55e5 0x98ab 0x516 0x57e4 0x9830 0x4c1 0x59e3 0x97c0 0x477 0x5be3 0x9760 0x445 0x5de2 0x9713 0x42b 0x5fe1 0x96cf 0x42b 0x61e1 0x9693 0x42b 0x63e0 0x9657 0x42b 0x65e0 0x9620 0x42b 0x67df 0x95ed 0x42b 0x69de 0x95bb 0x42b 0x6bde 0x9591 0x42b 0x6ddd 0x955e 0x42b 0x6fdc 0x9532 0x42b 0x71dc 0x950d 0x43e 0x73db 0x94e6 0x43e 0x75da 0x94bf 0x434 0x77da 0x949d 0x44c 0x79d9 0x947a 0x44c 0x7bd9 0x9458 0x44c 0x7dd8 0x943d 0x463 0x7fd7 0x941e 0x45b 0x81d7 0x9400 0x459 0x83d6 0x93e7 0x46d 0x85d5 0x93cd 0x471 0x87d5 0x93b3 0x48d 0x89d4 0x9392 0x474 0x8bd3 0x9376 0x46d 0x8dd3 0x9352 0x44b 0x8fd2 0x932f 0x42b 0x91d2 0x9311 0x423 0x93d1 0x92e7 0x40c 0x95d0 0x92c5 0x428 0x97d0 0x9294 0x411 0x99cf 0x926d 0x409 0x9bce 0x924b 0x419 0x9dce 0x9226 0x42b 0x9fcd 0x91f7 0x42b 0xa1cc 0x91bb 0x42a 0xa3cc 0x916e 0x40d 0xa5cb 0x9130 0x422 0xa7cb 0x90ef 0x43e 0xa9ca 0x9099 0x42e 0xabc9 0x9050 0x41d 0xadc9 0x903f 0x447 0xafc8 0x902e 0x42b 0xb1c7 0x9025 0x463 0xb3c7 0x9016 0x485 0xb5c6 0x8ffa 0x4b4 0xb7c5 0x8fa2 0x4c4 0xb9c5 0x8ebb 0x4b0 0xbbc4 0x8cf9 0x4bb 0xbdc4 0x8a9c 0x511 0xbfc3 0x8719 0x581 0xc1c2 0x8112 0x7b2 0xc3c2 0x7506 0x1a4e 0xc5c1 0x726a 0x1194>;
				battery3_profile_t1_col = <0x3>;
				battery3_profile_t1_num = <0x64>;
				battery3_profile_t2 = <0x0 0xab40 0x5dc 0x1ff 0xaab8 0x5dc 0x3ff 0xaa3e 0x5f3 0x5fe 0xa9bc 0x5eb 0x7fd 0xa937 0x5dc 0x9fd 0xa8b8 0x5d4 0xbfc 0xa839 0x5be 0xdfc 0xa7c2 0x5db 0xffb 0xa74b 0x5dc 0x11fa 0xa6cd 0x5dc 0x13fa 0xa653 0x5dc 0x15f9 0xa5dc 0x5dc 0x17f8 0xa565 0x5dc 0x19f8 0xa4ed 0x5dc 0x1bf7 0xa476 0x5dc 0x1df6 0xa3ff 0x5c3 0x1ff6 0xa38e 0x5cf 0x21f5 0xa31b 0x5dc 0x23f5 0xa2a7 0x5dc 0x25f4 0xa238 0x5e2 0x27f3 0xa1ca 0x5fd 0x29f3 0xa152 0x5fd 0x2bf2 0xa0e3 0x5fd 0x2df1 0xa074 0x610 0x2ff1 0xa00a 0x61f 0x31f0 0x9fae 0x631 0x33ef 0x9f6b 0x669 0x35ef 0x9f30 0x6a2 0x37ee 0x9ecb 0x6a4 0x39ee 0x9e28 0x68e 0x3bed 0x9d70 0x683 0x3dec 0x9cc4 0x683 0x3fec 0x9c36 0x683 0x41eb 0x9bcb 0x688 0x43ea 0x9b7e 0x6c1 0x45ea 0x9b41 0x6df 0x47e9 0x9b12 0x726 0x49e8 0x9ade 0x75b 0x4be8 0x9a99 0x761 0x4de7 0x9a42 0x745 0x4fe7 0x99e4 0x727 0x51e6 0x9975 0x6ee 0x53e5 0x9906 0x6b6 0x55e5 0x9892 0x656 0x57e4 0x9823 0x601 0x59e3 0x97c0 0x5c9 0x5be3 0x9765 0x595 0x5de2 0x9719 0x578 0x5fe1 0x96d5 0x578 0x61e1 0x9698 0x561 0x63e0 0x965c 0x557 0x65e0 0x9624 0x557 0x67df 0x95f1 0x557 0x69de 0x95bf 0x55a 0x6bde 0x9595 0x576 0x6ddd 0x956a 0x578 0x6fdc 0x9540 0x578 0x71dc 0x9515 0x578 0x73db 0x94ee 0x578 0x75da 0x94cc 0x57f 0x77da 0x94aa 0x599 0x79d9 0x9488 0x599 0x7bd9 0x9466 0x599 0x7dd8 0x944a 0x599 0x7fd7 0x9430 0x5a8 0x81d7 0x9414 0x5b0 0x83d6 0x93f5 0x59f 0x85d5 0x93e4 0x5ba 0x87d5 0x93ca 0x59e 0x89d4 0x93b8 0x5b1 0x8bd3 0x93a7 0x5a8 0x8dd3 0x9396 0x599 0x8fd2 0x9385 0x599 0x91d2 0x9373 0x599 0x93d1 0x9359 0x599 0x95d0 0x9337 0x57e 0x97d0 0x9308 0x562 0x99cf 0x92df 0x568 0x9bce 0x92ba 0x56c 0x9dce 0x928f 0x55e 0x9fcd 0x9263 0x578 0xa1cc 0x9228 0x578 0xa3cc 0x91e4 0x592 0xa5cb 0x91a7 0x5ae 0xa7cb 0x9162 0x5bb 0xa9ca 0x910f 0x5bb 0xabc9 0x90bb 0x5c0 0xadc9 0x9092 0x5dd 0xafc8 0x9080 0x5f9 0xb1c7 0x906f 0x616 0xb3c7 0x905e 0x645 0xb5c6 0x9045 0x68c 0xb7c5 0x9015 0x6ea 0xb9c5 0x8fa3 0x74b 0xbbc4 0x8e5f 0x74b 0xbdc4 0x8c3c 0x7b9 0xbfc3 0x8946 0x886 0xc1c2 0x84be 0xa2c 0xc3c2 0x7bb3 0x1943 0xc5c1 0x731e 0x1493>;
				battery3_profile_t2_col = <0x3>;
				battery3_profile_t2_num = <0x64>;
				battery3_profile_t3 = <0x0 0xab54 0x9a6 0x1ff 0xaac3 0x9a3 0x3ff 0xaa33 0x9a3 0x5fe 0xa9a8 0x9a3 0x7fd 0xa91f 0x988 0x9fd 0xa89a 0x960 0xbfc 0xa81a 0x95c 0xdfc 0xa79b 0x940 0xffb 0xa723 0x93f 0x11fa 0xa6ac 0x93f 0x13fa 0xa635 0x93f 0x15f9 0xa5be 0x933 0x17f8 0xa547 0x91d 0x19f8 0xa4cf 0x91b 0x1bf7 0xa458 0x8ff 0x1df6 0xa3e9 0x915 0x1ff6 0xa37a 0x91d 0x21f5 0xa30c 0x91d 0x23f5 0xa29a 0x91d 0x25f4 0xa224 0x91d 0x27f3 0xa1b6 0x91e 0x29f3 0xa147 0x93a 0x2bf2 0xa0d9 0x957 0x2df1 0xa06a 0x94d 0x2ff1 0xa008 0x94d 0x31f0 0x9fbb 0x97b 0x33ef 0x9f7e 0x9d4 0x35ef 0x9f3a 0xa46 0x37ee 0x9ebc 0xa49 0x39ee 0x9e07 0xa1c 0x3bed 0x9d3e 0x9d2 0x3dec 0x9c8c 0x9af 0x3fec 0x9c02 0x9bc 0x41eb 0x9b8e 0x9a5 0x43ea 0x9b39 0x9c2 0x45ea 0x9af4 0x9de 0x47e9 0x9ab6 0x9fa 0x49e8 0x9a75 0xa07 0x4be8 0x9a2e 0x9fc 0x4de7 0x99de 0x9d3 0x4fe7 0x9980 0x97e 0x51e6 0x9911 0x929 0x53e5 0x98aa 0x8d4 0x55e5 0x9844 0x892 0x57e4 0x97e6 0x859 0x59e3 0x9791 0x82a 0x5be3 0x973f 0x813 0x5de2 0x96fb 0x813 0x5fe1 0x96b7 0x7f7 0x61e1 0x967a 0x7f1 0x63e0 0x9643 0x7f1 0x65e0 0x9610 0x7f1 0x67df 0x95dd 0x7f1 0x69de 0x95aa 0x7f1 0x6bde 0x9577 0x7f1 0x6ddd 0x954c 0x7f1 0x6fdc 0x9522 0x7f1 0x71dc 0x94fc 0x802 0x73db 0x94da 0x81e 0x75da 0x94b8 0x834 0x77da 0x9496 0x834 0x79d9 0x9474 0x834 0x7bd9 0x9452 0x834 0x7dd8 0x9436 0x848 0x7fd7 0x941c 0x855 0x81d7 0x9403 0x855 0x83d6 0x93eb 0x855 0x85d5 0x93da 0x855 0x87d5 0x93c9 0x855 0x89d4 0x93bf 0x86d 0x8bd3 0x93b6 0x889 0x8dd3 0x93aa 0x898 0x8fd2 0x939b 0x8a9 0x91d2 0x9391 0x8db 0x93d1 0x9377 0x8db 0x95d0 0x935e 0x8db 0x97d0 0x933d 0x8f1 0x99cf 0x9316 0x8fc 0x9bce 0x92ec 0x908 0x9dce 0x92bf 0x925 0x9fcd 0x928b 0x943 0xa1cc 0x9250 0x97c 0xa3cc 0x920c 0x9b5 0xa5cb 0x91c8 0x9ed 0xa7cb 0x9180 0xa36 0xa9ca 0x9130 0xa8b 0xabc9 0x90e0 0xada 0xadc9 0x90a5 0xb15 0xafc8 0x908c 0xba3 0xb1c7 0x9072 0xc49 0xb3c7 0x9059 0xd1a 0xb5c6 0x9037 0xe52 0xb7c5 0x8ff9 0x1005 0xb9c5 0x8f76 0x11f6 0xbbc4 0x8e55 0x13a0 0xbdc4 0x8c3a 0x1627 0xbfc3 0x894d 0x1b19 0xc1c2 0x84e3 0x257e 0xc3c2 0x7d6e 0x2fbf 0xc5c1 0x7436 0x19a7>;
				battery3_profile_t3_col = <0x3>;
				battery3_profile_t3_num = <0x64>;
				battery3_profile_t4 = <0x0 0xabc2 0x1496 0x1ff 0xaaf6 0x1493 0x3ff 0xaa4d 0x14aa 0x5fe 0xa9b1 0x14a2 0x7fd 0xa917 0x146a 0x9fd 0xa883 0x1426 0xbfc 0xa7fb 0x1403 0xdfc 0xa773 0x13ae 0xffb 0xa6f3 0x138e 0x11fa 0xa67a 0x135c 0x13fa 0xa5fe 0x1323 0x15f9 0xa582 0x12eb 0x17f8 0xa50b 0x12b9 0x19f8 0xa494 0x129d 0x1bf7 0xa425 0x1280 0x1df6 0xa3b7 0x1264 0x1ff6 0xa348 0x125c 0x21f5 0xa2d5 0x123d 0x23f5 0xa261 0x1219 0x25f4 0xa1f2 0x1219 0x27f3 0xa184 0x1219 0x29f3 0xa115 0x11fc 0x2bf2 0xa0a7 0x11c8 0x2df1 0xa049 0x11db 0x2ff1 0x9ff8 0x1230 0x31f0 0x9fac 0x12ab 0x33ef 0x9f5a 0x1328 0x35ef 0x9eec 0x1344 0x37ee 0x9e43 0x12bc 0x39ee 0x9d85 0x122e 0x3bed 0x9cc6 0x118f 0x3dec 0x9c1e 0x110a 0x3fec 0x9b94 0x10bd 0x41eb 0x9b1f 0x1084 0x43ea 0x9ab9 0x104b 0x45ea 0x9a62 0x1047 0x47e9 0x9a13 0x1047 0x49e8 0x99c7 0x1037 0x4be8 0x997a 0x101a 0x4de7 0x992e 0xffe 0x4fe7 0x98e1 0xfe0 0x51e6 0x988b 0xfa8 0x53e5 0x9836 0xf6f 0x55e5 0x97e7 0xf4a 0x57e4 0x979b 0xf2d 0x59e3 0x974e 0xf11 0x5be3 0x9704 0xef9 0x5de2 0x96c9 0xef9 0x5fe1 0x9685 0xef9 0x61e1 0x9648 0xee2 0x63e0 0x9611 0xeea 0x65e0 0x95de 0xf06 0x67df 0x95ab 0xf1b 0x69de 0x9579 0xf1e 0x6bde 0x954f 0xf3a 0x6ddd 0x9524 0xf3c 0x6fdc 0x94fa 0xf52 0x71dc 0x94d4 0xf6e 0x73db 0x94af 0xf7f 0x75da 0x9486 0xf85 0x77da 0x9464 0xfa2 0x79d9 0x944b 0xfbe 0x7bd9 0x9431 0xfc1 0x7dd8 0x9418 0xfc1 0x7fd7 0x9407 0xfe0 0x81d7 0x93fc 0x1018 0x83d6 0x93ec 0x1051 0x85d5 0x93e4 0x108a 0x87d5 0x93d3 0x10c3 0x89d4 0x93c2 0x1113 0x8bd3 0x93b6 0x117b 0x8dd3 0x93a6 0x11de 0x8fd2 0x938f 0x123c 0x91d2 0x937d 0x12b1 0x93d1 0x9363 0x133f 0x95d0 0x934a 0x13e8 0x97d0 0x9329 0x147c 0x99cf 0x9302 0x151b 0x9bce 0x92d8 0x15d2 0x9dce 0x92ab 0x1698 0x9fcd 0x9278 0x1763 0xa1cc 0x9245 0x1862 0xa3cc 0x9202 0x1962 0xa5cb 0x91be 0x1a8a 0xa7cb 0x917a 0x1bd2 0xa9ca 0x9136 0x1d47 0xabc9 0x90f4 0x1f01 0xadc9 0x90b9 0x2105 0xafc8 0x9085 0x23ad 0xb1c7 0x905a 0x26e7 0xb3c7 0x9029 0x2b0e 0xb5c6 0x8fea 0x307d 0xb7c5 0x8f8c 0x3759 0xb9c5 0x8efc 0x3f46 0xbbc4 0x8e0e 0x46eb 0xbdc4 0x8c81 0x4bf7 0xbfc3 0x8a55 0x50c6 0xc1c2 0x876d 0x5420 0xc3c2 0x82d8 0x47fc 0xc5c1 0x7724 0x221d>;
				battery3_profile_t4_col = <0x3>;
				battery3_profile_t4_num = <0x64>;
				bootmode = <0x26>;
				charger = <0x25>;
				compatible = "mediatek,mt6357-gauge";
				g_FG_PSEUDO100_T0 = <0x5f>;
				g_FG_PSEUDO100_T1 = <0x5e>;
				g_FG_PSEUDO100_T2 = <0x5f>;
				g_FG_PSEUDO100_T3 = <0x55>;
				g_FG_PSEUDO100_T4 = <0x55>;
				io-channel-names = "pmic_battery_temp", "pmic_battery_voltage", "pmic_bif_voltage", "pmic_ptim_voltage", "pmic_ptim_r", "ap_batt_id";
				io-channels = <0x23 0x3 0x23 0x1 0x23 0xe 0x23 0xf 0x23 0x10 0x27 0x2>;
				nvmem-cell-names = "initialization", "state-of-charge";
				nvmem-cells = <0x28 0x29>;
				phandle = <0x60>;
			};

			mtk_rtc {
				#address-cells = <0x1>;
				#size-cells = <0x1>;
				bootmode = <0x26>;
				compatible = "mediatek,mt6357-rtc";
				phandle = <0x92>;

				ext_32k {
					bits = <0x6 0x1>;
					phandle = <0x93>;
					reg = <0x2 0x1>;
				};

				fg_init {
					bits = <0x0 0x8>;
					phandle = <0x28>;
					reg = <0x0 0x1>;
				};

				fg_soc {
					bits = <0x0 0x8>;
					phandle = <0x29>;
					reg = <0x1 0x1>;
				};
			};

			mtk_ts_pmic {
				#interconnect-cells = <0x1>;
				compatible = "mediatek,mtk_ts_pmic";
				interconnects = <0x23 0x1>;
				io-channel-names = "pmic_chip_temp", "pmic_buck1_temp", "pmic_buck2_temp";
				io-channels = <0x23 0x5 0x23 0x6 0x23 0x7>;
				phandle = <0x2a>;
			};

			pmic_accdet {
				accdet-mic-mode = <0x1>;
				accdet-mic-vol = <0x6>;
				accdet-name = "mt63xx-accdet";
				accdet-plugout-debounce = <0x1>;
				compatible = "mediatek,mt6357-accdet";
				headset-eint-level-pol = <0x8>;
				headset-eint-num = <0x0>;
				headset-eint-trig-mode = <0x0>;
				headset-four-key-threshold = <0x0 0x3a 0x79 0xc0 0x190>;
				headset-key-mode = <0x0>;
				headset-mode-setting = <0x500 0x500 0x1 0x1f0 0x800 0x800 0x20 0x44>;
				headset-three-key-threshold = <0x0 0x50 0xdc 0x190>;
				headset-three-key-threshold-CDD = <0x0 0x79 0xc0 0x258>;
				headset-use-ap-eint = <0x0>;
				io-channel-names = "pmic_accdet";
				io-channels = <0x23 0x9>;
				nvmem = <0x24>;
				nvmem-names = "mt63xx-accdet-efuse";
				phandle = <0x73>;
				status = "okay";
			};

			pmic_auxadc {
				#interconnect-cells = <0x1>;
				#io-channel-cells = <0x1>;
				compatible = "mediatek,pmic-auxadc", "mediatek,mt6357-auxadc";
				phandle = <0x23>;

				accdet {
					channel = <0x9>;
				};

				bat_temp {
					channel = <0x3>;
					resistance-ratio = <0x1 0x1>;
				};

				batadc {
					avg-num = <0x80>;
					channel = <0x0>;
					resistance-ratio = <0x3 0x1>;
				};

				chip_temp {
					channel = <0x5>;
				};

				dcxo_temp {
					avg-num = <0x10>;
					channel = <0xd>;
				};

				hpofs_cal {
					avg-num = <0x100>;
					channel = <0xc>;
				};

				imix_r {
					channel = <0x10>;
				};

				imp {
					avg-num = <0x80>;
					channel = <0xf>;
					resistance-ratio = <0x3 0x1>;
				};

				isense {
					avg-num = <0x80>;
					channel = <0x1>;
					resistance-ratio = <0x3 0x1>;
				};

				tsx_temp {
					avg-num = <0x80>;
					channel = <0xb>;
				};

				vbif {
					channel = <0xe>;
					resistance-ratio = <0x1 0x1>;
				};

				vcdt {
					channel = <0x2>;
				};

				vcore_temp {
					channel = <0x6>;
				};

				vproc_temp {
					channel = <0x7>;
				};
			};

			pmic_codec {
				compatible = "mediatek,mt6357-sound";
				io-channel-names = "pmic_codec", "pmic_accdet";
				io-channels = <0x23 0xc 0x23 0x9>;
				mediatek,pwrap-regmap = <0x12>;
				nvmem = <0x24>;
				nvmem-names = "pmic-hp-efuse";
				phandle = <0x94>;
				use_hp_depop_flow = <0x0>;
				use_ul_260k = <0x0>;
			};

			pmic_efuse {
				#address-cells = <0x1>;
				#size-cells = <0x1>;
				compatible = "mediatek,mt6357-efuse";
				phandle = <0x24>;
			};

			pmic_lbat_service {
				compatible = "mediatek,mt6357-lbat_service";
			};
		};
	};

	radio_md_cfg {
		compatible = "mediatek,radio_md_cfg";
		phandle = <0xe8>;
	};

	regulator_vibrator {
		compatible = "regulator-vibrator";
		max-limit = <0x3a98>;
		max-volt = <0x30d400>;
		min-limit = <0xf>;
		min-volt = <0x231860>;
		vib-supply = <0x1f>;
	};

	reserved-memory {
		#address-cells = <0x2>;
		#size-cells = <0x2>;
		ranges;

		consys-reserve-memory {
			alignment = <0x0 0x1000000>;
			alloc-ranges = <0x0 0x40000000 0x0 0x80000000>;
			compatible = "mediatek,consys-reserve-memory";
			no-map;
			phandle = <0x48>;
			size = <0x0 0x400000>;
		};

		reserve-memory-scp_share {
			alignment = <0x0 0x1000000>;
			alloc-ranges = <0x0 0x40000000 0x0 0x50000000>;
			compatible = "mediatek,reserve-memory-scp_share";
			no-map;
			size = <0x0 0x300000>;
		};

		reserve-memory-sspm_share {
			alignment = <0x0 0x10000>;
			alloc-ranges = <0x0 0x40000000 0x0 0x60000000>;
			compatible = "mediatek,reserve-memory-sspm_share";
			no-map;
			size = <0x0 0x110000>;
			status = "okay";
		};

		soter-shared-mem {
			alignment = <0x0 0x200000>;
			alloc-ranges = <0x0 0x40000000 0x0 0x50000000>;
			compatible = "microtrust,shared_mem";
			no-map;
			size = <0x0 0x200000>;
		};

		wifi-reserve-memory {
			alignment = <0x0 0x1000000>;
			alloc-ranges = <0x0 0x40000000 0x0 0x80000000>;
			compatible = "shared-dma-pool";
			no-map;
			phandle = <0x49>;
			size = <0x0 0x300000>;
		};
	};

	rt-pd-manager {
		compatible = "mediatek,rt-pd-manager";
	};

	rt9465_slave_chr {
		compatible = "richtek,rt9465";
		phandle = <0xe3>;
		status = "disabled";
	};

	scp@10500000 {
		compatible = "mediatek,scp";
		core_1 = "enable";
		interrupts = <0x0 0x88 0x4>;
		phandle = <0x96>;
		reg = <0x0 0x10500000 0x0 0x40000 0x0 0x105c0000 0x0 0x3000 0x0 0x105c4000 0x0 0x1000 0x0 0x105d4000 0x0 0x6000>;
		scp_feature_tbl = <0x0 0x2f 0x1 0x164 0x2 0x3e 0x3 0x2f 0x4 0x1a 0x5 0x0 0x6 0xc8 0x7 0x0 0x8 0x64 0x9 0xa>;
		scp_mem_key = "mediatek,reserve-memory-scp_share";
		scp_mem_tbl = <0x1 0x100000 0x4 0x200000>;
		scp_mpuRegionId = <0x1b>;
		scp_sramSize = <0x40000>;
		status = "okay";
	};

	scp_dvfs {
		clock-names = "clk_mux", "clk_pll_0", "clk_pll_1", "clk_pll_2", "clk_pll_3", "clk_pll_4", "clk_pll_5", "clk_pll_6";
		clocks = <0xf 0x6c 0x21 0xf 0x10 0xf 0x1d 0xf 0x4 0xf 0x1a 0xf 0x8 0xf 0x1c>;
		compatible = "mediatek,scp_dvfs";
		dvfs-opp = <0xff 0xff 0xff 0x0 0x0 0xfa 0x0 0xff 0xff 0xff 0x0 0x0 0x111 0x3 0xff 0xff 0xff 0x2 0x8 0x14a 0x5 0xff 0xff 0xff 0x3 0xc 0x1a0 0x6>;
		dvfsrc-opp-num = <0x3>;
		gpio = <0x16 0x1>;
		gpio-feature = "gpio-mode";
		gpio-feature-cfg = <0x0>;
		pmic = <0x2c>;
		pmic-feature = "pmic-vow-lp", "pmic-pmrc";
		pmic-feature-cfg = <0x0 0x0>;
	};

	scp_infra@10001000 {
		compatible = "mediatek,scpinfra";
		phandle = <0x66>;
		reg = <0x0 0x10001000 0x0 0x1000>;
	};

	scpsys@10001000 {
		#clock-cells = <0x1>;
		clock-names = "mm", "mfg", "mm-0", "mm-1", "mm-2", "mm-3", "cam-0", "cam-1", "cam-2", "cam-3";
		clocks = <0xf 0x6b 0xf 0x6d 0x10 0x15 0x10 0x16 0x10 0x13 0x10 0x14 0x11 0x0 0x11 0x1 0x10 0x19 0x10 0x18>;
		compatible = "mediatek,mt6761-scpsys", "syscon";
		phandle = <0x34>;
		reg = <0x0 0x10001000 0x0 0x1000 0x0 0x10006000 0x0 0x1000 0x0 0x14002000 0x0 0x1000 0x0 0x1020e000 0x0 0x1000 0x0 0x18004000 0x0 0x1000>;
	};

	security_ao@1001a000 {
		compatible = "mediatek,security_ao";
		reg = <0x0 0x1001a000 0x0 0x1000>;
	};

	serial@11020000 {
		clock-names = "baud", "bus";
		clocks = <0x21 0x22 0x16>;
		compatible = "mediatek,mt6761-uart", "mediatek,mt6577-uart";
		dma-names = "tx", "rx";
		dmas = <0x45 0x0 0x45 0x1>;
		interrupts = <0x0 0x23 0x8>;
		phandle = <0xa6>;
		reg = <0x0 0x11002000 0x0 0x1000>;
	};

	serial@11030000 {
		clock-names = "baud", "bus";
		clocks = <0x21 0x22 0x17>;
		compatible = "mediatek,mt6761-uart", "mediatek,mt6577-uart";
		dma-names = "tx", "rx";
		dmas = <0x45 0x2 0x45 0x3>;
		interrupts = <0x0 0x24 0x8>;
		phandle = <0xa7>;
		reg = <0x0 0x11003000 0x0 0x1000>;
	};

	sgm41513 {
		compatible = "sgm, sgm41513_charger";
		phandle = <0xe1>;
	};

	silead_fp {
		compatible = "sil,silead_fp-pins";
		phandle = <0x9c>;
	};

	silead_fp_platform {
		compatible = "sil,silead_fp";
	};

	simtray {
		compatible = "xiaomi,simtray-status";
		status-gpio = <0x1e 0x2f 0x0>;
	};

	sleep@10006000 {
		compatible = "mediatek,sleep", "syscon";
		interrupts = <0x0 0x7d 0x8>;
		mediatek,pwrap-regmap = <0x12>;
		phandle = <0x62>;
		reg = <0x0 0x10006000 0x0 0x1000>;
		wakeup-source = <0x13 0x0 0x4 0x14 0x1 0x20 0x15 0x3 0x2000000>;
	};

	sleep_reg_md@1000f000 {
		compatible = "mediatek,sleep_reg_md";
		reg = <0x0 0x1000f000 0x0 0x1000>;
	};

	smart_pa {
		phandle = <0x68>;
	};

	smi_common@14002000 {
		clock-names = "apb", "gals0", "gals1", "smi";
		clocks = <0x34 0x3 0x10 0x15 0x10 0x16 0x10 0x13>;
		compatible = "mediatek,smi_common", "mediatek,mt6761-smi-common";
		mediatek,smi-cnt = <0x4>;
		mediatek,smi-id = <0x3>;
		mmsys_config = <0x38>;
		phandle = <0xd0>;
		reg = <0x0 0x14002000 0x0 0x1000>;
	};

	smi_larb0@14003000 {
		clock-names = "apb", "smi";
		clocks = <0x34 0x3 0x10 0x14>;
		compatible = "mediatek,smi_larb0", "mediatek,smi_larb", "mediatek,mt6761-smi-larb";
		mediatek,larb-id = <0x0>;
		mediatek,smi-id = <0x0>;
		phandle = <0x31>;
		reg = <0x0 0x14003000 0x0 0x1000>;
	};

	smi_larb1@17010000 {
		clock-names = "apb", "smi";
		clocks = <0x34 0x9 0x5f 0x1>;
		compatible = "mediatek,smi_larb1", "mediatek,smi_larb", "mediatek,mt6761-smi-larb";
		mediatek,larb-id = <0x1>;
		mediatek,smi-id = <0x1>;
		phandle = <0x32>;
		reg = <0x0 0x17010000 0x0 0x1000>;
	};

	smi_larb2@15001000 {
		clock-names = "apb", "gals", "smi";
		clocks = <0x34 0x8 0x10 0x18 0x11 0x0>;
		compatible = "mediatek,smi_larb2", "mediatek,smi_larb", "mediatek,mt6761-smi-larb";
		mediatek,larb-id = <0x2>;
		mediatek,smi-id = <0x2>;
		phandle = <0x33>;
		reg = <0x0 0x15001000 0x0 0x1000>;
	};

	spi0@1100a000 {
		clock-names = "parent-clk", "sel-clk", "spi-clk";
		clocks = <0xf 0xd 0xf 0x74 0x22 0x1b>;
		compatible = "mediatek,mt6765-spi";
		interrupts = <0x0 0x3e 0x8>;
		mediatek,pad-select = <0x0>;
		phandle = <0xb4>;
		reg = <0x0 0x1100a000 0x0 0x1000>;
	};

	spi1@11010000 {
		clock-names = "parent-clk", "sel-clk", "spi-clk";
		clocks = <0xf 0xd 0xf 0x74 0x22 0x34>;
		compatible = "mediatek,mt6765-spi";
		interrupts = <0x0 0x42 0x8>;
		mediatek,pad-select = <0x0>;
		phandle = <0xb9>;
		reg = <0x0 0x11010000 0x0 0x1000>;
	};

	spi2@11012000 {
		clock-names = "parent-clk", "sel-clk", "spi-clk";
		clocks = <0xf 0xd 0xf 0x74 0x22 0x37>;
		compatible = "mediatek,mt6765-spi";
		interrupts = <0x0 0x48 0x8>;
		mediatek,pad-select = <0x0>;
		phandle = <0xba>;
		reg = <0x0 0x11012000 0x0 0x1000>;
	};

	spi3@11013000 {
		clock-names = "parent-clk", "sel-clk", "spi-clk";
		clocks = <0xf 0xd 0xf 0x74 0x22 0x38>;
		compatible = "mediatek,mt6765-spi";
		interrupts = <0x0 0x49 0x8>;
		mediatek,pad-select = <0x0>;
		phandle = <0xbb>;
		reg = <0x0 0x11013000 0x0 0x1000>;
	};

	spi4@11014000 {
		clock-names = "parent-clk", "sel-clk", "spi-clk";
		clocks = <0xf 0xd 0xf 0x74 0x22 0x41>;
		compatible = "mediatek,mt6765-spi";
		interrupts = <0x0 0x27 0x8>;
		mediatek,pad-select = <0x0>;
		phandle = <0xbc>;
		reg = <0x0 0x11014000 0x0 0x1000>;
	};

	spi5@11015000 {
		clock-names = "parent-clk", "sel-clk", "spi-clk";
		clocks = <0xf 0xd 0xf 0x74 0x22 0x42>;
		compatible = "mediatek,mt6765-spi";
		interrupts = <0x0 0x28 0x8>;
		mediatek,pad-select = <0x0>;
		phandle = <0xbd>;
		reg = <0x0 0x11015000 0x0 0x1000>;
	};

	sramrom@10214000 {
		compatible = "mediatek,sramrom";
		reg = <0x0 0x10214000 0x0 0x1000>;
	};

	sspm@10440000 {
		compatible = "mediatek,mt6761-sspm";
		interrupt-names = "ipc", "mbox0", "mbox1", "mbox2", "mbox3", "mbox4";
		interrupts = <0x0 0x92 0x4 0x0 0x95 0x4 0x0 0x96 0x4 0x0 0x97 0x4 0x0 0x98 0x4 0x0 0x99 0x4>;
		reg = <0x0 0x10440000 0x0 0x10000 0x0 0x10450000 0x0 0x100 0x0 0x10451000 0x0 0x8 0x0 0x10460000 0x0 0x100 0x0 0x10461000 0x0 0x8 0x0 0x10470000 0x0 0x100 0x0 0x10471000 0x0 0x8 0x0 0x10480000 0x0 0x100 0x0 0x10481000 0x0 0x8 0x0 0x10490000 0x0 0x100 0x0 0x10491000 0x0 0x8>;
		reg-names = "cfgreg", "mbox0_base", "mbox0_ctrl", "mbox1_base", "mbox1_ctrl", "mbox2_base", "mbox2_ctrl", "mbox3_base", "mbox3_ctrl", "mbox4_base", "mbox4_ctrl";
	};

	swtp {
		compatible = "mediatek, swtp-eint";
		phandle = <0x9d>;
	};

	swtp1 {
		compatible = "mediatek, swtp1-eint";
		phandle = <0x9e>;
	};

	sys_cirq@10204000 {
		compatible = "mediatek,sys_cirq";
		interrupts = <0x0 0xe0 0x8>;
		mediatek,cirq_num = <0xd1>;
		mediatek,spi_start_offset = <0x10>;
		reg = <0x0 0x10204000 0x0 0x1000>;
	};

	syscfg_pctl_0@10005000 {
		compatible = "mediatek,mt6761-pctl-0-syscfg", "syscon";
		phandle = <0x6d>;
		reg = <0x0 0x10005000 0x0 0x1000>;
	};

	tcpc_pd {
		phandle = <0x69>;
	};

	therm_ctrl@1100b000 {
		clock-names = "therm-main";
		clocks = <0x22 0xa>;
		compatible = "mediatek,therm_ctrl";
		interrupts = <0x0 0x16 0x8>;
		nvmem = <0x44>;
		nvmem-cell-names = "cpu_freq_segment_cell", "thermal_efuse_cell";
		nvmem-cells = <0x46 0x47>;
		nvmem-names = "mtk_efuse";
		reg = <0x0 0x1100b000 0x0 0x1000>;
	};

	thermal-sensor1 {
		compatible = "mediatek,mtboard-thermistor1";
		interconnects = <0x27 0x0>;
		io-channel-names = "thermistor-ch0";
		io-channels = <0x27 0x0>;
		phandle = <0xb5>;
	};

	thermal-sensor2 {
		compatible = "mediatek,mtboard-thermistor2";
		interconnects = <0x27 0x1>;
		io-channel-names = "thermistor-ch1";
		io-channels = <0x27 0x1>;
		phandle = <0xb6>;
	};

	thermal-sensor3 {
		compatible = "mediatek,mtboard-thermistor3";
		interconnects = <0x27 0x2>;
		io-channel-names = "thermistor-ch2";
		io-channels = <0x27 0x2>;
		phandle = <0xb7>;
	};

	thermal-sensor5 {
		compatible = "mediatek,mtboard-thermistor5";
		interconnects = <0x27 0x4>;
		io-channel-names = "thermistor-ch4";
		io-channels = <0x27 0x4>;
		phandle = <0xb8>;
	};

	timer {
		clock-frequency = <0xc65d40>;
		compatible = "arm,armv8-timer";
		interrupt-parent = <0xe>;
		interrupts = <0x1 0xd 0x8 0x1 0xe 0x8 0x1 0xb 0x8 0x1 0xa 0x8>;
	};

	timer@10017000 {
		clocks = <0x30>;
		compatible = "mediatek,sys_timer", "mediatek,mt6761-timer", "mediatek,mt6765-timer";
		interrupts = <0x0 0x8a 0x4>;
		phandle = <0xa0>;
		reg = <0x0 0x10017000 0x0 0x1000>;
		reg-names = "sys_timer_base";
	};

	tkcore {
		compatible = "trustkernel,tkcore";
		interrupts = <0x0 0xc4 0x1>;
	};

	topckgen@10000000 {
		#clock-cells = <0x1>;
		compatible = "mediatek,mt6761-topckgen", "syscon";
		phandle = <0xf>;
		reg = <0x0 0x10000000 0x0 0x1000>;
	};

	topckgen_ao@1001b000 {
		compatible = "mediatek,topckgen_ao";
		reg = <0x0 0x1001b000 0x0 0x1000>;
	};

	topmisc@10011000 {
		compatible = "mediatek,topmisc";
		reg = <0x0 0x10011000 0x0 0x1000>;
	};

	toprgu@10007000 {
		#reset-cells = <0x1>;
		compatible = "mediatek,mt6761-wdt", "mediatek,mt6589-wdt", "mediatek,toprgu", "syscon", "simple-mfd";
		interrupts = <0x0 0x53 0x0>;
		phandle = <0x43>;
		reg = <0x0 0x10007000 0x0 0x1000>;

		reboot-mode {
			compatible = "syscon-reboot-mode";
			mask = <0xf>;
			mode-bootloader = <0x3>;
			mode-charger = <0x1>;
			mode-ddr-reserve = <0x6>;
			mode-dm-verity-dev-corrupt = <0x4>;
			mode-kpoc = <0x5>;
			mode-meta = <0x7>;
			mode-recovery = <0x2>;
			mode-rpmbpk = <0x8>;
			offset = <0x24>;
		};
	};

	touch {
		compatible = "mediatek,touch";
		phandle = <0x98>;
	};

	trng@1020f000 {
		compatible = "mediatek,trng";
		interrupts = <0x0 0x69 0x8>;
		reg = <0x0 0x1020f000 0x0 0x1000>;
	};

	type_c_port0 {
		charger = <0x64>;
		mt-tcpc,name = "type_c_port0";
		mt-tcpc,notifier_supply_num = <0x2>;
		mt-tcpc,role_def = <0x5>;
		mt-tcpc,rp_level = <0x1>;
		mt-tcpc,vconn_supply = <0x1>;
		mt6370pd,intr_gpio = <0x1e 0x18 0x0>;
		mt6370pd,intr_gpio_num = <0x18>;
		phandle = <0xed>;

		displayport {
			1st_connection = "dfp_d";
			2nd_connection = "dfp_d";
			signal,dp_v13;
			typec,receptacle;

			dfp_d {
				pin_assignment,mode_c;
				pin_assignment,mode_d;
				pin_assignment,mode_e;
			};

			ufp_d {
			};
		};

		dpm_caps {
			attemp_discover_cable;
			attemp_discover_id;
			attemp_enter_dp_mode;
			dr_check = <0x0>;
			local_dr_data;
			local_dr_power;
			local_no_suspend;
			local_usb_comm;
			local_vconn_supply;
			pr_check = <0x0>;
		};

		pd-data {
			bat,nr = <0x1>;
			pd,charging_policy = <0x31>;
			pd,country_nr = <0x0>;
			pd,id-vdo-data = <0xd14029cf 0x0 0x50810000 0x41800000 0x0 0x21800000>;
			pd,id-vdo-size = <0x6>;
			pd,mfrs = "RichtekTCPC";
			pd,pid = <0x5081>;
			pd,sink-pdo-data = <0x190c8>;
			pd,sink-pdo-size = <0x1>;
			pd,source-cap-ext = <0x508129cf 0x0 0x0 0x0 0x0 0x7000000>;
			pd,source-pdo-data = <0x19096>;
			pd,source-pdo-size = <0x1>;
			pd,vid = <0x29cf>;

			bat-info0 {
				bat,design_cap = <0xbb8>;
				bat,mfrs = "bat1";
				bat,pid = <0x5081>;
				bat,vid = <0x29cf>;
			};
		};
	};

	usb-phy@11210000 {
		#address-cells = <0x2>;
		#size-cells = <0x2>;
		compatible = "mediatek,generic-tphy-v1";
		phandle = <0xbe>;
		ranges;
		reg = <0x0 0x11cc0000 0x0 0x800>;
		status = "okay";

		usb-phy@11210000 {
			#phy-cells = <0x1>;
			clock-names = "ref";
			clocks = <0x21>;
			nvmem-cell-masks = <0x1f>;
			nvmem-cell-names = "intr_cal";
			nvmem-cells = <0x4c>;
			phandle = <0x4b>;
			reg = <0x0 0x11cc0800 0x0 0x100>;
			status = "okay";
		};
	};

	usb0@11200000 {
		clock-names = "usb0", "usb0_clk_top_sel", "usb0_clk_univpll3_d4";
		clocks = <0x22 0x8 0xf 0x7f 0xf 0x23>;
		compatible = "mediatek,mt6761-usb20";
		dr_mode = "otg";
		interrupt-names = "mc";
		interrupts = <0x0 0x11 0x8>;
		mode = <0x2>;
		multipoint = <0x1>;
		num_eps = <0x10>;
		pericfg = <0x4a>;
		phandle = <0x61>;
		phys = <0x4b 0x3>;
		reg = <0x0 0x11200000 0x0 0x10000 0x0 0x11cc0000 0x0 0x10000>;
		usb-role-switch;
	};

	usb1p_sif@11210000 {
		compatible = "mediatek,usb1p_sif";
		reg = <0x0 0x11210000 0x0 0x10000>;
	};

	utos {
		compatible = "microtrust,utos";
		interrupts = <0x0 0xbc 0x1 0x0 0xbd 0x1>;
	};

	utos_tester {
		compatible = "microtrust,tester-v1";
	};

	vcodecsys@17000000 {
		#clock-cells = <0x1>;
		compatible = "mediatek,mt6761-vcodecsys", "syscon";
		phandle = <0x5f>;
		reg = <0x0 0x17000000 0x0 0x10000>;
	};

	vdec@17040000 {
		compatible = "mediatek,vdec";
		interrupts = <0x0 0xb1 0x8>;
		reg = <0x0 0x17040000 0x0 0x10000>;
	};

	venc@17020000 {
		compatible = "mediatek,venc";
		interrupts = <0x0 0xae 0x8>;
		reg = <0x0 0x17020000 0x0 0x10000>;
	};

	venc_gcon@17000000 {
		clock-names = "MT_SCP_SYS_DIS", "MT_SCP_SYS_VCODEC", "MT_CG_MM_SMI_COMM0", "MT_CG_MM_SMI_COMM1", "MT_CG_MM_SMI_COMMON", "MT_CG_VDEC", "MT_CG_VENC";
		clocks = <0x34 0x3 0x34 0x9 0x10 0x15 0x10 0x16 0x10 0x13 0x5f 0x3 0x5f 0x1>;
		compatible = "mediatek,venc_gcon", "syscon";
		phandle = <0xda>;
		reg = <0x0 0x17000000 0x0 0x10000>;
	};

	venc_jpg@17030000 {
		clock-names = "MT_CG_VENC_JPGENC";
		clocks = <0x5f 0x2>;
		compatible = "mediatek,venc_jpg";
		interrupts = <0x0 0xb0 0x8>;
		reg = <0x0 0x17030000 0x0 0x10000>;
	};

	wifi@18000000 {
		compatible = "mediatek,wifi";
		interrupts = <0x0 0xd4 0x8>;
		memory-region = <0x49>;
		reg = <0x0 0x18000000 0x0 0x100000>;
	};
};
